## drivers/input/touchscreen/pop10/synaptics_pop10/Kconfig
```kconfig
#
# Touchscreen driver configuration
#
config TOUCHSCREEN_SYNAPTICS_I2C_RMI4_POP10
	tristate "Synaptics DSX I2C touchscreen"
	depends on I2C
	help
	  Say Y here if you have a Synaptics DSX I2C touchscreen
	  connected to your system.

	  If unsure, say N.

	  To compile this driver as a module, choose M here: the
	  module will be called synaptics_i2c_rmi4.

config TOUCHSCREEN_SYNAPTICS_DSX_RMI4_DEV_POP10
	tristate "Synaptics I2C touchscreen rmi device"
	depends on TOUCHSCREEN_SYNAPTICS_I2C_RMI4_POP10
	help
	  This enables support for character device channel for Synaptics
	  RMI4 touchscreens.

	  Say Y here if you have a Synaptics DSX I2C touchscreen
	  connected to your system.

	  If unsure, say N.

	  To compile this driver as a module, choose M here: the
	  module will be called synaptics_dsx_rmi4_dev.

config TOUCHSCREEN_SYNAPTICS_DSX_FW_UPDATE_POP10
	tristate "Synaptics I2C touchscreen firmware update"
	depends on TOUCHSCREEN_SYNAPTICS_I2C_RMI4_POP10
	help
	  This enables support for firmware update for Synaptics RMI4
	  touchscreens.

	  Say Y here if you have a Synaptics DSX I2C touchscreen
	  connected to your system.

	  If unsure, say N.

	  To compile this driver as a module, choose M here: the
	  module will be called synaptics_dsx_fw_update.
```

## drivers/input/touchscreen/tp_tct/Kconfig
```kconfig
#
# TCT Touchscreen driver
#

# [PLATFORM]-Mod-BEGIN by TCTNB.YJ, 2014/03/25, add macro for TP driver.

config FT5X06_TOUCHPANEL_DRIVER
	tristate "Focaltech ft5x06 touchpanel driver"
	depends on TOUCHSCREEN_FT5X06
	default n
	help
	  This is the main file for touchpanel driver for Focaltech ft5x06
	  touchscreens.

	  Say Y here if you have a Focaltech ft5x06 touchscreen connected
	  to your system.

	  If unsure, say N.

          To compile this driver as a module, choose M here: the
          module will be called ft5x06_ts.

config GT9XX_TOUCHPANEL_DRIVER
	tristate "Goodix GT9xx touchpanel driver"
	depends on TOUCHSCREEN_GT9XX
	default n
	help
	  This is the main file for touchpanel driver for Goodix GT9xx
	  touchscreens.

	  Say Y here if you have a Goodix GT9xx touchscreen connected
	  to your system.

	  If unsure, say N.

	  To compile this driver as a module, choose M here: the
	  module will be called gt9xx_update.

config GT9XX_TOUCHPANEL_UPDATE
	tristate "Goodix GT9xx touchpanel auto update support"
	depends on GT9XX_TOUCHPANEL_DRIVER
	default n
	help
	  This enables support for firmware update for Goodix GT9xx
	  touchscreens.

	  Say Y here if you have a Goodix GT9xx touchscreen connected
	  to your system.

	  If unsure, say N.

	  To compile this driver as a module, choose M here: the
	  module will be called gt9xx_update.

config GT9XX_TOUCHPANEL_DEBUG
	tristate "Goodix GT9xx Tools for debuging"
	depends on GT9XX_TOUCHPANEL_DRIVER
	default n
	help
	  This is application debug interface support for Goodix GT9xx
	  touchscreens.

	  Say Y here if you want to have a Android app debug interface
	  to your system.

	  If unsure, say N.

	  To compile this driver as a module, choose M here: the
	  module will be called gt9xx_update.

# [PLATFORM]-Mod-END by TCTNB.YJ
```

## drivers/media/mmc/Kconfig
```kconfig
comment "Supported MMC/SDIO adapters"
#delete, by ck-changjun.li
#source "drivers/media/mmc/siano/Kconfig"
source "drivers/media/mmc/sms4470/Kconfig"
```

## drivers/media/mmc/sms4470/Kconfig
```kconfig
#
# Siano Mobile Silicon Digital TV device configuration
#

config SMS_SIANO_MDTV
	tristate "Siano SMSxxxx based MDTV receiver"
	default n
	---help---
	  Choose Y or M here if you have MDTV receiver with a Siano chipset.

	  To compile this driver as a module, choose M here
	  (The module will be called smsmdtv).

	  Further documentation on this driver can be found on the WWW
	  at http://www.siano-ms.com/

menu "Siano module components"
	depends on SMS_SIANO_MDTV

# Kernel sub systems support

config SMS_RC_SUPPORT_SUBSYS
	bool "Remote Control Subsystem support"
	depends on RC_CORE
	default n
	---help---
	Choose if you would like to have Siano's ir remote control sub-system support.

config SMS_HOSTLIB_SUBSYS
	bool "Host Library Subsystem support"
	default n
	---help---
	Choose if you would like to have Siano's host library kernel sub-system support.

config SMS_DVB_API_SUBSYS
	bool "DVB API Subsystem support"
	depends on DVB_CORE
	default n
	---help---
	Choose if you would like to have Siano's host library kernel sub-system support.

if SMS_HOSTLIB_SUBSYS
config SMS_NET_SUBSYS
	bool "Siano Network Adapter"
	depends on NET
	default n
	---help---
	Choose if you would like to have Siano's network adapter support.
endif # SMS_HOSTLIB_SUBSYS

# Hardware interfaces support

config SMS_USB_DRV
	bool "USB interface support"
	depends on USB
	default y if USB
	---help---
	  Choose if you would like to have Siano's support for USB interface

config SMS_SDIO_DRV
	bool "SDIO interface support"
	depends on MMC
	---help---
	  Choose if you would like to have Siano's support for SDIO interface

config SMS_SPI_DRV
	bool "SPI interface support"
	depends on SPI
	default n if SPI
	---help---
	Choose if you would like to have Siano's support for PXA 310 SPI interface

config SMS_I2C_DRV
	bool "I2C interface support"
	depends on I2C
	---help---
	Choose if you would like to have Siano's support for I2C interface
	
choice
	prompt "SMS mdtv power management"
#	default SMS_POWER_CUSTOMER
	default n
	---help---
	  power control driver for the Siano SMSxxxx based MDTV
	  
config SMS_POWER
	bool "Siano SMSxxxx based MDTV power ctrl driver"
	default n
	---help---
	Siano power management sequence 

config SMS_POWER_CUSTOMER
	bool "Siano SMSxxxx based MDTV power ctrl customer driver"
	default n
	---help---
	Customer power management sequence 
	  
endchoice

endmenu
```
