## drivers/media/platform/msm/camera_v2/Kconfig
```kconfig
config MSM_CAMERA_SENSOR
	    bool "Qualcomm MSM camera sensor support"
	    depends on MSMB_CAMERA
        ---help---
          This flag enables support for Camera Sensor.
          The sensor driver is capable of providing real time
          data for camera support. The driver support V4L2
          subdev APIs.


config LG_PROXY
        bool "Qualcomm MSM camera proxy support"
        depends on MSMB_CAMERA
        ---help---
        Enable support for proxy sensor for msm camera.

config LG_TCS
        bool "Qualcomm MSM camera tcs support"
        depends on MSMB_CAMERA
        ---help---
        Enable support for rgbir sensor for msm camera.

config MSM_CPP
        bool "Qualcomm MSM Camera Post Processing Engine support"
        depends on MSMB_CAMERA
        ---help---
          Enable support for Camera Post-processing Engine
          The Post processing engine is capable of scaling
          and cropping image. The driver support V4L2 subdev
          APIs.

config MSM_CCI
        bool "Qualcomm MSM Camera Control Interface support"
        depends on MSMB_CAMERA
        ---help---
          Enable support for Camera Control Interface driver only
          for those platforms that have hardware support. This driver
          is responsible for handling I2C read and write on the I2C
          bus. It is also responsible for synchronization with
          GPIO and data frames.

config MSM_CSI20_HEADER
        bool "Qualcomm MSM CSI 2.0 Header"
        depends on MSMB_CAMERA
        ---help---
          Enable support for CSI drivers to include 2.0
          header. This header has register macros and its
          values and bit mask for register configuration bits
          This config macro is required targets based on 8960,
          8930 and 8064 platforms.

config MSM_CSI22_HEADER
        bool "Qualcomm MSM CSI 2.2 Header"
        depends on MSMB_CAMERA
        ---help---
          Enable support for CSI drivers to include 2.2
          header. This header has register macros and its
          values and bit mask for register configuration bits
          This config macro is required targets based on 8610
          platform.

config MSM_CSI30_HEADER
        bool "Qualcomm MSM CSI 3.0 Header"
        depends on MSMB_CAMERA
        ---help---
          Enable support for CSI drivers to include 3.0
          header. This header has register macros and its
          values and bit mask for register configuration bits
          This config macro is required for targets based on
          8064 platforms.

config MSM_CSI31_HEADER
        bool "Qualcomm MSM CSI 3.1 Header"
        depends on MSMB_CAMERA
        ---help---
          Enable support for CSI drivers to include 3.0
          header. This header has register macros and its
          values and bit mask for register configuration bits
          This config macro is required for targets based on
          APQ8084 platform.

config MSM_CSIPHY
        bool "Qualcomm MSM Camera Serial Interface Physical receiver support"
        depends on MSMB_CAMERA
        ---help---
          Enable support for Camera Serial Interface
          Physical receiver. It deserializes packets and
          supports detection of packet start and stop
          signalling.

config MSM_CSID
        bool "Qualcomm MSM Camera Serial Interface decoder support"
        depends on MSMB_CAMERA
        ---help---
          Enable support for Camera Serial Interface decoder.
          It supports lane merging and decoding of packets
          based on cid which is mapped to a virtual channel
          and datatype.

config MSM_EEPROM
        bool "Qualcomm MSM Camera ROM Interface for Calibration support"
        depends on MSMB_CAMERA
        ---help---
          Enable support for ROM Interface for Calibration
          Provides interface for reading the Claibration data.
          and also provides support for writing data in case of FLASH ROM.
	  Currently supports I2C, CCI and SPI protocol

config MSM_ISPIF
        bool "Qualcomm MSM Image Signal Processing interface support"
        depends on MSMB_CAMERA
        ---help---
          Enable support for Image Signal Processing interface module.
          This module acts as a crossbar between CSID and VFE. Output
          of any CID of CSID can be routed to of of pixel or raw
          data interface in VFE.

config MSM_ISPIF_V1
        bool "Qualcomm MSM Image Signal Processing interface support"
        depends on MSMB_CAMERA
        ---help---
          Enable support for Image Signal Processing interface module.
          This module acts as a crossbar between CSID and VFE. Output
          of any CID of MSM_CSI22_HEADER can be routed to of pixel
          or raw data interface in VFE.


config S5K3L2
    bool "Sensor S5K3L2XX (Samsung 13MP)"
    depends on MSMB_CAMERA
    ---help---
        Support for S5K3L2XX sensor driver.
        This is a Samsung 13MP Bayer Sensor with autofocus.
        Say Y if the platform uses S5K3L2 sensor.

config HI544
    bool "Sensor hi544 (Hynix 5MP)"
    depends on MSMB_CAMERA
    ---help---
        Support for HI544 sensor driver.
        This is a Hynix 5MP Bayer Sensor with autofocus.
        Say Y if the platform uses HI544 sensor.

config HI545
    bool "Sensor hi545 (Hynix 5MP)"
    depends on MSMB_CAMERA
    ---help---
        Support for HI545 sensor driver.
        This is a Hynix 5MP Bayer Sensor with autofocus.
        Say Y if the platform uses HI544 sensor.

config HI841
    bool "Sensor hi841 (Hynix 8MP)"
    depends on MSMB_CAMERA
    ---help---
        Support for HI841 sensor driver.
        This is a Hynix 8MP Bayer Sensor with autofocus.
        Say Y if the platform uses HI841 sensor.

config IMX134
	bool "Sensor IMX134 (BAYER 8M)"
	depends on MSMB_CAMERA
	---help---
		Sony 8 MP Bayer Sensor with auto focus, uses
		4 mipi lanes full resolution @30fps and
		HFR @60fps and @120fps,
		Video HDR support.

config IMX132
	bool "Sensor IMX132 (BAYER 2M)"
	depends on MSMB_CAMERA
	---help---
		Sony 2 MP Bayer Sensor with auto focus, uses
		2 mipi lanes, preview config = 1920 x 1080 at 30 fps,
		snapshot config = 1920 x 1080 at 30 fps,
		Video HDR support.
config IMX219
	bool "Sensor imx219 (Sony 8MP)"
	depends on MSMB_CAMERA
	---help---
		Support for IMX219 sensor driver.
		This is a Sony 8MP Bayer Sensor with autofocus.
		Say Y if the platform uses IMX219 sensor.

config OV9724
	bool "Sensor OV9724 (BAYER 2M)"
	depends on MSMB_CAMERA
	---help---
		OmniVision 2 MP Bayer Sensor, supports 2 mipi lanes,
		preview and snapshot config at 1280*720 at 30 fps,
		hfr video at 60, 90 and 120 fps. This sensor driver does
		not support auto focus.

config HI256
        bool "Hynix hi256 (YUV 2MP)"
        depends on MSMB_CAMERA
        ---help---
                OmniVision 8 MP Bayer Sensor with auto focus.uses
                2 mipi lanes, preview config = 1632*1224 30 fps,
                snapshot config = 3264 * 2448 at 18 fps.
                2 lanes max fps is 18, 4 lanes max fps is 24.

config OV5648
	bool "Sensor OV5648 (BAYER 5M)"
	depends on MSMB_CAMERA
	---help---
		OmniVision 5 MP Bayer Sensor, only use 1 mipi lane,
		preview set to 1296*972 at 30 fps,
		snapshot set to 2592*1944 at 12 fps,
		This sensor driver does not support auto focus.

config OV5670
	bool "Sensor OV5670 (BAYER 5M)"
	depends on MSMB_CAMERA
	---help---
		OmniVision 5 MP Bayer Sensor, use 1 or 2 mipi lane,
		preview set to 1296*972 at 30 fps,
		snapshot set to 2592*1944 at 30 fps,
		This sensor driver does not support auto focus.

config MT9M114
	bool "Sensor MT9M114 (YUV 1.26MP)"
	depends on MSMB_CAMERA
	---help---
		MT9M114 is Aptina YUV sensor. It supports 1.26 MP preview
		and snapshot. The preview and snapshot resolution shall be
		1280 * 270. It does not support auto focus. It supports
		few special effects like saturation.

config HI707
	bool "Sensor HI707 (YUV VGA)"
	depends on MSMB_CAMERA
	---help---
		HI707 is Aptina YUV sensor. It supports VGA preview
		and snapshot. The preview and snapshot resolution shall be
		640 * 480. It does not support auto focus. It supports
		few special effects like saturation.

config HI191
	bool "Sensor HI191 (YUV 1M)"
	depends on MSMB_CAMERA
	---help---
		HI191 is Hynix YUV sensor. It supports 1MP preview
		and snapshot. The preview and snapshot resolution shall be
		1280 * 720. It does not support auto focus. It supports
		few special effects like saturation.

config BF3905
	bool "Sensor BF3905 (YUV VGA)"
	depends on MSMB_CAMERA
	---help---
		BF3905 is BYD YUV sensor. It supports VGA preview
		and snapshot. The preview and snapshot resolution shall be
		640 * 480. It does not support auto focus. It supports
		few special effects like saturation.

config OV5645
	bool "Sensor OV5645 (YUV 5.0MP)"
	depends on MSMB_CAMERA
	---help---
		OV5645 is Omnivision YUV sensor. It supports 5.0 MP preview
		and snapshot. The preview and snapshot resolution shall be
		1280 * 270. It does not support auto focus. It supports
		few special effects like saturation.

config OV7695
	bool "Sensor OV7695 (YUV 0.3MP)"
	depends on MSMB_CAMERA
	---help---
		OV7695 is Omnivision YUV sensor. It supports 0.3 MP preview
		and snapshot. The preview and snapshot resolution shall be
		VGA. It does not support auto focus. It supports
		few special effects like saturation.

config SP1628
	bool "Sensor SP1628 (YUV 720P)"
	depends on MSMB_CAMERA
	---help---
		SP1628 is SuperPix YUV sensor. It supports 720P preview
		and snapshot. The preview and snapshot resolution shall be
		1280 * 270. It does not support auto focus. It supports
		few special effects like mono.

config GC0339
	bool "Sensor GC0339 (BAYER .3M)"
	depends on MSMB_CAMERA
	---help---
		gc0339 is a Galaxycore .3 MP Bayer Sensor.
		It supports 1 or 2 mipi lanes.
		Preview and snapshot resolution shall be 640*480 at 30 fps,
		It does not support auto focus.

config OV8825
	bool "OmniVision OV8825 (BAYER 8MP)"
	depends on MSMB_CAMERA
	---help---
		OmniVision 8 MP Bayer Sensor with auto focus.uses
		2 mipi lanes, preview config = 1632*1224 30 fps,
		snapshot config = 3264 * 2448 at 18 fps.
		2 lanes max fps is 18, 4 lanes max fps is 24.

config OV8865
	bool "OmniVision OV8865 (BAYER 8MP)"
	depends on MSMB_CAMERA
	---help---
		OmniVision 8 MP Bayer Sensor with auto focus.uses
		4 mipi lanes, preview config = 1632*1224 30 fps,
		snapshot config = 3264 * 2448 at 30 fps.
		Max fps is 30fps at 3264 * 2448, 60fps at 1632 * 1224

config s5k4e1
	bool "Sensor s5k4e1 (BAYER 5MP)"
	depends on MSMB_CAMERA
	---help---
		Samsung 5 MP Bayer Sensor. It uses 2 mipi lanes,
		supports 720P preview at 30 fps
		and QSXGA snapshot at 15 fps.
		This sensor driver does not support auto focus.

config OV12830
	bool "OmniVision OV12830 (BAYER 12MP)"
	depends on MSMB_CAMERA
	---help---
		OmniVision 12.8 MP Bayer Sensor with auto focus.uses
		4 mipi lanes, preview config = 2112 * 1500 at 30 fps,
		snapshot config = 4224 * 3000 at 15 fps.
		2 lanes max fps is 18, 4 lanes max fps is 24.

config MSM_V4L2_VIDEO_OVERLAY_DEVICE
	tristate "Qualcomm MSM V4l2 video overlay device"
	---help---
	  Enables support for the MSM V4L2 video
	  overlay driver. This allows video rendering
	  apps to render overlaid video using Video4Linux2
	  APIs, by using /dev/videoX device

config MSMB_JPEG
	tristate "Qualcomm MSM Jpeg Encoder Engine support"
        depends on MSMB_CAMERA && (ARCH_MSM8974 || ARCH_MSM8226 || ARCH_APQ8084 || ARCH_MSM8916 || ARCH_MSM)
	---help---
	  Enable support for Jpeg Encoder/Decoder
	  Engine for 8974.
	  This module serves as the common driver
	  for the JPEG 1.0 encoder and decoder.

config MSM_GEMINI
	tristate "Qualcomm MSM Gemini JPEG engine support"
	depends on MSMB_CAMERA && (ARCH_MSM7X30 || ARCH_MSM8X60 || ARCH_MSM8960)
	---help---
	  Enables support for the Gemini JPEG encoder engine for 8x60.

config BACKLIGHT_RT8542
        tristate "Backlight driver for rt8542 visualisation device"
        depends on BACKLIGHT_CLASS_DEVICE
        help
          To compile this driver as a module, choose M here: the module will be
          called rt8542 driver.
	  
config BACKLIGHT_LM3632
	tristate "Backlight Driver for LM3632"
	depends on BACKLIGHT_CLASS_DEVICE && I2C
	help
	  This supports TI LM3632 backlight, LCD power and flash solution

config LGE_TOUCH_CTRL_DSV
	tristate "Touch Control DSV in LM3632"
	depends on BACKLIGHT_LM3632
	help
	  This supports Touch IC control DSV for knock on

config BACKLIGHT_LM3639
	tristate "Backlight Driver for LM3639"
	depends on BACKLIGHT_CLASS_DEVICE && I2C
	help
	  This supports TI LM3639 backlight and flash solution

config MSM_FD
	 tristate "Qualcomm MSM FD face detection engine support"
	 depends on MSMB_CAMERA
	 ---help---
	    Enables support for the MSM FD face detection engine.

config LGE_G4STYLUS_CAMERA
	bool "Lion Stylus LGE camera"
	depends on MACH_LGE
	help
	  Enable Lion stylus LGE camera

config LGE_P1B_CAMERA
	bool "Lion Beat LGE camera"
	depends on MACH_LGE
	help
	  Enable Lion Beat LGE camera

config LGE_YG_CAMERA
	bool "LGE YG Camera"
	depends on MACH_LGE
	help
	  Enable LGE YG Camera

config FLASHLIGHT_LM3559
	bool "LM3559 Flashlight"
	depends on MACH_LGE
	help
	  Enable LM3559 Flashlight

config LGE_CAMERA_USE_MAKER_ID
	bool "Use maker id"
	depends on MACH_LGE
	help
	  Enable maker id check

config LGE_DISABLE_VCM_POWER_DOWN_MODE
	bool "Disable vcm power down mode"
	depends on MACH_LGE
	help
	  Disable vcm power down mode
```

## drivers/misc/idol347_sensor/Kconfig
```kconfig
config IDOL347_SENSOR_HALL
	tristate "Hall sensor"
	default n
	help
         Say Y here to enable support for the Hall sensor
         To compile this driver as a module, choose M here: the module will
         be called hall_sensor.

config IDOL347_SENSOR_KIONIX_ACCEL
	tristate "KIONIX_ACCEL"
	depends on I2C
	default n
	help
	  If you say yes here you get support for the Kionix digital 3-axis
	  accelerometer.
	  This driver can also be built as a module. If so, the module will be
	  called kionix_accel.

config IDOL347_SENSOR_TSL27723
	tristate "TAOS TSL27723 proximity and ambient light sensor"
	depends on I2C
	default n
	help
	  If you say yes here you get support for the TAOS tsl27723,
	  proximity and ambient light sensors.
	  This driver can also be built as a module.  If so, the module
	  will be called tsl277x.

config IDOL347_SENSOR_BMG
	tristate "Bosch Gyroscope Sensor Driver"
	depends on I2C
	default n
	help
	  If you say yes here, you get support for Bosch Sensortec
	  gyroscope sensor drivers of BMG160/BMI055/BMI058 e.t.c.\

config IDOL347_SENSOR_BMG_FIFO
	tristate "Bosch Gyroscope FIFO Support"
	depends on IDOL347_BMG
	help
	  If you say yes here, you get support for Gyroscope sensor FIFO operations.

config IDOL347_SENSOR_AKM09911_MAG
	tristate "AKM09911 3-axis electronic compass sensor driver"
	depends on I2C
	default n
	help
	  Say Y here if you want to enable the akm09911 ecompass sensor
	  driver.

	  To compile this driver as a module, choose M here: the
	  module will be called akm09911.

config IDOL347_SENSOR_RPR521
	tristate "ROHM RPR521 proximity and ambient light sensor"
	depends on I2C
	default n
	help
	  If you say yes here you get support for the ROHM RPR521,
	  proximity and ambient light sensors.
	  This driver can also be built as a module.  If so, the module
	  will be called RPR521.

config IDOL347_SENSOR_STK3X1X
	tristate "proximity and ambient light sensor"
	depends on I2C
	default n
```
