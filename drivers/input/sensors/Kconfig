## drivers/input/sensors/Kconfig
```kconfig
#
# Sensor drivers configuration
#

config SENSORS_CM36686
        bool "AL3320A Light Sensor"
        depends on I2C


config SENSORS_BMC156
        bool "BMC156 G-Sensor & E-compass"
        depends on I2C
config SENSORS_HALL
        bool "Hall sensor"
	depends on INPUT
        default n
        ---help---
         Say y here if you want to use this hall sensor driver, it
         is like a switch. For example, lid.
```

## drivers/input/sensors/bmc156/Kconfig
```kconfig
#
# Makefile for Bosch sensors driver.
#
config SENSORS_BMA2X2
	tristate "BMA255/BMA250E/BMA222E/BMA280 acceleration sensor support"
	depends on I2C
	help
	  If you say yes here, you get support for Bosch Sensortec's
	  acceleration sensors BMA255/BMA250E/BMA222E/BMA280.

config SENSORS_BMA2X2_ENABLE_INT1
	tristate "BMA2X2 acceleration sensor interrupt INT1 support"
	help
	 If you say yes here, you get INT1 support for Bosch Sensortec
	 acceleration sensors BMA255/BMA250E/BMA222E/BMA280.
	 Select it will disable interrupt INT2 support

config SENSORS_BMA2X2_ENABLE_INT2
	tristate "BMA2X2 acceleration sensor interrupt INT2 support"
	help
	 If you say yes here, you get INT2 support for Bosch Sensortec
	 acceleration sensors BMA255/BMA250E/BMA222E/BMA280.
	 Can only open if you do NOT open interrupt INT1 support

config SIG_MOTION
	tristate "support significant motion sensor function"
	depends on SENSORS_BMA2X2  && ( SENSORS_BMA2X2_ENABLE_INT1 || SENSORS_BMA2X2_ENABLE_INT2)
	help
	 If you say yes here, if you want to support Bosch significant motion sensor function

config DOUBLE_TAP
	tristate "support double tap sensor function"
	depends on SENSORS_BMA2X2  && ( SENSORS_BMA2X2_ENABLE_INT1 || SENSORS_BMA2X2_ENABLE_INT2)
	help
	 If you say yes here, you get support Bosch double tap sensor function

config SENSORS_BMG
	tristate "Bosch Gyroscope Sensor Driver"
	depends on I2C
	help
	 If you say yes here, you get support for Bosch Sensortec's
	 gyroscope sensor drivers of BMG160/BMI055/BMI058 e.t.c.

config SENSORS_BMG_FIFO
	tristate "Bosch Gyroscope FIFO Support"
	depends on SENSORS_BMG
	help
	 If you say yes here, you get support for Gyroscope sensor FIFO operations.

config SENSORS_BMI058
	tristate "BMI058 Sensor Support"
	depends on (SENSORS_BMG || SENSORS_BMA2X2)
	help
	 If you say yes here, you get support for Bosch Sensortec's
	 sensor driver of BMI058.

config SENSORS_BMM050
	tristate "BMM050 Magnetic Sensor Driver"
	depends on I2C
	help
	 If you say yes here, you get support for Bosch Sensortec's
	 sensor BMM050 Magnetic Sensor

config SENSORS_BMP18X
	tristate "BMP18X Pressure Sensor Driver"
	depends on I2C
	help
	  If you say yes here, you get support for Bosch Sensortec's BMP18X Pressure Sensor.

config SENSORS_BMP280
	tristate "BMP280 digital Pressure Sensor"
	depends on (I2C || SPI_MASTER) && SYSFS
	help
	 If you say yes here, you get support for Bosch Sensortec's BMP280 digital pressure sensors.

config SENSORS_BMP280_I2C
	tristate "support I2C bus communication"
	depends on SENSORS_BMP280 && I2C
	help
	 If you say yes here, you get support Bosch Sensortec's BMP280 pressure sensor hooked to an I2C bus.

config SENSORS_BMP280_SPI
	tristate "support SPI bus communication"
	depends on SENSORS_BMP280 && SPI_MASTER
	help
	 If you say yes here, you get support Bosch Sensortec'S bmp280 pressure sensor hooked to an SPI bus.

config SENSORS_BMM050_Z300KL
	tristate "BMM050 Magnetic Sensor Driver"
	depends on I2C
	help
	 If you say yes here, you get support for Bosch Sensortec's
	 sensor BMM050 Magnetic Sensor

config SENSORS_BMA2X2_Z300KL
	tristate "BMA255/BMA250E/BMA222E/BMA280 acceleration sensor support"
	depends on I2C
	help
	  If you say yes here, you get support for Bosch Sensortec's
	  acceleration sensors BMA255/BMA250E/BMA222E/BMA280.
```

## drivers/input/sensors_v1/Kconfig
```kconfig
#
#
# Input misc drivers configuration
#
menu "BBK Sensors devices"
config BBK_SENSORS_V1
	tristate "BBK Sensors config ..."
	help
	  Say Y here, and a list of miscellaneous input drivers will be displayed.
	  Everything that didn't fit into the other categories is here. This option
	  doesn't affect the kernel.
	  If unsure, say Y.

if BBK_SENSORS_V1

config BBK_SENSORS_APDS9960
	tristate "AVAGO APDS9960 Digital Proximity, Ambient Light, RGB and Gesture Sensor"
	depends on I2C
	help
	  Say Y here if you want to support AVAGO APDS9960
	  connected via an I2C bus.
	  To compile this driver as a module, choose M here: the
	  module will be called apds9960.
	  
config BBK_SENSORS_APDS9920
	tristate "AVAGO APDS9920 Digital Proximity, Ambient Light Sensor"
	depends on I2C
	help
	  Say Y here if you want to support AVAGO APDS9920
	  connected via an I2C bus.
	  To compile this driver as a module, choose M here: the
	  module will be called apds9920.
config BBK_SENSORS_APDS9922
	tristate "AVAGO APDS9922 Digital Proximity, Ambient Light Sensor"
	depends on I2C
	help
	  Say Y here if you want to support AVAGO APDS9922
	  connected via an I2C bus.
	  To compile this driver as a module, choose M here: the
	  module will be called apds9922.
	  
config BBK_SENSORS_GP2AP008T
	tristate "SHARP GP2AP008T Digital Proximity, Ambient Light Sensor"
	depends on I2C
	help
	  Say Y here if you want to support SHARP GP2AP008T
	  connected via an I2C bus.
	  To compile this driver as a module, choose M here: the
	  module will be called GP2AP008T.
	  
config BBK_SENSORS_GYRO_L3GD20TR
	tristate "ST L3GD20TR gyro Sensor"
	depends on I2C
	help
	  Say Y here if you want to support ST L3GD20TR
	  connected via an I2C bus.
	  To compile this driver as a module, choose M here: the
	  module will be called L3GD20TR.	  

config BBK_SENSORS_LIS3DH
	tristate "ST LIS3DH 3-axis digital acceleromater"
	depends on I2C
	help
	  Say Y here if you want to support STMicroelectronics LIS3DH
	  accelerometer connected via an I2C bus.
	  To compile this driver as a module, choose M here: the
	  module will be called lis3dh_acc.
	  
config BBK_SENSORS_MAG_YAS533
	tristate "Yamaha YAS533 mag Sensor"
	depends on I2C
	help
	  Say Y here if you want to support Yamaha YAS533
	  connected via an I2C bus.
	  To compile this driver as a module, choose M here: the
	  module will be called YAS533.	 
	  
config BBK_SENSORS_MAG_YAS537
	tristate "Yamaha YAS537 mag Sensor"
	depends on I2C
	help
	  Say Y here if you want to support Yamaha YAS537
	  connected via an I2C bus.
	  To compile this driver as a module, choose M here: the
	  module will be called YAS537.	 
	
config BBK_SENSORS_TMD277X
	tristate "TAOS TMD277X or AVAGO APDS9930 Digital Proximity, Ambient Light"
	depends on I2C
	help
	  Say Y here if you want to support TMD277X
	  connected via an I2C bus.
	  To compile this driver as a module, choose M here: the
	  module will be called TMD277X.	   

config BBK_SENSORS_MAG_AKM8963
	tristate "AKM akm8963 mag Sensor"
	depends on I2C
	help
	  Say Y here if you want to support AKM akm8963
	  connected via an I2C bus.
	  To compile this driver as a module, choose M here: the
	  module will be called akm8963.

config BBK_SENSORS_MAG_AKM09911
	tristate "AKM akm09911 mag Sensor"
	depends on I2C
	help
	  Say Y here if you want to support AKM akm09911
	  connected via an I2C bus.
	  To compile this driver as a module, choose M here: the
	  module will be called akm09911.	  

#laizhilong add start
config BBK_SENSORS_LSM330ACC
	tristate "LSM330ACC 3-axis electronic acc sensor driver"
	depends on I2C
	default n
	help
	  Say Y here if you want to enable the LSM330ACC ecompass sensor
	  driver.
	  To compile this driver as a module, choose M here: the
	  module will be called LSM330ACC.
	  
config BBK_SENSORS_LSM330GYRO
	tristate "LSM330GYRO 3-axis electronic gyroscope sensor driver"
	depends on I2C
	default n
	help
	  Say Y here if you want to enable the LSM330GYRO ecompass sensor
	  driver.
	  To compile this driver as a module, choose M here: the
	  module will be called LSM330GYRO.

config BBK_SENSORS_MAG_ALPS007
	tristate "ALPS ALPS007 mag Sensor"
	depends on I2C
	help
	  Say Y here if you want to support ALPS ALPS007
	  connected via an I2C bus.
	  To compile this driver as a module, choose M here: the
	  module will be called ALPS.	 
#laizhilong add end

# weitianlei add start
config BBK_SENSORS_KX023
	tristate "ST KX023 3-axis digital acceleromater"
	depends on I2C
	help
	  Say Y here if you want to support STMicroelectronics KX023
	  accelerometer connected via an I2C bus.
	  To compile this driver as a module, choose M here: the
	  module will be called kx023_acc.
	  
config BBK_SENSORS_MPU6500
	tristate "Inven MPU6500 Gyroscope and accelerometer sensor"
	depends on I2C
	help
	  Say Y here if you want to support InvenSense MPU6500
	  Gyroscope and accelerometer connected via an I2C bus.
	  To compile this driver as a module, choose M here: the
	  module will be called mpu6500.
# weitianlei add end
endif



endmenu
```

## drivers/input/touchscreen/MIT300/Kconfig
```kconfig
#
# Kconfig for MELFAS MIP4 Touchscreen Driver
#

if INPUT_TOUCHSCREEN

config TOUCHSCREEN_MELFAS_MIT300
        tristate "MELFAS MIT300 Touchscreen"
        depends on I2C
        help
          Say Y here if you have a MELFAS MIT300 touchscreen device based on ts_core in your system.

          If unsure, say N.

          To compile this driver as a module, choose M here: the module will be called mip4_ts.

config TOUCHSCREEN_MELFAS_MIT300_PH1
	tristate "MELFAS MIT300 Touchscreen"
        depends on I2C
        help
          Say Y here if you have a MELFAS MIT300 PH1 touchscreen device based on ts_core in your system.

          If unsure, say N.

          To compile this driver as a module, choose M here: the module will be called mip4_ts.

endif
```

## drivers/input/touchscreen/TD4191/Kconfig
```kconfig
#
# Synaptics TD4191 touchscreen driver configuration
#
config TOUCHSCREEN_LGE_SYNAPTICS_TD4191
	tristate "Synaptics TD4191 I2C Touchscreen"
	depends on I2C
	help
	  Say Y here if you have Synaprics I2C touchscreen,
	  such as TD4191, connected to your system.

	  If unsure, say N.

	  To compile this driver as a module, choose M here: the
	  module will be called synaptics_TD4191.

source "drivers/input/touchscreen/TD4191/synaptics_dsx/Kconfig"
```

## drivers/input/touchscreen/ekth3260/Kconfig
```kconfig
#
# ELAN ekth3260 Touchscreen driver
#

config TOUCHSCREEN_EKTH3260
	boolean "ELAN ekth3260 touchpanel driver"
	depends on I2C
	default n
	help
	  This is the main file for touchpanel driver for ELAN ekth3260
	  touchscreens.

	  Say Y here if you have a ELAN ekth3260 touchscreen connected
	  to your system.

	  If unsure, say N.
```

## drivers/input/touchscreen/ft5x36_idol3/Kconfig
```kconfig
config TOUCHSCREEN_FT5X36_IDOL3
       tristate "MSG touchscreens"
       depends on I2C
       help
         Say Y here if you have a FT touchscreen on TCL 
         If unsure, say N.
         To compile this driver as a module, choose M here: the
         module will be called FT.
```

## drivers/input/touchscreen/gt1x/Kconfig
```kconfig
#
# Goodix GT1x Touchscreen driver
#

config TOUCHSCREEN_GT1X
	tristate "Goodix GT1x touchpanel driver"
    depends on I2C
	default n
	help
	  This is the main file for touchpanel driver for Goodix GT1x
	  touchscreens.

	  Say Y here if you have a Goodix GT1x touchscreen connected
	  to your system.

	  If unsure, say N.

	  To compile this driver as a module, choose M here: the
	  module will be called gt1x.
```

## drivers/input/touchscreen/gt928/Kconfig
```kconfig
#
# Goodix GT928 Touchscreen driver
#

config TOUCHSCREEN_GT928
	boolean "Goodix GT928 touchpanel driver"
	depends on I2C
	default n
	help
	  This is the main file for touchpanel driver for Goodix GT928
	  touchscreens.

	  Say Y here if you have a Goodix GT928 touchscreen connected
	  to your system.

	  If unsure, say N.
```

## drivers/input/touchscreen/gt970/Kconfig
```kconfig
#
# gt970 configuration
#
menuconfig BBK_TOUCHSCREEN_GT970
	bool "gt970"
	help
	  Say Y here, and a list of miscellaneous input drivers will be displayed.
	  Everything that didn't fit into the other categories is here. This option
	  doesn't affect the kernel.

	  If unsure, say Y.

if BBK_TOUCHSCREEN_GT970
config BBK_GT9XX_TOUCHPANEL_DRIVER
	bool "Goodix GT9xx touchpanel driver"
	help
	  Say Y here if you want to support the Synaptics RMI4 bus.

	  If unsure, say Y.

	  This feature is not currently available as a loadable module.

config BBK_GT9XX_TOUCHPANEL_UPDATE
	bool "Goodix GT9xx touchpanel auto update support"
	help
	  This enables support for firmware update for Goodix GT9xx
	  touchscreens.

	  If unsure, say N.

config BBK_GT9XX_TOUCHPANEL_DEBUG
	bool "Goodix GT9xx Tools for debuging"
	help
	  This is application debug interface support for Goodix GT9xx
	  touchscreens.
	  
	  If unsure, say N.
	  
endif
```

## drivers/input/touchscreen/msg21xx/Kconfig
```kconfig
# modify(add) by junfeng.zhou.sz for [TP driver development (1st source)] with PR721418 begin . 20140714 
config TOUCHSCREEN_MSG21XX             
       tristate "MSG21xx touchscreens"
       depends on I2C
       help
         Say Y here if you have a MSG21xx touchscreen on TCL RIO.
         If unsure, say N.

         To compile this driver as a module, choose M here: the
         module will be called MSG21xx.
# modify(add) by junfeng.zhou.sz for [TP driver development (1st source)] with PR721418 end .
```

## drivers/input/touchscreen/msg2638_tp/Kconfig
```kconfig
#[PLATFORM]-Add-BEGIN by TCTSH.furong, 2014/11/18 add msg2638 TP
config TOUCHSCREEN_MSG2638            
       tristate "MSG2638 touchscreen"
       depends on I2C
       help
         Say Y here if you have a MSG2638 touchscreen on TCL RIO.
         If unsure, say N.
         To compile this driver as a module, choose M here: the
         module will be called MSG2638.
# [PLATFORM]-Add-END by TCTSH.furong
```

## drivers/input/touchscreen/msg_tp/Kconfig
```kconfig
#[PLATFORM]-Add-BEGIN by TCTNB.ZXZ, FR-788074, 2014/09/20 add msg2633 TP
config TOUCHSCREEN_MSG            
       tristate "MSG touchscreens"
       depends on I2C
       help
         Say Y here if you have a MSG touchscreen on TCL RIO.
         If unsure, say N.
         To compile this driver as a module, choose M here: the
         module will be called MSG.
# [PLATFORM]-Add-END by TCTNB.ZXZ
```

## drivers/input/touchscreen/pop10/ft5x06/Kconfig
```kconfig
#
# TCT Touchscreen driver
#

# [PLATFORM]-Mod-BEGIN by weihong.chen.sz, 2014/08/20, add macro for POP10 TP driver.

config FT5X06_TOUCHPANEL_DRIVER_POP10
	tristate "Focaltech ft5x06 touchpanel driver"
	default n
	help
	  This is the main file for touchpanel driver for Focaltech ft5x06
	  touchscreens.

	  Say Y here if you have a Focaltech ft5x06 touchscreen connected
	  to your system.

	  If unsure, say N.

          To compile this driver as a module, choose M here: the
          module will be called ft5x06_ts.

# [PLATFORM]-Mod-END by weihong.chen.sz
```
