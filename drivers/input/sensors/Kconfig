## drivers/power/idol347/Kconfig
```kconfig
config SMB1360_CHARGER
	tristate "SMB1360 Charger and Fuel Guage"
	depends on I2C
	help
	  Say Y to include support for SMB1360 Charger and Fuel Guage.
	  SMB1360 is a single path switching mode charger capable of charging
	  the battery with 1.5Amps of current. It supports a fuel gauge which
	  uses voltage and coloumb counting for state of charge reporting.
	  The driver reports the status via the power supply framework.
	  A status change triggers an IRQ via the device STAT pin.
config SMB1360_BATTERY_POLICY
	tristate "SMB1360_BATTERY_POLICY temporary control driver"
	depends on SPMI
	depends on OF_SPMI
	help
	  Say Y here to enable the ntc support.
```
