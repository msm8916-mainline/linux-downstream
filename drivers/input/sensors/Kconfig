## drivers/misc/tct_sensor/Kconfig
```kconfig
#
# TCT Sensor driver
#

# [PLATFORM]-Mod-BEGIN by TCTNB.YJ, 2014/04/11, add sensor driver.

config APDS9930_ALSPRX
	tristate "Avago APDS9930 combined als and proximity sensors"
	depends on I2C
	help
	  Say Y here if you want to build a driver for Avago APDS9930
	  combined ambient light and proximity sensor chip.

	  To compile this driver as a module, choose M here: the
	  module will be called apds9950. If unsure, say N here.

config SENSORS_AKM09911_MAG
	tristate "AKM09911 3-axis electronic compass sensor driver"
	depends on I2C
	help
	  Say Y here if you want to enable the akm09911 ecompass sensor
	  driver.

	  To compile this driver as a module, choose M here: the
	  module will be called akm09911.

#
# Makefile for Bosch sensors driver.
#
config SENSORS_BMA2X2
	tristate "BMA255/BMA250E/BMA222E/BMA280 acceleration sensor support"
	depends on I2C
	help
	  If you say yes here, you get support for Bosch Sensortec's
	  acceleration sensors BMA255/BMA250E/BMA222E/BMA280.

config SENSORS_BMA2X2_ENABLE_INT1
	tristate "BMA2X2 acceleration sensor interrupt INT1 support"
#	depends on SENSORS_BMA2X2 && !SENSORS_BMA2X2_ENABLE_INT2
	depends on SENSORS_BMA2X2
	help
	 If you say yes here, you get INT1 support for Bosch Sensortec
	 acceleration sensors BMA255/BMA250E/BMA222E/BMA280.
	 Select it will disable interrupt INT2 support

config SENSORS_BMA2X2_ENABLE_INT2
	tristate "BMA2X2 acceleration sensor interrupt INT2 support"
#	depends on SENSORS_BMA2X2 && !SENSORS_BMA2X2_ENABLE_INT1
	depends on SENSORS_BMA2X2
	help
	 If you say yes here, you get INT2 support for Bosch Sensortec
	 acceleration sensors BMA255/BMA250E/BMA222E/BMA280.
	 Can only open if you do NOT open interrupt INT1 support

config SIG_MOTION
	tristate "support significant motion sensor function"
	depends on SENSORS_BMA2X2  && ( SENSORS_BMA2X2_ENABLE_INT1 || SENSORS_BMA2X2_ENABLE_INT2)
	help
	 If you say yes here, if you want to support Bosch significant motion sensor function

config DOUBLE_TAP
	tristate "support double tap sensor function"
	depends on SENSORS_BMA2X2  && ( SENSORS_BMA2X2_ENABLE_INT1 || SENSORS_BMA2X2_ENABLE_INT2)
	help
	 If you say yes here, you get support Bosch double tap sensor function

config SENSORS_BMI058
	tristate "BMI058 Sensor Support"
	depends on (SENSORS_BMG || SENSORS_BMA2X2)
	help
	 If you say yes here, you get support for Bosch Sensortec's
	 sensor driver of BMI058.

# [PLATFORM]-Mod-END by TCTNB.YJ
```

## drivers/mmc/Kconfig
```kconfig
#
# MMC subsystem configuration
#

menuconfig MMC
	tristate "MMC/SD/SDIO card support"
	depends on HAS_IOMEM
	help
	  This selects MultiMediaCard, Secure Digital and Secure
	  Digital I/O support.

	  If you want MMC/SD/SDIO support, you should say Y here and
	  also to your specific host controller driver.

config MMC_DEBUG
	bool "MMC debugging"
	depends on MMC != n
	help
	  This is an option for use by developers; most people should
	  say N here.  This enables MMC core and driver debugging.

config MMC_PERF_PROFILING
	bool "MMC performance profiling"
	depends on MMC != n
	default n
	help
	  If you say Y here, support will be added for collecting
	  performance numbers at the MMC Queue and Host layers.

# LGE_CHANGE_S : D3-5T-FS@lge.com
config LGE_MMC_RESET_IF_HANG
    bool "MMC Reset if eMMC is hang. "
    default n
    help
        Reset eMMC if eMMC is unaccessible. continously error on r/w cmd.

config LGE_MMC_DYNAMIC_LOG
    bool "MMC debugging - enable logs through adb"
    default n
    help
        If you say Y here, developers can enable/disable mmc logs through adb
        by accessing /sys/module/mmc_core/parameters/debug_level
        ex. echo {debug_level} > /sys/module/mmc_core/parameters/debug_level

config LGE_MMC_DEBUG
    bool "MMC debugging - show eMMC CMD/ARG/RESP in case of eMMC fails"
    default n
    help
        If you say Y here, eMMC command set is holded on RAM (CMD/ARG/RESP) and print it on eMMC fail condition.

config LGE_MMC_PON_SHORT
    bool "Send PON for SYS_RESTART"
    help
        If you say Y here, mmc send PON for SYS_RESTART also.
        There is slight chance of data loss on cache enabled,
        if PON is not send properly.
# LGE_CHANGE_E : D3-5T-FS@lge.com

config LGE_SHOW_SDCARD_DETECT_PIN_STATUS
    bool "Show SD Card Detect pin status"
    default n
    help
        Show SD Card Detect pin status at /sys/devices/soc.0/7864900.sdhci/mmc_host/mmc1/cd_status

config LGE_MMC_BKOPS_ENABLE
    bool "enable BKOPS for eMMC"
    depends on MMC != n
    help
        if you want to use BKOPS for eMMC, you have to set Y in kernel/arch/arm/configs/XXXX_defconfig file.

if MMC

source "drivers/mmc/core/Kconfig"

source "drivers/mmc/card/Kconfig"

source "drivers/mmc/host/Kconfig"

endif # MMC
```

## drivers/nfc/pn547/Kconfig
```kconfig
config NFC_PN547
	tristate "NXP PN547 NFC driver"
	depends on NFC_HCI
	select CRC_CCITT
	default n
	---help---
	  NXP PN547 core driver.
	  This is a driver based on the HCI NFC kernel layers and
	  will thus not work with NXP libnfc library.

	  To compile this driver as a module, choose m here. The module will
	  be called pn544.
	  Say N if unsure.
```
