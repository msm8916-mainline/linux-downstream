## drivers/sensorhub/Kconfig
```kconfig
#
# sensor drivers configuration
#

config SENSORS_SSP_STM_HESTIA
	tristate "Sensors ssp STM"
	default n
	depends on SPI
	help
	  ssp driver for STM sensor hub.
          If you say yes here you get ssp support for
	  sensor hub.
	  To compile this driver as a module, choose M here: the
	  module will be called ssp.

source "drivers/sensorhub/stm_hestia/Kconfig"
```

## drivers/soc/qcom/lge/Kconfig
```kconfig
config MACH_LGE
	bool

menu "LGE Board Selection"


config MACH_MSM8939_ALTEV2_VZW
        bool "MSM8939 ALTEV2_VZW"
        depends on ARCH_MSM8916
        select MACH_LGE
	select LGE_ENABLE_THERMAL_CORE_CONTROL
        help
          Support for the Qualcomm MSM8939 ALTEV2 VZW device.

config MACH_MSM8939_P1BDSN_GLOBAL_COM
        bool "MSM8939 P1BDSN_GLOBAL_COM"
        depends on ARCH_MSM8916
        select MACH_LGE
        select LGE_ENABLE_THERMAL_CORE_CONTROL
        help
          Support for the Qualcomm MSM8939 P1BDSN GLOBAL COM device.

config MACH_MSM8939_P1BSSN_SKT_KR
        bool "MSM8939 P1BSSN_SKT_KR"
        depends on ARCH_MSM8916
        select MACH_LGE
        select LGE_ENABLE_THERMAL_CORE_CONTROL
        help
          Support for the Qualcomm MSM8939 P1BSSN SKT KR device.

endmenu

menu "LGE Specific Patches"

config LGE_BOOTLOADER_LOG
	tristate "Support LGE bootloader log"
	default n
	depends on MACH_LGE
	help
	  LGE bootloader log

config LGE_HANDLE_PANIC
	tristate "Support LGE Kernel Panic Handler"
	default n
	depends on MACH_LGE
	help
	  LGE Error handler

config LGE_BOOTLOADER_TIME_CHECKER
	bool "Show bootloader(LK, SBL) time"
	default n
	depends on MACH_LGE
	help
	  This shows the lk and sbl1 booting time in MSM8974.
	  If this feature is enabled, it should be check by adb shell.
	  Device Node : sys/module/lge_bootloader_time_checker/

config LGE_HANDLE_PANIC
	tristate "Support LGE Kernel Panic Handler"
	default n
	depends on MACH_LGE
	help
	  LGE Crash Handler

config LCD_KCAL
        bool "Enable sysfs for LCD KCAL"
        default n

config PRE_SELF_DIAGNOSIS
	tristate "Support LGE self diagnosis for factory"
	default n
	depends on MACH_LGE
	help
	  LGE self diagnosis

config LGE_ENABLE_THERMAL_CORE_CONTROL
        bool "Thermal Core Control"
        default n
        help
          Enable Thermal Core control to prevent hot temperature (Temporal)

config LGE_QSDL_SUPPORT
    tristate "Support for Quality Statistics Data Logging"
	default n
	depends on MACH_LGE
	help
	  QSDL is a feature which notify infomation for quality statistics data logging of device.

config LGE_KSWITCH
    tristate "Support LGE Kill Switch"
    default n
    depends on MACH_LGE
    help
	  LGE Kill Switch

endmenu

menu "LGE QFPROM Values"

config LGE_QFPROM_INTERFACE
	bool "Support qfprom interface"
	default n
	depends on MACH_LGE
	help
	  LGE QFPROM DRIVER.

config LGE_QFPROM_SECHASH
	string "Support qfprom sec hash"
	default 0x0
	depends on LGE_QFPROM_INTERFACE
	help
	  LGE QFPROM DRIVER-SEC partition's hash value.
endmenu
```

## drivers/soc/vivo/Kconfig
```kconfig
config VIVO_BOARDINFO
        bool "vivo Board information support"
        depends on MSM_SMEM
        help
          enable vivo Board information support on qcom platform
```

## drivers/switch/Kconfig
```kconfig
menuconfig SWITCH
	tristate "Switch class support"
	help
	  Say Y here to enable switch class support. This allows
	  monitoring switches by userspace via sysfs and uevent.

if SWITCH

config SWITCH_GPIO
	tristate "GPIO Swith support"
	depends on GPIOLIB
	help
	  Say Y here to enable GPIO based switch support.
	  
config SWITCH_HALL
	tristate "GPIO Swith support"
	depends on GPIOLIB
	help
	  Say Y here to enable GPIO based switch support.

config BBK_SWITCH_GSENSOR_INT1
	tristate "GPIO Swith gsensor interrupt1"
	depends on GPIOLIB
	help
	  Say Y here to enable GPIO based switch support.

endif # SWITCH
```

## drivers/video/msm/mdss/Kconfig
```kconfig
config FB_MSM_MDSS_WRITEBACK
	bool "MDSS Writeback Panel"
	---help---
	The MDSS Writeback Panel provides support for routing the output of
	MDSS frame buffer driver and MDP processing to memory.

config FB_MSM_MDSS_HDMI_PANEL
	depends on FB_MSM_MDSS
	bool "MDSS HDMI Tx Panel"
	default n
	---help---
	The MDSS HDMI Panel provides support for transmitting TMDS signals of
	MDSS frame buffer data to connected hdmi compliant TVs, monitors etc.

config FB_MSM_MDSS_HDMI_MHL_SII8334
	depends on FB_MSM_MDSS_HDMI_PANEL
	bool 'MHL SII8334 support '
	default n
	---help---
	  Support the HDMI to MHL conversion.
	  MHL (Mobile High-Definition Link) technology
	  uses USB connector to output HDMI content

config FB_MSM_MDSS_DSI_CTRL_STATUS
	tristate "DSI controller status check feature"
	---help---
	  Check DSI controller status periodically (default period is 5
	  seconds) by sending Bus-Turn-Around (BTA) command. If DSI controller
	  fails to acknowledge the BTA command, it sends PANEL_ALIVE=0 status
	  to HAL layer to reset the controller.

config FB_MSM_MDSS_EDP_PANEL
	depends on FB_MSM_MDSS
	bool "MDSS eDP Panel"
	---help---
	The MDSS eDP Panel provides support for eDP host controller driver
	which runs in Video mode only and is responsible for transmitting
	frame buffer from host SOC to eDP display panel.

config FB_MSM_MDSS_MDP3
	depends on FB_MSM_MDSS
	bool "MDP3 display controller"
	---help---
	The MDP3 provides support for an older version display controller
	included in latest display sub-system, known as MDSS.

config LCD_KCAL
        bool "Enable sysfs for LCD KCAL"
        default n
config LGE_BW_CLK_TUNING
	bool "Enable sysfs for MDP Bandwidth and core clock Tuning"
	default n
	---help---
	Tuning AB/IB value and MDP core clock value.
config LGE_LCD_ESD
	bool "Enable a function for report panel dead"
	default n
config LGD_INCELL_VIDEO_WVGA_PT_PANEL
	bool "Enable LGD INCELL panel"
	default n
config LGD_INCELL_VIDEO_FWVGA_PT_PANEL
	bool "Enable LGD INCELL FWVGA panel"
	default n
config LGD_LD083_VIDEO_WUXGA_PT_PANEL
	bool "Enable LGD LD083 WUXGA panel"
	default n
config JDI_INCELL_VIDEO_HD_PANEL
	bool "Enable JDI INCELL panel"
	default n
config LGD_INCELL_PHASE3_VIDEO_HD_PT_PANEL
	bool "Enable LGD INCELL PHASE3 HD panel"
	default n
config LGD_DONGBU_INCELL_VIDEO_HD_PANEL
	bool "Enable LGD DONGBU INCELL HD panel"
	default n
config LGD_M2DONGBU_INCELL_VIDEO_HD_PANEL
	bool "Enable LGD M2DONGBU INCELL HD panel"
	default n
config LGD_PH1DONGBU_INCELL_VIDEO_HD_PANEL
	bool "Enable LGD PH1DONGBU INCELL HD panel"
	default n
config LGE_MIPI_DSI_BYD_ILI9806E_WVGA
	bool "Enable BYD ILI9806E panel"
	default n

config LGD_INCELL_DB7400_VIDEO_HD_DUAL_PANEL
	bool "Enable LGD INCELL DB7400 HD DUAL PANEL"
	select LGE_MODULE_DETECT
	default n
config LGE_DIC_TRIPLE_DETECT
	bool "Enable LGE_DIC_TRIPLE_DETECT"
	default n

config LGE_READER_MODE
	bool "LGE reader mode"
	default n
config LGE_VSYNC_SKIP
	bool "MDSS VSYNC Skip scheme"
	---help---
	This feature provides VSYNC skip scheme.

config LGE_MIPI_DSI_LGD_NT35521_E7II_WXGA
	bool "Enable LGD NT35521 E7II WXGA panel"
	default n

config LGE_MANUAL_FUDGE_FACTOR
	bool "Enable change fudge factor in mdss mdp manually"
	default n

config JDI_INCELL_VIDEO_FHD_PANEL
	bool "Enable JDI FHD INCELL panel"
	default n

config LCD_LGE_IOVCC_EXT_LDO
	bool "Ext IOVCC LDO"
	default n

config LCD_VDD_VDDIO_EXT_LDO
	bool "Ext VDD VDDIO LDO"
	default n
config LGE_DYNAMIC_FPS
	bool "LGE Dynamic FPS feature"
	default n
config LGE_UNDERRUN
	bool "LGE UNDERRUN feature to prevent 8916-user-underrun"
	default n

config LGE_DISPLAY_TUNING
	bool "Enable panel/mipi/backlight tuning"
	select LGE_DISPLAY_COMMON
	default n
	---help---
	Support LCD initial code, mipi clock, and backlight tuning
	Support sysfs

config LGE_DISPLAY_DFPS
	bool "LG Dynamic LCD Refresh Driver"
	select ARCH_HAS_OPP
	select DEVFREQ_GOV_SIMPLE_ONDEMAND
	select LGE_DISPLAY_COMMON
	default n
	---help---
	This adds the DEVFREQ driver for LG display

config LGE_DISPLAY_VSYNC_SKIP
	bool "MDSS VSYNC Skip scheme"
	select LGE_DISPLAY_COMMON
	default n
	---help---
	This feature provides VSYNC skip scheme.

config LGE_DISPLAY_COMMON
	bool "Display Common code"
	default n
	---help---
	This feature provides display common code.

config LGE_DISPLAY_POWER_SEQUENCE
	bool "lge panel power sequence"
	default n
	---help---
	Support panel power sequence

config LGE_DISPLAY_CODE_REFACTORING
	bool "Enable mdss code refactoring"
	default n

config LGE_DISPLAY_AOD_SUPPORT
    bool "Enable always on display"
    default n
    ---help---
    if you say yes here you get support for the 'Always On Display'
config LGE_DISPLAY_DSI_CMD_HS_DISABLE
	bool "Disable mipi cmd in hs mode"
	default n
```

## sound/soc/vivo/Kconfig
```kconfig
config VIVO_REGDUMP
	bool "vivo audio register dump enable"

config SND_HIFI_CODEC_PD1524
    bool "Enable HIFI codec for PD1524"
    help
        To add support for SoC audio on HIFI codec for PD1524.
		
config SND_TLV320ADC3001_COMMON
	bool "Enable TLV320ADC3001 common"
	help
		To add support for SoC audio on TLV320ADC3001.

config SND_ES9018_COMMON
	bool "Enable ES9018 common"
	help
		To add support for SoC audio on ES9018.

config SND_CS4398_COMMON
	bool "Enable CS4398 common"
	help
		To add support for SoC audio on CS4398.

config SND_MACH5_COMMON
	depends on SPI
	bool "Enable YSS205X(MACH-5) common"
	help
		To add support for SoC audio on MACH-5 for KTV.

config SND_AK4375_COMMON
	bool "Enable AK437 common"
	help
		To add support for SoC audio on AK437.	

config SND_ES9028_COMMON
	bool "Enable ES9028 common"
	help
		To add support for SoC audio on ES9028.
```
