## arch/arm/mach-msm/product_list/Kconfig
```kconfig
#
#     date      	author      	why
#  2015.01.10     litao2		add y560 product
#  2015.3.10      liumx         add 860 product

#
# YEP_product_list
#  
#========================================================
config QW620_BASE
	depends on ARCH_MSM8909
	bool "QW620_BASE version"
	help
	  Fix version type as QW620_BASE.
#========================================================
#========================================================
config QL620_BASE
        depends on ARCH_MSM8909
        bool "QL620_BASE version"
        help
          Fix version type as QL620_BASE.
#========================================================
```

## drivers/broadcast/Kconfig
```kconfig
# LGE Broadcast Device Driver Support

menu "LGE Broadcast Device Support"

config LGE_BROADCAST_TDMB
    bool "LGE broadcast TDMB device Driver"
    depends on (ARCH_MSM8916 || ARCH_MSM8917 || ARCH_MSM8992 || ARCH_MSM8996)
    default n
    help
      Select this if you want to use TDMB broadcast service

source "drivers/broadcast/tdmb/Kconfig"
endmenu
```

## drivers/broadcast/tdmb/Kconfig
```kconfig
#menu "BROADCAST_DEVICE"

#
# Broadcast Device Driver Support
#

#menu "BROADCAST_DEVICE"

config LGE_BROADCAST_TDMB_FC8080
    bool "LGE broacast TDMB FC8080 device"
    depends on (LGE_BROADCAST_TDMB && MACH_MSM8916_YG_SKT_KR) || (LGE_BROADCAST_TDMB && MACH_MSM8939_P1BSSN_SKT_KR) || (LGE_BROADCAST_TDMB && MACH_MSM8916_C100N_KR) || (LGE_BROADCAST_TDMB && MACH_MSM8916_PH1_KR) || (LGE_BROADCAST_TDMB && MACH_MSM8916_PH1_GLOBAL_COM)  || (LGE_BROADCAST_TDMB && MACH_MSM8916_K5_KR)
    default y
    help
      Select this if you want to use broadcast service

config LGE_BROADCAST_TDMB_MTV319
	bool "LGE broacast TDMB MTV319 device"
	depends on (LGE_BROADCAST_TDMB && MACH_MSM8916_YG_SKT_KR)
	default y
	help
	  Select this if you want to use broadcast service
#endmenu
```

## drivers/broadcast/tdmb/mtv319/src/Kconfig
```kconfig
#
# MTV319_DEVICE subsystem configuration
#

#menu "MTV319 support"

config MTV319_TDMB
	default n
	---help---
	  This driver implements the front-end of the Xen virtual
	  keyboard and mouse device driver.  It communicates with a back-end
	  in another domain.
  
#endmenu
```

## drivers/char/diag/Kconfig
```kconfig
menu "Diag Support"

config DIAG_CHAR
	tristate "char driver interface and diag forwarding to/from modem"
	default m
	depends on USB_G_ANDROID || USB_FUNCTION_DIAG || USB_QCOM_MAEMO
	depends on ARCH_MSM
	select CRC_CCITT
	help
	 Char driver interface for diag user space and diag-forwarding to modem ARM and back.
	 This enables diagchar for maemo usb gadget or android usb gadget based on config selected.
endmenu

menu "DIAG traffic over USB"

config DIAG_OVER_USB
	bool "Enable DIAG traffic to go over USB"
        depends on ARCH_MSM
	default y
	help
	 This feature helps segregate code required for DIAG traffic to go over USB.
endmenu

menu "HSIC/SMUX support for DIAG"

config DIAGFWD_BRIDGE_CODE
	depends on USB_QCOM_DIAG_BRIDGE
	default y
	bool "Enable QSC/9K DIAG traffic over SMUX/HSIC"
	help
	 SMUX/HSIC Transport Layer for DIAG Router
endmenu
menu "LGE Diag Enable for TRF"

config LGE_DIAG_ENABLE
    bool "LGE Diag Enable for TRF"
    default n
	help
     LGE Diag Enable for TRF
endmenu

menu "LGE Diag Enable for SPR"

config LGE_DIAG_USB_ACCESS_LOCK
	bool "feature for usb diag access lock"
	default n
	help
	 this feature should be applied to meet usb diag lock requirement
config LGE_DIAG_ENABLE_SYSFS
	bool "provide diag enable sysfs for user space"
	default n
	help
	 diag enable sysfs value can define diag enable or disable
endmenu

menu "LGE DM APP Support"

config LGE_DM_APP
	bool "LGE DM APP Support"
	default n
	depends on MACH_LGE
	help
	 LGE DM APP Support
endmenu

menu "LGE DIAG BYPASS Support"
config LGE_DIAG_BYPASS
    tristate "Support LGE diag bypass for factory"
    default n
    depends on MACH_LGE
    help
      LGE diag bypass
endmenu
```

## drivers/dts_eagle/Kconfig
```kconfig
config DTS_EAGLE
	tristate "DTS Eagle driver"
	depends on ARM64
	default n if ARM64
	help
	  DTS Eagle module.
```

## drivers/fingerprint/Kconfig
```kconfig
menu "BBK FINGERPRINT support"
config BBK_FINGERPRINT
	tristate "BBK FINGERPRINT support"
	help
	  Say Y here to enable switch class support. This allows
	  monitoring switches by userspace via sysfs and uevent.

if BBK_FINGERPRINT
	  
config BBK_FP_ID
	tristate "FPC OEM fingerprint FPC1022 support"
	help
	  there is nothing for help!  
endif
source "drivers/fingerprint/fpc1022/Kconfig"
source "drivers/fingerprint/gf3208/Kconfig"
endmenu
```

## drivers/fingerprint/fpc1022/Kconfig
```kconfig
config BBK_FPC1022
	tristate "FPC OEM fingerprint FPC1022 support"
	help
	  there is nothing for help!
```

## drivers/fingerprint/gf318/Kconfig
```kconfig
config BBK_GOODIX318
	tristate "Goodix OEM fingerprint drvier support"
	help
	  Say Y here to enable goodix fingerprint driver support!
```

## drivers/fingerprint/gf3208/Kconfig
```kconfig
config BBK_GOODIX3208
	tristate "Goodix OEM fingerprint drvier support"
	help
	  Say Y here to enable goodix fingerprint driver support!
```

## drivers/input/notify/Kconfig
```kconfig
config CHARGER_NOTIFY
	bool "enable charger plug in notify"
	help
	  Say Y here if you want to enable charger plug in notify.
	  
config HALL_NOTIFY
	bool "enable hall sensor notify"
	help
	  Say Y here if you want to enable hall sensor notify.
	  
config PROX_NOTIFY
	bool "enable prox sensor notify"
	help
	  Say Y here if you want to enable prox sensor notify.
```

## drivers/input/sensor/Kconfig
```kconfig
#
# Input misc drivers configuration
#
menuconfig INPUT_SENSOR
	bool "Sensor devices"
	help
	  Say Y here, and a list of Sensor input drivers will be displayed.
	  Everything that didn't fit into the other categories is here. This option
	  doesn't affect the kernel.

	  If unsure, say Y.

if INPUT_SENSOR

config SENSOR_APDS9130
	bool "APDS 9130 support"
	depends on I2C
	help
	  Support APDS-9130 as an input device.

config SENSOR_RPR0521
	bool "RPR 0521 support"
	depends on I2C
	help
	  Support RPR-0521 as an input device.

config SENSOR_APDS9930_ALS_ENABLE
	bool "APDS 9930 als enable support"
	depends on I2C
	help
	  Support APDS-9930 ALS ENABLE as an input device.

config SENSOR_K2DH
        bool "K2DH support"
        depends on I2C
        help
          Support ST Micro Accel Sensor K2DH as an input device.

config SENSORS_K2HH
        bool "K2HH support"
        depends on I2C
        help
          Support ST Micro Accel Sensor K2HH as an input device.

config SENSOR_AK09911
        bool "AK09911 support"
        depends on I2C
        help
          Support AK09911 as an input device.

config SENSORS_BMC150_COMMON
	bool
	default n

config SENSORS_BMC150
	tristate "BMC150 acceleration and magnetic sensor support"
	depends on I2C=y
	select SENSORS_BMC150_COMMON
	help
	  If you say yes here you get support for Bosch Sensortec's
	  acceleration sensors BMA255/BMA250E/BMA222E/BMA280.

config SENSOR_SX9500
    tristate "SX9500 based capacitive touch button"
    depends on I2C
    help
      Say Y here if you have a SX9500.
      If unsure, say N.

      To compile this driver as a module, choose M here: the
      module will be called sx8651.

config SENSOR_ATMF04
       bool "ATMF04 support"
       depends on I2C
       help
         Support ATMF04 as an input device.
config SENSORS_K303C
	tristate "STM K303C 6axis axl+mag sensor support"
	depends on I2C=y
	help
	  If you say yes here you get support for STMicroelectronics's
	  acceleration sesnsors K303C.

#
# Makefile for Bosch sensors driver.
#
config SENSORS_BMI160
	tristate "BMI160 Sensor Support"
		depends on I2C || SPI_MASTER
			help
				 If you say yes here, you get support for Bosch Sensortec's
					 sensor driver of BMI160.

config SENSORS_BMI160_I2C
	tristate "support I2C bus communication"
	depends on SENSORS_BMI160 && I2C
	help
	 If you say yes here, you get support Bosch Sensortec's BMI160 sensor hooked to an I2C bus.

config BMI160_MAG_INTERFACE_SUPPORT
tristate "BMI160 Sensor mag interface support"
depends on SENSORS_BMI160
	help
	 If you say yes here, you get support for Bosch Sensortec's
	 sensor driver of BMI160 with mag sensor support.

config SENSORS_BMI160_ENABLE_INT1
tristate "BMI160 sensor interrupt INT1 support"
depends on SENSORS_BMI160
	help
	 If you say yes here, you get INT1 support for Bosch Sensortec
	 sensors BMI160.

config SENSORS_BMI160_ENABLE_INT2
tristate "BMI160 sensor interrupt INT2 support"
depends on SENSORS_BMI160
	help
	 If you say yes here, you get INT2 support for Bosch Sensortec
	 sensors BMI160.

config SENSOR_AK09911_DRIVER
        bool "AK09911 support"
        depends on I2C
        help
          Support AK09911 in BMI160 Driver as an input device.
endif
```
