## arch/arm/configs/ph1_kt_kr_defconfig
```kconfig
CONFIG_AEABI=y
CONFIG_ALLOC_BUFFERS_IN_4K_CHUNKS=y
CONFIG_ANDROID_BINDER_IPC=y
CONFIG_ANDROID_INTF_ALARM_DEV=y
CONFIG_ANDROID_LOW_MEMORY_KILLER=y
CONFIG_ANDROID_TIMED_GPIO=y
CONFIG_ANDROID=y
CONFIG_APDS9930_ALS_INT=y
CONFIG_APDS9930_BMCHAL=y
CONFIG_APDS9930_DEBUG_BMCHAL=y
CONFIG_ARCH_MSM=y
CONFIG_ARCH_MSM8916=y
CONFIG_ARM_DECOMPRESSOR_LIMIT=0x3200000
CONFIG_ASHMEM=y
CONFIG_AUDIT=y
CONFIG_AUTO_ZRELADDR=y
CONFIG_BACKLIGHT_CLASS_DEVICE=y
CONFIG_BACKLIGHT_LCD_SUPPORT=y
CONFIG_BACKLIGHT_LM3632=y
CONFIG_BALANCE_ANON_FILE_RECLAIM=y
CONFIG_BATTERY_BCL=y
CONFIG_BLK_DEV_DM=y
CONFIG_BLK_DEV_INITRD=y
CONFIG_BLK_DEV_LOOP=y
CONFIG_BLK_DEV_RAM=y
CONFIG_BLK_DEV_SD=y
CONFIG_BOOTPARAM_SOFTLOCKUP_PANIC=y
CONFIG_BRIDGE_EBT_BROUTE=y
CONFIG_BRIDGE_NF_EBTABLES=y
CONFIG_BRIDGE=y
CONFIG_BT_BNEP_MC_FILTER=y
CONFIG_BT_BNEP_PROTO_FILTER=y
CONFIG_BT_BNEP=y
CONFIG_BT_HIDP=y
CONFIG_BT_RFCOMM_TTY=y
CONFIG_BT_RFCOMM=y
CONFIG_BT=y
CONFIG_BUS_TOPOLOGY_ADHOC=y
CONFIG_CC_OPTIMIZE_FOR_SIZE=y
CONFIG_CC_STACKPROTECTOR_REGULAR=y
CONFIG_CFG80211_ALLOW_RECONNECT=y
CONFIG_CFG80211_INTERNAL_REGDB=y
CONFIG_CFG80211=y
CONFIG_CGROUP_CPUACCT=y
CONFIG_CGROUP_DEBUG=y
CONFIG_CGROUP_FREEZER=y
CONFIG_CGROUP_SCHED=y
CONFIG_CGROUPS=y
CONFIG_CHECK_SYNC_TIME=y
CONFIG_CHR_DEV_SCH=y
CONFIG_CHR_DEV_SG=y
CONFIG_CLS_U32_MARK=y
CONFIG_CMA_SIZE_MBYTES=8
CONFIG_CMA=y
CONFIG_CP_ACCESS=y
CONFIG_CPU_FREQ_GOV_INTERACTIVE=y
CONFIG_CPU_FREQ_GOV_ONDEMAND=y
CONFIG_CPU_FREQ_GOV_POWERSAVE=y
CONFIG_CPU_FREQ_GOV_USERSPACE=y
CONFIG_CPU_HAS_L2_PMU=y
CONFIG_CPU_IDLE_MULTIPLE_DRIVERS=y
CONFIG_CPU_IDLE=y
CONFIG_CRYPTO_ARC4=y
CONFIG_CRYPTO_CTR=y
CONFIG_CRYPTO_DEV_QCE=y
CONFIG_CRYPTO_DEV_QCEDEV=y
CONFIG_CRYPTO_DEV_QCRYPTO=y
CONFIG_CRYPTO_MD4=y
CONFIG_CRYPTO_NULL=y
CONFIG_CRYPTO_TWOFISH=y
CONFIG_CRYPTO_XCBC=y
CONFIG_CRYPTO_XTS=y
CONFIG_CRYPTO=y
CONFIG_DEBUG_ATOMIC_SLEEP=y
CONFIG_DEBUG_GPIO=y
CONFIG_DEBUG_INFO=y
CONFIG_DEBUG_KMEMLEAK_DEFAULT_OFF=y
CONFIG_DEBUG_KMEMLEAK_EARLY_LOG_SIZE=4000
CONFIG_DEBUG_KMEMLEAK=y
CONFIG_DEBUG_LIST=y
CONFIG_DEBUG_MEMORY_INIT=y
CONFIG_DEBUG_MUTEXES=y
CONFIG_DEBUG_PAGEALLOC=y
CONFIG_DEBUG_SET_MODULE_RONX=y
CONFIG_DEBUG_SPINLOCK=y
CONFIG_DEBUG_STACK_USAGE=y
CONFIG_DIAG_CHAR=y
CONFIG_DM_CRYPT=y
CONFIG_DM_REQ_CRYPT=y
CONFIG_DM_VERITY=y
CONFIG_DMADEVICES=y
CONFIG_DUMMY=y
CONFIG_DYNAMIC_DEBUG=y
CONFIG_ECRYPT_FS_MESSAGING=y
CONFIG_ECRYPT_FS=y
CONFIG_EMBEDDED=y
CONFIG_ENABLE_VMALLOC_SAVING=y
CONFIG_ENCRYPTED_KEYS=y
CONFIG_EXFAT_FS=m
CONFIG_EXT4_FS_SECURITY=y
CONFIG_EXT4_FS=y
CONFIG_FAIL_PAGE_ALLOC=y
CONFIG_FAULT_INJECTION_DEBUG_FS=y
CONFIG_FAULT_INJECTION_STACKTRACE_FILTER=y
CONFIG_FAULT_INJECTION=y
CONFIG_FB_MSM_MDSS_WRITEBACK=y
CONFIG_FB_MSM_MDSS=y
CONFIG_FB_MSM=y
CONFIG_FB_VIRTUAL=y
CONFIG_FB=y
CONFIG_FORCE_INSTRUCTION_ALIGNMENT=y
CONFIG_FREE_PAGES_RDONLY=y
CONFIG_FUSE_FS=y
CONFIG_GPIO_QPNP_PIN=y
CONFIG_GPIO_SYSFS=y
CONFIG_HAS_DMA=y
CONFIG_HAVE_ARCH_SECCOMP_FILTER=y
CONFIG_HI553_FF=y
CONFIG_HID=y
CONFIG_HIGH_RES_TIMERS=y
CONFIG_HIGHMEM=y
CONFIG_HW_RANDOM_MSM=y
CONFIG_HW_RANDOM=y
CONFIG_I2C_CHARDEV=y
CONFIG_I2C_MSM_V2=y
CONFIG_I2C=y
CONFIG_IKCONFIG=y
CONFIG_INET_AH=y
CONFIG_INET_ESP=y
CONFIG_INET_IPCOMP=y
CONFIG_INET_TUNNEL=y
CONFIG_INET_XFRM_MODE_BEET=y
CONFIG_INET_XFRM_MODE_TRANSPORT=y
CONFIG_INET_XFRM_MODE_TUNNEL=y
CONFIG_INET_XFRM_TUNNEL=y
CONFIG_INET=y
CONFIG_INET6_AH=y
CONFIG_INET6_ESP=y
CONFIG_INET6_IPCOMP=y
CONFIG_INET6_XFRM_MODE_BEET=y
CONFIG_INET6_XFRM_MODE_TRANSPORT=y
CONFIG_INET6_XFRM_MODE_TUNNEL=y
CONFIG_INET6_XFRM_TUNNEL=y
CONFIG_INPUT_EVBUG=m
CONFIG_INPUT_EVDEV=y
CONFIG_INPUT_GPIO=m
CONFIG_INPUT_JOYSTICK=y
CONFIG_INPUT_MISC=y
CONFIG_INPUT_SENSOR=y
CONFIG_INPUT_TOUCHSCREEN=y
CONFIG_INPUT_UINPUT=y
CONFIG_ION_MSM=y
CONFIG_ION=y
CONFIG_IP_ADVANCED_ROUTER=y
CONFIG_IP_MULTICAST=y
CONFIG_IP_MULTIPLE_TABLES=y
CONFIG_IP_NF_ARP_MANGLE=y
CONFIG_IP_NF_ARPFILTER=y
CONFIG_IP_NF_ARPTABLES=y
CONFIG_IP_NF_FILTER=y
CONFIG_IP_NF_IPTABLES=y
CONFIG_IP_NF_MANGLE=y
CONFIG_IP_NF_MATCH_AH=y
CONFIG_IP_NF_MATCH_ECN=y
CONFIG_IP_NF_MATCH_TTL=y
CONFIG_IP_NF_RAW=y
CONFIG_IP_NF_TARGET_MASQUERADE=y
CONFIG_IP_NF_TARGET_NETMAP=y
CONFIG_IP_NF_TARGET_REDIRECT=y
CONFIG_IP_NF_TARGET_REJECT=y
CONFIG_IP_PNP_DHCP=y
CONFIG_IP_PNP=y
CONFIG_IP_ROUTE_VERBOSE=y
CONFIG_IP6_NF_FILTER=y
CONFIG_IP6_NF_IPTABLES=y
CONFIG_IP6_NF_MANGLE=y
CONFIG_IP6_NF_RAW=y
CONFIG_IP6_NF_TARGET_LOG=y
CONFIG_IP6_NF_TARGET_REJECT=y
CONFIG_IPC_LOGGING=y
CONFIG_IPC_ROUTER_SECURITY=y
CONFIG_IPC_ROUTER=y
CONFIG_IPV6_MIP6=y
CONFIG_IPV6_MULTIPLE_TABLES=y
CONFIG_IPV6_OPTIMISTIC_DAD=y
CONFIG_IPV6_PRIVACY=y
CONFIG_IPV6_ROUTE_INFO=y
CONFIG_IPV6_ROUTER_PREF=y
CONFIG_IPV6_SUBTREES=y
CONFIG_IPV6=y
CONFIG_JOYSTICK_XPAD=y
CONFIG_KALLSYMS_ALL=y
CONFIG_KEYBOARD_GPIO=y
CONFIG_KEYS=y
CONFIG_KEYS=y
CONFIG_KGSL_PER_PROCESS_PAGE_TABLE=y
CONFIG_KS8851=y
CONFIG_L2TP_DEBUGFS=y
CONFIG_L2TP_ETH=y
CONFIG_L2TP_IP=y
CONFIG_L2TP_V3=y
CONFIG_L2TP=y
CONFIG_LEDS_GPIO=y
CONFIG_LEDS_PM8916=y
CONFIG_LEDS_QPNP=y
CONFIG_LGD_PH1DONGBU_INCELL_VIDEO_HD_PANEL=y
CONFIG_LGE_READER_MODE=y
CONFIG_LGE_BOOTLOADER_LOG=y
CONFIG_LGE_BOOTLOADER_TIME_CHECKER=y
CONFIG_LGE_DIAG_BYPASS=y
CONFIG_LGE_DIC_TRIPLE_DETECT=y
CONFIG_LGE_DISPLAY_DFPS=y
CONFIG_LGE_DISPLAY_POWER_SEQUENCE=y
CONFIG_LGE_DISPLAY_TUNING=y
CONFIG_LGE_DISPLAY_VSYNC_SKIP=y
CONFIG_LGE_DM_APP=y
CONFIG_LGE_ENABLE_THERMAL_CORE_CONTROL=y
CONFIG_LGE_EVENT_LOCK=y
CONFIG_LGE_HANDLE_PANIC=y
CONFIG_LGE_KGSL_OFFSET_SEARCH=y
CONFIG_LGE_LCD_ESD=y
CONFIG_LGE_MANUAL_FUDGE_FACTOR=y
CONFIG_LGE_MMC_DEBUG=y
CONFIG_LGE_MMC_DYNAMIC_LOG=y
CONFIG_LGE_MMC_RESET_IF_HANG=y
CONFIG_LGE_MMC_BKOPS_ENABLE=y
CONFIG_LGE_MMC_PON_SHORT=y
CONFIG_LGE_PH1_CAMERA=y
CONFIG_LGE_PM_BATTERY_EXTERNAL_FUELGAUGE=y
CONFIG_LGE_PM_BATTERY_ID_CHECKER=y
CONFIG_LGE_PM_BATTERY_RT9428_4P4V_USED=y
CONFIG_LGE_PM_BATTERY_RT9428_BL45B1F_3000mAh=y
CONFIG_LGE_PM_BATTERY_RT9428_FUELGAUGE=y
CONFIG_LGE_PM_BATTERY_RT9428_RESET_RECOVER=y
CONFIG_LGE_PM_CHARGER_TEMP_SCENARIO_COMMON=y
CONFIG_LGE_PM_CHARGING_BQ24262_CHARGER=y
CONFIG_LGE_PM_CHARGING_SAFETY_TIMER=y
CONFIG_LGE_PM_CHARGING_TEMP_SCENARIO=y
CONFIG_LGE_PM_CONTROL_TSENS_CRITICAL_TEMPERATURE=y
CONFIG_LGE_PM_DEBUG_CHECK_LOG=y
CONFIG_LGE_PM_FACTORY_TESTMODE=y
CONFIG_LGE_PM_IRQ_NOT_WORKGROUND=y
CONFIG_LGE_PM_MPP_LED_SINK=y
CONFIG_LGE_PM_PSEUDO_BATTERY=y
CONFIG_LGE_PM_SMPL_COUNT=y
CONFIG_LGE_PM_UNIFIED_NODE=y
CONFIG_LGE_PM=y
CONFIG_LGE_QFPROM_INTERFACE=y
CONFIG_LGE_QFPROM_SECHASH="fabffa2474319250cf910f4da0f6eba6e82cc06f58572ab638d7fccfc785823a"
CONFIG_LGE_REINIT_SDCARD_FOR_DETECT_FAIL=y
CONFIG_LGE_RTC_FAKE_SECS=y
CONFIG_LGE_SENSOR_UNIFIED_NODE=y
CONFIG_LGE_UNDERRUN=y
CONFIG_LGE_USB_DIAG_LOCK=y
CONFIG_LGE_USB_G_ANDROID_PFSC=y
CONFIG_LGE_USB_G_ANDROID=y
CONFIG_LGE_USB_G_AUTORUN_LGE=y
CONFIG_LGE_USB_G_AUTORUN=y
CONFIG_LGE_USB_G_CDROM_MAC_SUPPORT=y
CONFIG_LGE_USB_G_MULTIPLE_CONFIGURATION=y
CONFIG_LGE_USE_6GBIT_CS_N_SDRAM=y
CONFIG_LGE_USE_DEFAULT_HARD_RESET=y
CONFIG_LGP_DATA_BUGFIX_IPV6_ADDRCONF_KERNEL_CRASH=y
CONFIG_LGP_DATA_TCPIP_SLAAC_IPV6_ALLOCATION_BOOSTER=y
CONFIG_LOCKUP_DETECTOR=y
CONFIG_LSM_MMAP_MIN_ADDR=4096
CONFIG_MACH_LGE=y
CONFIG_MACH_MSM8916_PH1_KR=y
CONFIG_MACH_MSM8916_PH1_KT_KR=y
CONFIG_MACH_MSM8916_PH1=y
CONFIG_MAGIC_SYSRQ=y
CONFIG_MD=y
CONFIG_MEDIA_CAMERA_SUPPORT=y
CONFIG_MEDIA_CONTROLLER=y
CONFIG_MEDIA_RADIO_SUPPORT=y
CONFIG_MEDIA_SUPPORT=y
CONFIG_MEM_SHARE_QMI_SERVICE=y
CONFIG_MMC_BLOCK_MINORS=32
CONFIG_MMC_BLOCK_TEST=m
CONFIG_MMC_CLKGATE=y
CONFIG_MMC_EMBEDDED_SDIO=y
CONFIG_MMC_PARANOID_SD_INIT=y
CONFIG_MMC_PERF_PROFILING=y
CONFIG_MMC_SDHCI_MSM=y
CONFIG_MMC_SDHCI_PLTFM=y
CONFIG_MMC_SDHCI=y
CONFIG_MMC_TEST=m
CONFIG_MMC_UNSAFE_RESUME=y
CONFIG_MMC=y
CONFIG_MN34153=y
CONFIG_MOBICORE_API=m
CONFIG_MOBICORE_SUPPORT=m
CONFIG_MODULE_FORCE_UNLOAD=y
CONFIG_MODULE_SIG_FORCE=y
CONFIG_MODULE_SIG_SHA512=y
CONFIG_MODULE_SIG=y
CONFIG_MODULE_UNLOAD=y
CONFIG_MODULES=y
CONFIG_MODVERSIONS=y
CONFIG_MSM_ADSP_LOADER=y
CONFIG_MSM_AVTIMER=y
CONFIG_MSM_BAM_DMUX=y
CONFIG_MSM_BOOT_STATS=y
CONFIG_MSM_BUS_SCALING=y
# CONFIG_MSM_BUSPM_DEV is not set
CONFIG_MSM_CAMERA_SENSOR=y
CONFIG_MSM_CCI=y
CONFIG_MSM_COMMON_LOG=y
CONFIG_MSM_CPP=y
CONFIG_MSM_CSI30_HEADER=y
CONFIG_MSM_CSID=y
CONFIG_MSM_CSIPHY=y
CONFIG_MSM_DIRECT_SCLK_ACCESS=y
CONFIG_MSM_DLOAD_MODE=y
CONFIG_MSM_EEPROM=y
CONFIG_MSM_ENABLE_WDOG_DEBUG_CONTROL=y
CONFIG_MSM_FORCE_WDOG_BITE_ON_PANIC=y
CONFIG_MSM_IOMMU_V1=y
CONFIG_MSM_IPC_ROUTER_SMD_XPRT=y
CONFIG_MSM_ISPIF=y
CONFIG_MSM_KGSL=y
CONFIG_MSM_L2_SPM=y
CONFIG_MSM_MDSS_PLL=y
CONFIG_MSM_MEMORY_DUMP_V2=y
CONFIG_MSM_OTP=y
CONFIG_MSM_PERFORMANCE=y
CONFIG_MSM_PIL_MSS_QDSP6V5=y
CONFIG_MSM_PIL_PRONTO=y
CONFIG_MSM_PIL_SSR_GENERIC=y
CONFIG_MSM_PIL=y
CONFIG_MSM_QMI_INTERFACE=y
CONFIG_MSM_QPNP_INT=y
CONFIG_MSM_RMNET_BAM=y
CONFIG_MSM_RTB_SEPARATE_CPUS=y
CONFIG_MSM_RTB=y
CONFIG_MSM_SCM=y
CONFIG_MSM_SMCMOD=y
CONFIG_MSM_SMD_DEBUG=y
CONFIG_MSM_SMD_PKT=y
CONFIG_MSM_SMD=y
CONFIG_MSM_SMEM_LOGGING=y
CONFIG_MSM_SMEM=y
CONFIG_MSM_SMP2P_TEST=y
CONFIG_MSM_SMP2P=y
CONFIG_MSM_SPM=y
CONFIG_MSM_SUBSYSTEM_RESTART=y
CONFIG_MSM_SYSMON_COMM=y
CONFIG_MSM_TZ_LOG=y
CONFIG_MSM_VIDC_V4L2=y
CONFIG_MSM_WATCHDOG_V2=y
CONFIG_MSM_XPU_ERR_FATAL=y
CONFIG_MSMB_CAMERA=y
CONFIG_MSMB_JPEG=y
CONFIG_NAMESPACES=y
CONFIG_NEON=y
CONFIG_NET_CLS_ACT=y
CONFIG_NET_CLS_FLOW=y
CONFIG_NET_CLS_FW=y
CONFIG_NET_CLS_POLICE=y
CONFIG_NET_CLS_U32=y
CONFIG_NET_CLS=y
CONFIG_NET_EMATCH_U32=y
CONFIG_NET_EMATCH=y
CONFIG_NET_KEY_MIGRATE=y
CONFIG_NET_KEY=y
CONFIG_NET_SCH_CBQ=y
CONFIG_NET_SCH_CHOKE=y
CONFIG_NET_SCH_DRR=y
CONFIG_NET_SCH_DSMARK=y
CONFIG_NET_SCH_FIFO=y
CONFIG_NET_SCH_GRED=y
CONFIG_NET_SCH_HFSC=y
CONFIG_NET_SCH_HTB=y
CONFIG_NET_SCH_INGRESS=y
CONFIG_NET_SCH_MQPRIO=y
CONFIG_NET_SCH_MULTIQ=y
CONFIG_NET_SCH_NETEM=y
CONFIG_NET_SCH_PRIO=y
CONFIG_NET_SCH_QFQ=y
CONFIG_NET_SCH_RED=y
CONFIG_NET_SCH_SFB=y
CONFIG_NET_SCH_SFQ=y
CONFIG_NET_SCH_TBF=y
CONFIG_NET_SCH_TEQL=y
CONFIG_NET_SCHED=y
CONFIG_NET=y
CONFIG_NETDEVICES=y
CONFIG_NETFILTER_ADVANCED=y
CONFIG_NETFILTER_NETLINK_LOG=y
CONFIG_NETFILTER_TPROXY=y
CONFIG_NETFILTER_XT_MATCH_COMMENT=y
CONFIG_NETFILTER_XT_MATCH_CONNBYTES=y
CONFIG_NETFILTER_XT_MATCH_CONNLIMIT=y
CONFIG_NETFILTER_XT_MATCH_CONNMARK=y
CONFIG_NETFILTER_XT_MATCH_CONNTRACK=y
CONFIG_NETFILTER_XT_MATCH_ESP=y
CONFIG_NETFILTER_XT_MATCH_HASHLIMIT=y
CONFIG_NETFILTER_XT_MATCH_HELPER=y
CONFIG_NETFILTER_XT_MATCH_IPRANGE=y
CONFIG_NETFILTER_XT_MATCH_LENGTH=y
CONFIG_NETFILTER_XT_MATCH_LIMIT=y
CONFIG_NETFILTER_XT_MATCH_MAC=y
CONFIG_NETFILTER_XT_MATCH_MARK=y
CONFIG_NETFILTER_XT_MATCH_MULTIPORT=y
CONFIG_NETFILTER_XT_MATCH_PKTTYPE=y
CONFIG_NETFILTER_XT_MATCH_POLICY=y
CONFIG_NETFILTER_XT_MATCH_QTAGUID=y
CONFIG_NETFILTER_XT_MATCH_QUOTA=y
CONFIG_NETFILTER_XT_MATCH_QUOTA2_LOG=y
CONFIG_NETFILTER_XT_MATCH_QUOTA2=y
CONFIG_NETFILTER_XT_MATCH_SOCKET=y
CONFIG_NETFILTER_XT_MATCH_STATE=y
CONFIG_NETFILTER_XT_MATCH_STATISTIC=y
CONFIG_NETFILTER_XT_MATCH_STRING=y
CONFIG_NETFILTER_XT_MATCH_TCPMSS=y
CONFIG_NETFILTER_XT_MATCH_TIME=y
CONFIG_NETFILTER_XT_MATCH_U32=y
CONFIG_NETFILTER_XT_TARGET_CLASSIFY=y
CONFIG_NETFILTER_XT_TARGET_CONNMARK=y
CONFIG_NETFILTER_XT_TARGET_CONNSECMARK=y
CONFIG_NETFILTER_XT_TARGET_HARDIDLETIMER=y
CONFIG_NETFILTER_XT_TARGET_IDLETIMER=y
CONFIG_NETFILTER_XT_TARGET_MARK=y
CONFIG_NETFILTER_XT_TARGET_NFLOG=y
CONFIG_NETFILTER_XT_TARGET_NFQUEUE=y
CONFIG_NETFILTER_XT_TARGET_SECMARK=y
CONFIG_NETFILTER_XT_TARGET_TCPMSS=y
CONFIG_NETFILTER_XT_TARGET_TPROXY=y
CONFIG_NETFILTER_XT_TARGET_TRACE=y
CONFIG_NETFILTER=y
CONFIG_NF_CONNTRACK_AMANDA=y
CONFIG_NF_CONNTRACK_EVENTS=y
CONFIG_NF_CONNTRACK_FTP=y
CONFIG_NF_CONNTRACK_H323=y
CONFIG_NF_CONNTRACK_IPV4=y
CONFIG_NF_CONNTRACK_IPV6=y
CONFIG_NF_CONNTRACK_IRC=y
CONFIG_NF_CONNTRACK_NETBIOS_NS=y
CONFIG_NF_CONNTRACK_PPTP=y
CONFIG_NF_CONNTRACK_SANE=y
CONFIG_NF_CONNTRACK_SECMARK=y
CONFIG_NF_CONNTRACK_TFTP=y
CONFIG_NF_CONNTRACK_TIMEOUT=y
CONFIG_NF_CONNTRACK_TIMESTAMP=y
CONFIG_NF_CONNTRACK=y
CONFIG_NF_CT_NETLINK=y
CONFIG_NF_CT_PROTO_DCCP=y
CONFIG_NF_CT_PROTO_SCTP=y
CONFIG_NF_CT_PROTO_UDPLITE=y
CONFIG_NF_DEFRAG_IPV6=y
CONFIG_NF_NAT_IPV4=y
CONFIG_LGE_NFC_PN547_C2=y
CONFIG_LGE_NFC=y
CONFIG_LGE_NFC_SET_IRQ_WAKEUP=y
CONFIG_NL80211_TESTMODE=y
CONFIG_NLS_ASCII=y
CONFIG_NLS_CODEPAGE_437=y
CONFIG_NLS_ISO8859_1=y
CONFIG_NLS_UTF8=y
CONFIG_NO_HZ=y
CONFIG_NR_CPUS=8
CONFIG_OF=y
CONFIG_ONESHOT_SYNC=y
CONFIG_OPROFILE=m
CONFIG_OV8858=y
CONFIG_PACKET=y
CONFIG_PANIC_ON_DATA_CORRUPTION=y
CONFIG_PANIC_ON_RECURSIVE_FAULT=y
CONFIG_PANIC_TIMEOUT=5
CONFIG_PARTITION_ADVANCED=y
CONFIG_PM_AUTOSLEEP=y
CONFIG_PM_DEBUG=y
CONFIG_PM_RUNTIME=y
CONFIG_PM_WAKELOCKS_LIMIT=0
CONFIG_PM_WAKELOCKS=y
CONFIG_POWER_RESET_MSM=y
CONFIG_POWER_RESET=y
CONFIG_POWER_SUPPLY=y
CONFIG_PPP_ASYNC=y
CONFIG_PPP_BSDCOMP=y
CONFIG_PPP_DEFLATE=y
CONFIG_PPP_FILTER=y
CONFIG_PPP_MPPE=y
CONFIG_PPP_MULTILINK=y
CONFIG_PPP_SYNC_TTY=y
CONFIG_PPP=y
CONFIG_PPPOE=y
CONFIG_PPPOL2TP=y
CONFIG_PPPOLAC=y
CONFIG_PPPOPNS=y
CONFIG_PRE_SELF_DIAGNOSIS=y
CONFIG_PREEMPT=y
CONFIG_PRIMA_WLAN_11AC_HIGH_TP=y
CONFIG_PRIMA_WLAN_LFR=y
CONFIG_PRIMA_WLAN_OKC=y
CONFIG_PRINTK_TIME=y
CONFIG_PROCESS_RECLAIM=y
CONFIG_PROFILING=y
CONFIG_PRONTO_WLAN=y
CONFIG_PSTORE_CONSOLE=y
CONFIG_PSTORE_RAM=y
CONFIG_PSTORE=y
CONFIG_PWM_QPNP=y
CONFIG_PWM=y
CONFIG_QCOM_EARLY_RANDOM=y
CONFIG_QCOM_SPS_DMA=y
CONFIG_QCOM_TDLS=y
CONFIG_QCOM_VOWIFI_11R=y
CONFIG_QPNP_POWER_ON=y
CONFIG_QPNP_REVID=y
CONFIG_QPNP_VIBRATOR=y
CONFIG_QSEECOM=y
CONFIG_RADIO_IRIS_TRANSPORT=y
CONFIG_RADIO_IRIS=y
CONFIG_RCU_FAST_NO_HZ=y
CONFIG_RD_BZIP2=y
CONFIG_RD_LZMA=y
CONFIG_READAHEAD_MMAP_PAGE_CNT=8
CONFIG_READAHEAD_MMAP_SIZE_ENABLE=y
CONFIG_REGULATOR_CPR=y
CONFIG_REGULATOR_FAN53555=y
CONFIG_REGULATOR_FIXED_VOLTAGE=y
CONFIG_REGULATOR_MEM_ACC=y
CONFIG_REGULATOR_ONSEMI_NCP6335D=y
CONFIG_REGULATOR_PROXY_CONSUMER=y
CONFIG_REGULATOR_QPNP=y
CONFIG_REGULATOR_RPM_SMD=y
CONFIG_REGULATOR_SPM=y
CONFIG_REGULATOR_STUB=y
CONFIG_REGULATOR_TPS65132=y
CONFIG_REGULATOR=y
CONFIG_REMOTE_SPINLOCK_MSM=y
CONFIG_RESOURCE_COUNTERS=y
CONFIG_RMNET_DATA_FC=y
CONFIG_RMNET_DATA=y
CONFIG_RT_GROUP_SCHED=y
CONFIG_RTC_CLASS=y
CONFIG_RTC_DRV_QPNP=y
CONFIG_S5717=y
CONFIG_SCHED_HMP=y
CONFIG_SCHED_MC=y
CONFIG_SCHEDSTATS=y
CONFIG_SCSI_CONSTANTS=y
CONFIG_SCSI_LOGGING=y
CONFIG_SCSI_MULTI_LUN=y
CONFIG_SCSI_SCAN_ASYNC=y
CONFIG_SCSI_TGT=y
CONFIG_SCSI=y
CONFIG_SD_ENCRYPTION_MANAGER=y
CONFIG_SDCARD_FS_CI_SEARCH=y
CONFIG_SDCARD_FS=y
CONFIG_SECCOMP_FILTER=y
CONFIG_SECCOMP=y
CONFIG_SECURITY_NETWORK=y
CONFIG_SECURITY_SELINUX=y
CONFIG_SECURITY=y
#CONFIG_SENSOR_APDS9130 is not set
CONFIG_SENSORS_BMC150_ENABLE_INT1=y
CONFIG_SENSORS_BMC150=y
#CONFIG_SENSORS_K303B is not set
CONFIG_SENSORS_QPNP_ADC_VOLTAGE=y
CONFIG_SENSORS=y
CONFIG_SERIAL_MSM_HS=y
CONFIG_SERIAL_MSM_HSL_CONSOLE=y
CONFIG_SERIAL_MSM_HSL=y
CONFIG_SERIAL_MSM_SMD=y
CONFIG_SLIMBUS_MSM_NGD=y
CONFIG_SMP=y
CONFIG_SND_LGE_INCALL_RECORD_TUNE=y
CONFIG_SND_LGE_MABL=y
CONFIG_SND_LGE_NORMALIZER=y
CONFIG_SND_SOC_MSM8X16=y
CONFIG_SND_SOC=y
CONFIG_SND_USB_AUDIO=y
CONFIG_SND=y
CONFIG_SOCKEV_NLMCAST=y
CONFIG_SOUND=y
CONFIG_SPI_QUP=y
CONFIG_SPI_SPIDEV=m
CONFIG_SPI=y
CONFIG_SPMI_MSM_PMIC_ARB=y
CONFIG_SPMI=y
CONFIG_SPS_SUPPORT_NDP_BAM=y
CONFIG_SPS=y
CONFIG_STAGING=y
CONFIG_STRICT_MEMORY_RWX=y
CONFIG_STYLUS_PEN=y
CONFIG_SWITCH=y
CONFIG_SYSVIPC=y
CONFIG_TCP_CONG_ADVANCED=y
CONFIG_TCP_CONG_BIC=y
CONFIG_TCP_CONG_LIA=y
CONFIG_TCP_CONG_OLIA=y
CONFIG_TCP_CONG_WVEGAS=y
CONFIG_THERMAL_MONITOR=y
CONFIG_THERMAL_QPNP_ADC_TM=y
CONFIG_THERMAL_QPNP=y
CONFIG_THERMAL_TSENS8974=y
CONFIG_THERMAL=y
CONFIG_TIMER_STATS=y
CONFIG_TMPFS=y
CONFIG_TOUCHSCREEN_UNIFIED_DRIVER4=y
CONFIG_TOUCHSCREEN_UNIFIED_MELFAS_MIT300_PH1=y
CONFIG_TUN=y
CONFIG_UHID=y
CONFIG_HIDRAW=y
CONFIG_HID_PID=y
CONFIG_HID_APPLE=y
CONFIG_HID_ELECOM=y
CONFIG_HID_MAGICMOUSE=y
CONFIG_HID_MICROSOFT=y
CONFIG_HID_MULTITOUCH=y
CONFIG_HID_A4TECH=y
CONFIG_HID_ACRUX=y
CONFIG_HID_ACRUX_FF=y
CONFIG_HID_AUREAL=y
CONFIG_HID_BELKIN=y
CONFIG_HID_CHERRY=y
CONFIG_HID_CHICONY=y
CONFIG_HID_PRODIKEYS=y
CONFIG_HID_CYPRESS=y
CONFIG_HID_DRAGONRISE=y
CONFIG_DRAGONRISE_FF=y
CONFIG_HID_ELECOM=y
CONFIG_HID_EMS_FF=y
CONFIG_HID_EZKEY=y
CONFIG_HID_HOLTEK=y
CONFIG_HOLTEK_FF=y
CONFIG_HID_KEYTOUCH=y
CONFIG_HID_KYE=y
CONFIG_HID_UCLOGIC=y
CONFIG_HID_WALTOP=y
CONFIG_HID_GYRATION=y
CONFIG_HID_ICADE=y
CONFIG_HID_TWINHAN=y
CONFIG_HID_KENSINGTON=y
CONFIG_HID_LCPOWER=y
CONFIG_HID_LENOVO_TPKBD=y
CONFIG_HID_LOGITECH=y
CONFIG_HID_LOGITECH_DJ=y
CONFIG_LOGITECH_FF=y
CONFIG_LOGIRUMBLEPAD2_FF=y
CONFIG_LOGIG940_FF=y
CONFIG_LOGIWHEELS_FF=y
CONFIG_HID_MONTEREY=y
CONFIG_HID_ORTEK=y
CONFIG_HID_PANTHERLORD=y
CONFIG_PANTHERLORD_FF=y
CONFIG_HID_PETALYNX=y
CONFIG_HID_PICOLCD=y
CONFIG_HID_PICOLCD_FB=y
CONFIG_HID_PICOLCD_LEDS=y
CONFIG_HID_PRIMAX=y
CONFIG_HID_PS3REMOTE=y
CONFIG_HID_ROCCAT=y
CONFIG_HID_SAITEK=y
CONFIG_HID_SAMSUNG=y
CONFIG_HID_SONY=y
CONFIG_HID_SPEEDLINK=y
CONFIG_HID_STEELSERIES=y
CONFIG_HID_SUNPLUS=y
CONFIG_HID_GREENASIA=y
CONFIG_GREENASIA_FF=y
CONFIG_HID_GREENASIA_FF=y
CONFIG_HID_SMARTJOYPLUS=y
CONFIG_SMARTJOYPLUS_FF=y
CONFIG_HID_TIVO=y
CONFIG_HID_TOPSEED=y
CONFIG_HID_THINGM=y
CONFIG_HID_THRUSTMASTER=y
CONFIG_THRUSTMASTER_FF=y
CONFIG_HID_WACOM=y
CONFIG_HID_WIIMOTE=y
CONFIG_HID_ZEROPLUS=y
CONFIG_ZEROPLUS_FF=y
CONFIG_HID_ZYDACRON=y
CONFIG_HID_SENSOR_HUB=y
CONFIG_INPUT_JOYSTICK=y
CONFIG_JOYSTICK_A3D=y
CONFIG_JOYSTICK_ADI=y
CONFIG_JOYSTICK_COBRA=y
CONFIG_JOYSTICK_GF2K=y
CONFIG_JOYSTICK_GRIP=y
CONFIG_JOYSTICK_GRIP_MP=y
CONFIG_JOYSTICK_GUILLEMOT=y
CONFIG_JOYSTICK_INTERACT=y
CONFIG_JOYSTICK_SIDEWINDER=y
CONFIG_JOYSTICK_TMDC=y
CONFIG_JOYSTICK_IFORCE=y
CONFIG_JOYSTICK_WARRIOR=y
CONFIG_JOYSTICK_MAGELLAN=y
CONFIG_JOYSTICK_SPACEORB=y
CONFIG_JOYSTICK_SPACEBALL=y
CONFIG_JOYSTICK_STINGER=y
CONFIG_JOYSTICK_TWIDJOY=y
CONFIG_JOYSTICK_ZHENHUA=y
CONFIG_JOYSTICK_AS5011=y
CONFIG_JOYSTICK_JOYDUMP=y
CONFIG_JOYSTICK_XPAD=y
CONFIG_JOYSTICK_XPAD_FF=y
CONFIG_JOYSTICK_XPAD_LEDS=y
CONFIG_UID_CPUTIME=y
CONFIG_UID_STAT=y
CONFIG_UIO_MSM_SHAREDMEM=y
CONFIG_UIO=y
CONFIG_UNIX=y
CONFIG_USB_ACM=y
CONFIG_USB_ANNOUNCE_NEW_DEVICES=y
CONFIG_USB_BAM=y
CONFIG_USB_CCID_BRIDGE=y
CONFIG_USB_CI13XXX_MSM=y
CONFIG_USB_EHCI_EHSET=y
CONFIG_USB_EHCI_HCD=y
CONFIG_USB_EHCI_MSM_UICC=y
CONFIG_USB_EHCI_MSM=y
CONFIG_USB_EHSET_TEST_FIXTURE=y
CONFIG_USB_G_ANDROID=y
CONFIG_USB_GADGET=y
CONFIG_USB_MON=y
CONFIG_USB_PHY=y
CONFIG_USB_SERIAL_CSVT=y
CONFIG_USB_SERIAL=y
CONFIG_USB_USBNET=y
CONFIG_V4L_PLATFORM_DRIVERS=y
CONFIG_VFAT_FS=y
CONFIG_VFP=y
CONFIG_VIDEO_V4L2_SUBDEV_API=y
CONFIG_VIDEOBUF2_MSM_MEM=y
CONFIG_WCNSS_CORE_PRONTO=y
CONFIG_WCNSS_CORE=y
CONFIG_WCNSS_MEM_PRE_ALLOC=y
CONFIG_WCNSS_REGISTER_DUMP_ON_BITE=y
CONFIG_WLAN_FEATURE_11W=y
CONFIG_XFRM_IPCOMP=y
CONFIG_XFRM_MIGRATE=y
CONFIG_XFRM_STATISTICS=y
CONFIG_XFRM_SUB_POLICY=y
CONFIG_XFRM_USER=y
CONFIG_XFRM=y
CONFIG_ZRAM_LZ4_COMPRESS=y
CONFIG_ZRAM=y
CONFIG_ZSMALLOC=y
CONFIG_SOUNDWIRE=y
# change WCNSS
# CONFIG_APDS9930 is not set
# CONFIG_BACKLIGHT_GENERIC is not set
# CONFIG_BACKLIGHT_RT8542 is not set
# CONFIG_CLS_U32_PERF is not set
# CONFIG_CORE_DUMP_DEFAULT_ELF_HEADERS is not set
# CONFIG_DEFAULT_BIC is not set
# CONFIG_DEFAULT_BINDER is not set
# CONFIG_DEFAULT_DUMMY is not set
# CONFIG_DEFAULT_FULLMESH is not set
# CONFIG_DEFAULT_LIA is not set
# CONFIG_DEFAULT_MPTCP_PM is not set
# CONFIG_DEFAULT_MPTCP_SCHED is not set
# CONFIG_DEFAULT_NDIFFPORTS is not set
# CONFIG_DEFAULT_OLIA is not set
# CONFIG_DEFAULT_ROUNDROBIN is not set
# CONFIG_DEFAULT_SCHEDULER is not set
# CONFIG_DEFAULT_TCP_CONG is not set
# CONFIG_DEFAULT_WVEGAS is not set
# CONFIG_DETECT_HUNG_TASK is not set
# CONFIG_DEVKMEM is not set
# CONFIG_DEVMEM is not set
# CONFIG_GACT_PROB is not set
# CONFIG_IKCONFIG_PROC is not set
# CONFIG_INET_LRO is not set
# CONFIG_INPUT_MOUSE is not set
# CONFIG_INPUT_MOUSEDEV is not set
# CONFIG_IP_NF_SECURITY is not set
# CONFIG_IP_NF_TARGET_REJECT_SKERR is not set
# CONFIG_IP6_NF_TARGET_REJECT_SKERR is not set
# CONFIG_IPA is not set
# CONFIG_IPC_NS is not set
# CONFIG_KPROBES is not set
# CONFIG_LCD_CLASS_DEVICE is not set
# CONFIG_LEDS_LP5521 is not set
# CONFIG_LEDS_MSM_GPIO_FLASH is not set
# CONFIG_LEDS_TRIGGERS is not set
# CONFIG_LEGACY_PTYS is not set
# CONFIG_LGD_INCELL_VIDEO_WVGA_PT_PANEL is not set
# CONFIG_LGE_ANDROID_LOW_MEMORY_KILLER_IMPROVE is not set
# CONFIG_LGE_DIAG_ENABLE_SYSFS is not set
# CONFIG_LGE_PM_BATTERY_MAX17048 is not set
# CONFIG_LGE_PM_BATTERY_MAX17050 is not set
# CONFIG_LGE_PM_CHARGING_BQ24296_CHARGER is not set
# CONFIG_LGE_PM_CHARGING_SUPPORT_PHIHONG is not set
# CONFIG_LGE_PM_COOLDOWN_VZW_POWER_REQ is not set
# CONFIG_LGE_PM_CURRENT_SENSING_FUELGAUGE is not set
# CONFIG_LGE_PM_FACTORY_CABLE is not set
# CONFIG_LGE_PM_FLOATED_CHARGER is not set
# CONFIG_LGE_PM_LLK_MODE is not set
# CONFIG_LGE_PM_PWR_KEY_FOR_CHG_LOGO is not set
# CONFIG_LGE_USB_CHARGING_SPEC_VZW is not set
# CONFIG_LGE_USB_G_AUTORUN_VZW is not set
# CONFIG_LGE_USB_G_MULTIPLE_CONFIGURATION_VZW is not set
# CONFIG_LGP_DATA_TCPIP_MPTCP is not set
# CONFIG_LGP_DATA_TCPIP_MPTCP_CHECKSUM_ENABLE is not set
# CONFIG_LGP_DATA_TCPIP_MPTCP_SYN_RETRY_1 is not set
# CONFIG_LGP_DATA_TCPIP_TCP_SYN_RETRY_CONFIG_UPLUS is not set
# CONFIG_MPTCP is not set
# CONFIG_MPTCP_BINDER is not set
# CONFIG_MPTCP_FULLMESH is not set
# CONFIG_MPTCP_NDIFFPORTS is not set
# CONFIG_MPTCP_PM_ADVANCED is not set
# CONFIG_MPTCP_ROUNDROBIN is not set
# CONFIG_MPTCP_SCHED_ADVANCED is not set
# CONFIG_MSM_STACKED_MEMORY is not set
# CONFIG_NET_ACT_CSUM is not set
# CONFIG_NET_ACT_GACT is not set
# CONFIG_NET_ACT_IPT is not set
# CONFIG_NET_ACT_MIRRED is not set
# CONFIG_NET_ACT_NAT is not set
# CONFIG_NET_ACT_PEDIT is not set
# CONFIG_NET_ACT_SIMP is not set
# CONFIG_NET_ACT_SKBEDIT is not set
# CONFIG_NET_CLS_BASIC is not set
# CONFIG_NET_CLS_CGROUP is not set
# CONFIG_NET_CLS_IND is not set
# CONFIG_NET_CLS_ROUTE4 is not set
# CONFIG_NET_CLS_RSVP is not set
# CONFIG_NET_CLS_RSVP6 is not set
# CONFIG_NET_CLS_TCINDEX is not set
# CONFIG_NET_EMATCH_CMP is not set
# CONFIG_NET_EMATCH_META is not set
# CONFIG_NET_EMATCH_NBYTE is not set
# CONFIG_NET_EMATCH_TEXT is not set
# CONFIG_NET_SCH_ATM is not set
# CONFIG_NETFILTER_XT_MATCH_DSCP is not set
# CONFIG_NETFILTER_XT_MATCH_OSF is not set
# CONFIG_NETFILTER_XT_MATCH_OWNER is not set
# CONFIG_NETFILTER_XT_TARGET_LOG is not set
# CONFIG_NETFILTER_XT_TARGET_NOTRACK is not set
# CONFIG_NETFILTER_XT_TARGET_TEE is not set
# CONFIG_NF_CONNTRACK_SIP is not set
# CONFIG_NF_NAT_IPV6 is not set
# CONFIG_NF_NAT_SIP is not set
# CONFIG_NO_VM_RECLAIM is not set
# CONFIG_PAGE_OWNER is not set
# CONFIG_PANIC_ON_RT_THROTTLING is not set
# CONFIG_PID_NS is not set
# CONFIG_PM_WAKELOCKS_GC is not set
# CONFIG_QCOM_NPA_DUMP is not set
# CONFIG_QPNP_LINEAR_CHARGER is not set
# CONFIG_QPNP_VM_BMS is not set
# CONFIG_RELAY is not set
# CONFIG_RMNET_DATA_DEBUG_PKT is not set
# CONFIG_RMNET_IPA is not set
# CONFIG_SENSORS_ADSP is not set
# CONFIG_SENSORS_AKM09911 is not set
# CONFIG_SENSORS_AKM8963 is not set
# CONFIG_SENSORS_BMA2X2 is not set
# CONFIG_SENSORS_LIS3DH is not set
# CONFIG_SENSORS_MMC3416X is not set
# CONFIG_SENSORS_MPU6050 is not set
# CONFIG_SENSORS_QPNP_ADC_CURRENT is not set
# CONFIG_SND_LGE_EFFECT is not set
# CONFIG_USB_GADGET_DEBUG_FILES is not set
# CONFIG_USB_GADGET_DEBUG_FS is not set
# CONFIG_UTS_NS is not set
CONFIG_CRYPTO_AES_ARM=y
CONFIG_CRYPTO_AES_ARM_BS=y
CONFIG_CRYPTO_ABLK_HELPER=y
CONFIG_CRYPTO_CRYPTD=y
# CONFIG_VT is not set
# Enable Q-FUSE
# Enable SDCard Encryption
# Enable VPN
# For Key Lock CMD
# hardware-based FDE end
# hardware-based FDE start
# LGE added ( from L MR1 )
# LKM
# WCNSS
#CONFIG_DEFAULT_BIC is not set
#CONFIG_DEFAULT_TCP_CONG is not set
#CONFIG_LG_PROXY is not set
#CONFIG_LGE_G4STYLUS_CAMERA is not set
```
