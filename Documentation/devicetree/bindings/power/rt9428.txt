## arch/arm/configs/msm8909-lge-eng_defconfig
```kconfig
CONFIG_CORESIGHT=y
CONFIG_CORESIGHT_EVENT=y
CONFIG_CORESIGHT_FUSE=y
CONFIG_CORESIGHT_CTI=y
CONFIG_CORESIGHT_TMC=y
CONFIG_CORESIGHT_TPIU=y
CONFIG_CORESIGHT_FUNNEL=y
CONFIG_CORESIGHT_REPLICATOR=y
CONFIG_CORESIGHT_STM=y
CONFIG_CORESIGHT_HWEVENT=y
CONFIG_CORESIGHT_ETM=y
CONFIG_CORESIGHT_MODEM_ETM=y
CONFIG_CORESIGHT_WCN_ETM=y
CONFIG_CORESIGHT_RPM_ETM=y
CONFIG_CORESIGHT_QPDI=y
CONFIG_CORESIGHT_DBGUI=y
CONFIG_PAGE_OWNER=y
CONFIG_LOCKUP_DETECTOR=y
CONFIG_BOOTPARAM_SOFTLOCKUP_PANIC=y
CONFIG_PANIC_ON_RECURSIVE_FAULT=y
# CONFIG_DETECT_HUNG_TASK is not set
CONFIG_DEBUG_KMEMLEAK=y
CONFIG_DEBUG_KMEMLEAK_EARLY_LOG_SIZE=4000
CONFIG_DEBUG_KMEMLEAK_DEFAULT_OFF=y
CONFIG_DEBUG_SPINLOCK=y
CONFIG_DEBUG_MUTEXES=y
CONFIG_DEBUG_ATOMIC_SLEEP=y
CONFIG_DEBUG_STACK_USAGE=y
CONFIG_DEBUG_LIST=y
CONFIG_DEBUG_HIGHMEM=y
CONFIG_DEBUG_VM=y
CONFIG_FAULT_INJECTION=y
CONFIG_FAIL_PAGE_ALLOC=y
CONFIG_FAULT_INJECTION_DEBUG_FS=y
CONFIG_FAULT_INJECTION_STACKTRACE_FILTER=y
CONFIG_DEBUG_PAGEALLOC=y
CONFIG_MSM_RTB=y
CONFIG_MSM_RTB_SEPARATE_CPUS=y
CONFIG_PANIC_ON_DATA_CORRUPTION=y
CONFIG_SLUB_DEBUG_ON=y
CONFIG_SLUB_DEBUG_PANIC_ON=y
CONFIG_FREE_PAGES_RDONLY=y
CONFIG_KERNEL_TEXT_RDONLY=y
CONFIG_DEBUG_LL=y
CONFIG_EARLY_PRINTK=y
```

## arch/arm/configs/msm8909-lge-userdebug_defconfig
```kconfig
CONFIG_CORESIGHT=y
CONFIG_CORESIGHT_EVENT=y
CONFIG_CORESIGHT_FUSE=y
CONFIG_CORESIGHT_CTI=y
CONFIG_CORESIGHT_TMC=y
CONFIG_CORESIGHT_TPIU=y
CONFIG_CORESIGHT_FUNNEL=y
CONFIG_CORESIGHT_REPLICATOR=y
CONFIG_CORESIGHT_STM=y
CONFIG_CORESIGHT_HWEVENT=y
CONFIG_CORESIGHT_ETM=y
CONFIG_CORESIGHT_MODEM_ETM=y
CONFIG_CORESIGHT_WCN_ETM=y
CONFIG_CORESIGHT_RPM_ETM=y
CONFIG_CORESIGHT_QPDI=y
CONFIG_CORESIGHT_DBGUI=y
CONFIG_PANIC_ON_RECURSIVE_FAULT=y
CONFIG_MSM_RTB=y
CONFIG_MSM_RTB_SEPARATE_CPUS=y
CONFIG_PANIC_ON_DATA_CORRUPTION=y
CONFIG_EARLY_PRINTK=y
```

## arch/arm/configs/msm8916_sec_e5_eur_defconfig
```kconfig
CONFIG_SEC_E5_PROJECT=y
CONFIG_MACH_E5_EUR_OPEN=y

# MUIC
CONFIG_SM5502_MUIC=y
CONFIG_USBID_STANDARD_VER_01=y

#AUDIO
CONFIG_AUDIO_SPEAKER_OUT_NXP_AMP_ENABLE=y
CONFIG_AUDIO_QUAT_I2S_ENABLE=y
CONFIG_RADIO_LNA_CONTROL=y

# TSP
CONFIG_TOUCHSCREEN_MMS300=y
CONFIG_KEYBOARD_TC360_TKEY=y

#LCD
CONFIG_PANEL_EA8061V_AMS497EE01_HD=y

#Vibrator
CONFIG_MSM_VIBRATOR=y

# BATTERY
CONFIG_MFD_RT5033=y
CONFIG_BATTERY_SAMSUNG=y
CONFIG_BATTERY_SAMSUNG_DATA_FILE="e5_battery_data.h"
CONFIG_SAMSUNG_LPM_MODE=y
CONFIG_CHARGER_RT5033=y
CONFIG_FUELGAUGE_RT5033=y
CONFIG_REGULATOR_RT5033=y
CONFIG_MFD_RT5033_RESET_WA=y
CONFIG_MFD_RT5033_SLDO_VBUSDET=y
CONFIG_BATTERY_SWELLING=y

#SENSOR
CONFIG_SENSORS=y
CONFIG_SENSORS_CORE=y
CONFIG_SENSORS_K2HH=y
CONFIG_SENSORS_CM36672P=y
CONFIG_SENSORS_LEDA_EN_GPIO=y

#NFC
CONFIG_SEC_NFC=y
CONFIG_SEC_NFC_IF_I2C=y
CONFIG_SEC_NFC_PRODUCT_N5=y
CONFIG_SEC_NFC_USE_8916_BBCLK2=y

#optimize mmc block delay on resume
CONFIG_MMC_BLOCK_DEFERRED_RESUME=y
#MMC
CONFIG_SEC_HYBRID_TRAY=y

#FLASH
CONFIG_FLASHLIGHT=y
CONFIG_RT_FLASH_LED=y
CONFIG_FLED_RT5033=y
CONFIG_FLED_RT5033_EXT_GPIO=y

#CAMERA
# CONFIG_MSM_OTP is not set
CONFIG_S5K4H5YB=y
CONFIG_S5K5E3YX=y
```

## arch/arm/configs/msm8939_sec_a7_eur_defconfig
```kconfig
CONFIG_SEC_A7_PROJECT=y
CONFIG_MACH_A7_EUR_OPEN=y

# GPIO SETTING
#CONFIG_SEC_GPIO_SETTINGS=y

#INPUT MODULES
CONFIG_KEYBOARD_ABOV_TOUCH_A7=y
# CONFIG_TOUCHSCREEN_SYNAPTICS_I2C_RMI_G is not set
CONFIG_TOUCHSCREEN_CYTTSP5=y
CONFIG_TOUCHSCREEN_CYTTSP5_DEVICETREE_SUPPORT=y
# CONFIG_TOUCHSCREEN_SYNAPTICS_DSX_v21 is not set
# CONFIG_TOUCHSCREEN_SYNAPTICS_DSX_CORE_v21 is not set
# CONFIG_TOUCHSCREEN_SYNAPTICS_DSX_RMI_DEV_v21 is not set
# CONFIG_TOUCHSCREEN_SYNAPTICS_DSX_FW_UPDATE_v21 is not set
# CONFIG_TOUCHSCREEN_ATMEL_MXT is not set
# CONFIG_TOUCHSCREEN_FT5X06 is not set
# CONFIG_TOUCHSCREEN_MSTAR21XX is not set
# CONFIG_TOUCHSCREEN_GEN_VKEYS is not set
# CONFIG_TOUCHSCREEN_SYNAPTICS_I2C_RMI4 is not set
# CONFIG_TOUCHSCREEN_SYNAPTICS_DSX_RMI4_DEV is not set
# CONFIG_TOUCHSCREEN_SYNAPTICS_DSX_FW_UPDATE is not set
# CONFIG_SECURE_TOUCH is not set
# CONFIG_TOUCHSCREEN_BU21150 is not set
# CONFIG_INPUT_MT_WRAPPER is not set
CONFIG_INPUT_UINPUT=y
CONFIG_INPUT_GPIO=y

#HALL IC
CONFIG_SENSORS_HALL=y
# CONFIG_SENSORS_HALL_REAR is not set

#VIBTONZ
CONFIG_VIBETONZ=y
CONFIG_TACTILE_ASSIST=y

# MUIC
CONFIG_SM5502_MUIC=y
CONFIG_USBID_STANDARD_VER_01=y
CONFIG_MUIC_SUPPORT_RUSTPROOF_INBATT=y
CONFIG_MUIC_SUPPORT_CHARGING_CABLE=y
CONFIG_MUIC_SUPPORT_DESKDOCK=y
CONFIG_MUIC_SUPPORT_SMARTDOCK=y

# IFPMIC
CONFIG_MFD_RT5033_RESET_WA=y
CONFIG_MFD_RT5033_SLDO_VBUSDET=n

# Charging/Battery
CONFIG_MFD_RT5033=y
CONFIG_REGULATOR_RT5033=y
CONFIG_CHARGER_RT5033=y
CONFIG_BATTERY_SAMSUNG=y
CONFIG_BATTERY_SAMSUNG_DATA_FILE="a7_battery_data.h"
CONFIG_SAMSUNG_LPM_MODE=y
CONFIG_FUELGAUGE_RT5033=y
CONFIG_PREVENT_SOC_JUMP=y

#USB Host
CONFIG_USB_HOST_NOTIFY=y

#NFC
CONFIG_NFC_PN547=y
CONFIG_NFC_PN547_8916_USE_BBCLK2=y
CONFIG_NFC_PN547_8916_CLK_CTL=y

#BATTERY
CONFIG_BATTERY_SWELLING=y

#AUDIO
CONFIG_AUDIO_SPEAKER_OUT_NXP_AMP_ENABLE=y
CONFIG_AUDIO_QUAT_I2S_ENABLE=y

#SENSORS
CONFIG_SENSORS=y
CONFIG_SENSORS_CORE=y
CONFIG_SENSORS_USE_SYMLINK=y
CONFIG_SYSFS=y
CONFIG_INPUT=y
CONFIG_INPUT_MISC=y
CONFIG_INPUT_GPIO=y
CONFIG_INPUT_POLLDEV=y
CONFIG_SENSORS_TMD3782S=y
CONFIG_SENSORS_TAOS_CHECK_REV=y
# BMC150
CONFIG_SENSORS_BMA2X2=y
CONFIG_SENSORS_BMM050=y
CONFIG_INPUT_BMA2x2_ACC_ALERT_INT=y
# CONFIG_SENSORS_BMA2X2_ENABLE_INT1 is not set
# CONFIG_BOSCH_BMA2X2_ENABLE_INT2 is not set

#DISPLAY
CONFIG_PANEL_S6E3FA2_AMS549EH01_FHD=y

# TIMA LOG
# CONFIG_ARCH_MSM8939_TIMA=y

#CAMERA
CONFIG_MSM_OTP=y
CONFIG_S5K5E3YX=y
CONFIG_IMX135=y

# debugging more information
#CONFIG_DEBUG_FS=y

#MMC
#CONFIG_SEC_HYBRID_TRAY=y
```

## arch/arm/configs/msm8939_sec_a8_chnopen_defconfig
```kconfig
CONFIG_SEC_A8_PROJECT=y
CONFIG_MACH_A8_CHN_OPEN=y

# GPIO SETTING
#CONFIG_SEC_GPIO_SETTINGS=y

# GPIO EXPANDER
CONFIG_GPIO_PCAL6416A=y

#VIBTONZ
CONFIG_VIBETONZ=y
CONFIG_TACTILE_ASSIST=y

# MUIC
CONFIG_EXTCON=y
CONFIG_EXTCON_MAX77843=y
CONFIG_MFD_MAX77843=y
CONFIG_MUIC_SUPPORT_RUSTPROOF_INBATT=y
CONFIG_MUIC_SUPPORT_CHARGING_CABLE=y
CONFIG_MUIC_SUPPORT_DESKDOCK=y
CONFIG_MUIC_SUPPORT_SMARTDOCK=y

#############################################
# SOUND FEATURE
#############################################
CONFIG_AUDIO_SPEAKER_OUT_NXP_AMP_ENABLE=y
CONFIG_AUDIO_QUAT_I2S_ENABLE=y
CONFIG_SW_100K_TO_GND=y
#############################################

#SENSOR
CONFIG_SENSORS=y
CONFIG_SENSORS_CORE=y
CONFIG_SENSORS_CM36652=y
CONFIG_SENSORS_CM36652_SENSOR_EN_GPIO=y
# CONFIG_SENSORS_CM36652_LEDA_EN_GPIO is not use
# BMC150
CONFIG_SENSORS_BMA2X2=y
CONFIG_SENSORS_BMM050=y
CONFIG_INPUT_BMA2x2_ACC_ALERT_INT=y

#NFC
CONFIG_SEC_NFC=y
CONFIG_SEC_NFC_I2C=y
CONFIG_SEC_NFC_USE_8916_BBCLK2=y
CONFIG_SEC_NFC_IF_I2C=y
CONFIG_SEC_NFC_PRODUCT_N5=y
CONFIG_SEC_NFC_IO_EN=y

#USB Host
CONFIG_USB_HOST_NOTIFY=y

# Charging/Battery
CONFIG_CHARGER_S2MU003=y
CONFIG_FUELGAUGE_S2MU003=y
CONFIG_BATTERY_SAMSUNG=y
CONFIG_BATTERY_SAMSUNG_DATA_FILE="a8_battery_data.h"
CONFIG_SAMSUNG_LPM_MODE=y
CONFIG_BATTERY_SWELLING=y
CONFIG_BATTERY_SWELLING_SELF_DISCHARGING=y
CONFIG_INBATTERY=y

# PMIC/MISC
CONFIG_MFD_S2MU003=y
CONFIG_REGULATOR_S2MU003=y

# CONFIG_SENSORS_BMA2X2_ENABLE_INT1 is not set
# CONFIG_BOSCH_BMA2X2_ENABLE_INT2 is not set

#DISPLAY
CONFIG_PANEL_S6E3FA3_AMS568HN01_FHD=y

# TIMA LOG
# CONFIG_ARCH_MSM8939_TIMA=y

#CAMERA
#CONFIG_MSM_OTP=y

# debugging more information
#CONFIG_DEBUG_FS=y

#MMC
#CONFIG_SEC_HYBRID_TRAY=y

# INPUT
CONFIG_TOUCHSCREEN_MELFAS_MMS449=y
# CONFIG_TOUCHSCREEN_SYNAPTICS_I2C_RMI_G is not set
# CONFIG_TOUCHSCREEN_CYTTSP5 is not set
# CONFIG_TOUCHSCREEN_CYTTSP5_DEVICETREE_SUPPORT is not set
# CONFIG_TOUCHSCREEN_SYNAPTICS_DSX_v21 is not set
# CONFIG_TOUCHSCREEN_SYNAPTICS_DSX_CORE_v21 is not set
# CONFIG_TOUCHSCREEN_SYNAPTICS_DSX_RMI_DEV_v21 is not set
# CONFIG_TOUCHSCREEN_SYNAPTICS_DSX_FW_UPDATE_v21 is not set
# CONFIG_TOUCHSCREEN_ATMEL_MXT is not set
# CONFIG_TOUCHSCREEN_FT5X06 is not set
# CONFIG_TOUCHSCREEN_MSTAR21XX is not set
# CONFIG_TOUCHSCREEN_GEN_VKEYS is not set
# CONFIG_TOUCHSCREEN_SYNAPTICS_I2C_RMI4 is not set
# CONFIG_TOUCHSCREEN_SYNAPTICS_DSX_RMI4_DEV is not set
# CONFIG_TOUCHSCREEN_SYNAPTICS_DSX_FW_UPDATE is not set
# CONFIG_SECURE_TOUCH is not set
# CONFIG_TOUCHSCREEN_BU21150 is not set
# CONFIG_INPUT_MT_WRAPPER is not set
CONFIG_KEYBOARD_ABOV_TOUCH=y
CONFIG_INPUT_BOOSTER=y
```

## arch/arm/configs/msm8939_sec_k5_chnopen_defconfig
```kconfig
CONFIG_SEC_K5_PROJECT=y
CONFIG_MACH_K5_CHN_OPEN=y

# GPIO SETTING
#CONFIG_SEC_GPIO_SETTINGS=y

#VIBTONZ
CONFIG_VIBETONZ=y
CONFIG_TACTILE_ASSIST=y

# MUIC
CONFIG_SM5502_MUIC=y
CONFIG_USBID_STANDARD_VER_01=y
CONFIG_MUIC_SUPPORT_RUSTPROOF_INBATT=y
CONFIG_MUIC_SUPPORT_CHARGING_CABLE=y
CONFIG_MUIC_SUPPORT_DESKDOCK=y
CONFIG_MUIC_SUPPORT_SMARTDOCK=y

#############################################
# SOUND FEATURE
#############################################
CONFIG_AUDIO_SPEAKER_OUT_NXP_AMP_ENABLE=y
CONFIG_AUDIO_QUAT_I2S_ENABLE=y
CONFIG_SW_100K_TO_GND=y
#############################################

#SENSOR
CONFIG_SENSORS=y
CONFIG_SENSORS_CORE=y
CONFIG_SENSORS_CM36652=y
# CONFIG_SENSORS_CM36652_LEDA_EN_GPIO is not use
# BMC150
CONFIG_SENSORS_BMA2X2=y
CONFIG_SENSORS_BMM050=y
CONFIG_INPUT_BMA2x2_ACC_ALERT_INT=y

#NFC
CONFIG_SEC_NFC=y
CONFIG_SEC_NFC_I2C=y
CONFIG_SEC_NFC_USE_8916_BBCLK2=y
CONFIG_SEC_NFC_IF_I2C=y
CONFIG_SEC_NFC_PRODUCT_N5=y
# IFPMIC
#CONFIG_MFD_RT5033_RESET_WA=y

#USB Host
CONFIG_USB_HOST_NOTIFY=y

# Charging/Battery
CONFIG_MFD_RT5033=y
CONFIG_REGULATOR_RT5033=y
CONFIG_CHARGER_RT5033=y
CONFIG_BATTERY_SAMSUNG=y
CONFIG_BATTERY_SAMSUNG_DATA_FILE="k5_battery_data.h"
CONFIG_SAMSUNG_LPM_MODE=y
CONFIG_FUELGAUGE_RT5033=y
CONFIG_BATTERY_SWELLING=y

# CONFIG_SENSORS_BMA2X2_ENABLE_INT1 is not set
# CONFIG_BOSCH_BMA2X2_ENABLE_INT2 is not set

#DISPLAY
CONFIG_PANEL_S6E3FA3_AMS499ER01_FHD=y

# TIMA LOG
# CONFIG_ARCH_MSM8939_TIMA=y

#CAMERA
#CONFIG_MSM_OTP=y

# debugging more information
#CONFIG_DEBUG_FS=y

#MMC
#CONFIG_SEC_HYBRID_TRAY=y

# INPUT
CONFIG_TOUCHSCREEN_MELFAS_MMS449=y
CONFIG_KEYBOARD_ABOV_TOUCH=y
CONFIG_INPUT_BOOSTER=y
```
