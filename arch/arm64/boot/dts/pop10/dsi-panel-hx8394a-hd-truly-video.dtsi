/* Copyright (c) 2014, The Linux Foundation. All rights reserved.
 *
 * This program is free software; you can redistribute it and/or modify
 * it under the terms of the GNU General Public License version 2 and
 * only version 2 as published by the Free Software Foundation.
 *
 * This program is distributed in the hope that it will be useful,
 * but WITHOUT ANY WARRANTY; without even the implied warranty of
 * MERCHANTABILITY or FITNESS FOR A PARTICULAR PURPOSE.  See the
 * GNU General Public License for more details.
 */

/*---------------------------------------------------------------------------
 * This file is autogenerated file using gcdb parser. Please do not edit it.
 * Update input XML file to add a new entry or update variable in this file
 * VERSION = "1.0"
 *---------------------------------------------------------------------------*/
&mdss_mdp {
	dsi_hx8394a_hd_vid: qcom,mdss_dsi_hx8394a_hd_truly_video {
		qcom,mdss-dsi-panel-name = "hx8394a alto5 vdf truly";
		qcom,mdss-dsi-panel-controller = <&mdss_dsi0>;
		qcom,mdss-dsi-panel-type = "dsi_video_mode";
		qcom,mdss-dsi-panel-destination = "display_1";
        qcom,mdss-dsi-panel-framerate = <60>;
		qcom,mdss-dsi-virtual-channel-id = <0>;
		qcom,mdss-dsi-stream = <0>;
		qcom,mdss-dsi-panel-width = <720>;
		qcom,mdss-dsi-panel-height = <1280>;
		qcom,mdss-dsi-h-front-porch = <79>;
		qcom,mdss-dsi-h-back-porch = <59>;
		qcom,mdss-dsi-h-pulse-width = <60>;
		qcom,mdss-dsi-h-sync-skew = <0>;
		qcom,mdss-dsi-v-back-porch = <10>;
		qcom,mdss-dsi-v-front-porch = <7>;
		qcom,mdss-dsi-v-pulse-width = <2>;
		
		qcom,mdss-dsi-h-left-border = <0>;
		qcom,mdss-dsi-h-right-border = <0>;
		qcom,mdss-dsi-v-top-border = <0>;
		qcom,mdss-dsi-v-bottom-border = <0>;
		qcom,mdss-dsi-bpp = <24>;
		qcom,mdss-dsi-color-order = "rgb_swap_rgb";
		qcom,mdss-dsi-underflow-color = <0xff>;
		qcom,mdss-dsi-border-color = <0>;
		qcom,mdss-dsi-on-command = [
	        39 01 00 00 00 00 04 B9 FF 83 94

		15 01 00 00 00 00 02 BA 13

 		39 01 00 00 00 00 11 B1 01 00 44 C7 02 12 FE 25 2F 3F
					3F 47 12 00 E6 E2
 		39 01 00 00 00 00 07 B2 00 C8 05 07 00 22
 		39 01 00 00 00 00 17 B4 00 10 32 10 00 32 15 04 32 15
					28 37 04 53 00 37 04 53 01 63
					63 01
 
		39 01 00 00 00 00 05 BF 06 02 10 04

		15 01 00 00 00 00 02 B6 39

		39 01 00 00 00 00 3F D5 00 00 00 00 0A 00 01 33 00 11
					88 00 88 88 88 88 88 88 10 54
					76 76 32 54 54 10 76 32 10 32
					88 88 88 88 88 88 88 88 67 23
					01 01 45 23 23 67 01 45 67 45
					88 88 00 00 00 00 EE 44 00 00
					00 00

		15 01 00 00 00 00 02 CC 01
		15 01 00 00 00 00 02 36 02

		39 01 00 00 00 00 05 C7 00 10 00 10
		39 01 00 00 00 00 03 C6 08 08


     		39 01 00 00 00 00 2B E0 00 1D 22 2F 31 3F 2C 44 07 0D
					0F 12 14 13 14 12 18 00 1D 22
					2F 31 3F 2C 45 06 0C 0E 12 14
					11 13 11 18 0B 17 08 13 0A 18
					06 13
		15 01 00 00 00 00 02 D4 32
 
		05 01 00 00 96 00 02 11 00
		05 01 00 00 32 00 02 29 00];
		qcom,mdss-dsi-off-command = [05 01 00 00 02 00 02 28 00
					05 01 00 00 79 00 02 10 00];
		qcom,mdss-dsi-on-command-state = "dsi_lp_mode";
		qcom,mdss-dsi-off-command-state = "dsi_hs_mode";
		qcom,mdss-dsi-h-sync-pulse = <1>;
		qcom,mdss-dsi-traffic-mode = "burst_mode";
		qcom,mdss-dsi-lane-map = "lane_map_3012";
		qcom,mdss-dsi-bllp-eof-power-mode;
		qcom,mdss-dsi-bllp-power-mode;
		qcom,mdss-dsi-lane-0-state;
		qcom,mdss-dsi-lane-1-state;
		qcom,mdss-dsi-lane-2-state;
		qcom,mdss-dsi-lane-3-state;
		qcom,mdss-dsi-panel-timings = [8d 24 19 00 34  34 1d 26 2a 03 04 00];
		qcom,mdss-dsi-t-clk-post = <0x05>;
		qcom,mdss-dsi-t-clk-pre = <0x36>;
		qcom,mdss-dsi-panel-clockrate = <424000000>;
		qcom,mdss-dsi-bl-min-level = <1>;
		qcom,mdss-dsi-bl-max-level = <255>;
		qcom,mdss-dsi-dma-trigger = "trigger_sw";
		qcom,mdss-dsi-mdp-trigger = "none";
		qcom,mdss-dsi-bl-pmic-control-type = "bl_ctrl_wled";
		qcom,mdss-dsi-reset-sequence = <1 20>, <0 20>, <1 20>;
		qcom,mdss-pan-physical-width-dimension = <62>;
		qcom,mdss-pan-physical-height-dimension = <110>;
	};
};
