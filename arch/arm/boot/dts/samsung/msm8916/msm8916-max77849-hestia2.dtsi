/* Copyright (c) 2012, The Linux Foundation. All rights reserved.
 *
 * This program is free software; you can redistribute it and/or modify
 * it under the terms of the GNU General Public License version 2 and
 * only version 2 as published by the Free Software Foundation.
 *
 * This program is distributed in the hope that it will be useful,
 * but WITHOUT ANY WARRANTY; without even the implied warranty of
 * MERCHANTABILITY or FITNESS FOR A PARTICULAR PURPOSE.  See the
 * GNU General Public License for more details.
 */

&soc {
       i2c_9:i2c@9 {
		cell-index = <9>;
		compatible = "i2c-gpio";
		i2c-gpio-scl = <&msm_gpio 76 0x00>;
		i2c-gpio-sda = <&msm_gpio 75 0x00>;
		i2c-gpio,delay-us = <2>;
		#address-cells = <1>;
		#size-cells = <0>;
		max77849@66 {
			compatible = "max77849,i2c";
			reg = <0x66>;
			interrupt-parent = <&msm_gpio>;
			interrupts = <62 0>;
			max77849,irq-gpio = <&msm_gpio 62 0x00>;
			pinctrl-names = "muic_i2c_active","muic_i2c_suspend";
			pinctrl-0 = <&muic_i2c_active &muic_int_pin>;
			pinctrl-1 = <&muic_i2c_suspend &muic_int_pin>;
		};
	};
};
