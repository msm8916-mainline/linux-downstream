/* Copyright (c) 2014, The Linux Foundation. All rights reserved.
 *
 * This program is free software; you can redistribute it and/or modify
 * it under the terms of the GNU General Public License version 2 and
 * only version 2 as published by the Free Software Foundation.
 *
 * This program is distributed in the hope that it will be useful,
 * but WITHOUT ANY WARRANTY; without even the implied warranty of
 * MERCHANTABILITY or FITNESS FOR A PARTICULAR PURPOSE.  See the
 * GNU General Public License for more details.
 */
/ {
	battery {
		status = "okay";
		compatible = "samsung,sec-battery";
		battery,vendor = "SDI SDI";
		battery,charger_name = "max77843-charger";
		battery,fuelgauge_name = "max77843-fuelgauge";
		battery,technology = <2>; /* POWER_SUPPLY_TECHNOLOGY_LION */

		battery,chip_vendor = "QCOM";
		battery,temp_adc_type = <1>; /* SEC_BATTERY_ADC_TYPE_AP */

		battery,polling_time = <10 30 30 30 3600>;

		battery,adc_check_count = <5>;

		battery,cable_check_type = <4>; /* SEC_BATTERY_CABLE_CHECK_PSY */
		battery,cable_source_type = <3>; /* SEC_BATTERY_CABLE_SOURCE_EXTERNAL */
		battery,event_check;
		battery,event_waiting_time = <600>;
		battery,polling_type = <1>; /* SEC_BATTERY_MONITOR_ALARM */
		battery,monitor_initial_count = <3>;

		battery,battery_check_type = <0>; /* SEC_BATTERY_CHECK_NONE */
		battery,check_count = <0>;
		battery,check_adc_max = <1440>;
		battery,check_adc_min = <0>;

		battery,ovp_uvlo_check_type = <3>; /* SEC_BATTERY_OVP_UVLO_CHGPOLLING */

		battery,thermal_source = <2>; /* SEC_BATTERY_THERMAL_SOURCE_ADC */

		battery,temp_check_type = <0>; /* SEC_BATTERY_TEMP_CHECK_NONE */
		battery,temp_check_count = <1>;
		battery,temp_high_threshold_event = <600>;
		battery,temp_high_recovery_event = <450>;
		battery,temp_low_threshold_event = <(-50)>;
		battery,temp_low_recovery_event = <0>;
		battery,temp_high_threshold_normal = <600>;
		battery,temp_high_recovery_normal = <450>;
		battery,temp_low_threshold_normal = <(-50)>;
		battery,temp_low_recovery_normal = <0>;
		battery,temp_high_threshold_lpm = <600>;
		battery,temp_high_recovery_lpm = <450>;
		battery,temp_low_threshold_lpm = <(-50)>;
		battery,temp_low_recovery_lpm = <0>;
		battery,full_check_type = <7>; /* SEC_BATTERY_FULLCHARGED_CHGPSY */
		battery,full_check_type_2nd = <3>; /* SEC_BATTERY_FULLCHARGED_TIME */
		battery,full_check_count = <1>;
		battery,chg_gpio_full_check = <0>;
		battery,chg_polarity_full_check = <1>;

		/* SEC_BATTERY_FULL_CONDITION_SOC |
		   SEC_BATTERY_FULL_CONDITION_NOTIMEFULL |
		   SEC_BATTERY_FULL_CONDITION_VCELL */
		battery,full_condition_type = <13>;
		battery,full_condition_soc = <93>;
		battery,full_condition_vcell = <4250>;

		battery,recharge_check_count = <1>;
		battery,recharge_condition_type = <4>; /* SEC_BATTERY_RECHARGE_CONDITION_VCELL */
		battery,recharge_condition_soc = <98>;
		battery,recharge_condition_vcell = <4300>;

		battery,self_discharging_en;
		battery,factory_discharging = <&expander_gpios 13 0x00>;
		battery,force_discharging_limit = <600>;
		battery,force_discharging_recov = <550>;
		battery,self_discharging_voltage_limit = <4250>;
		battery,discharging_adc_max = <36864>;
		battery,discharging_adc_min = <32768>;
		battery,discharging_ntc_limit = <2750>;

		battery,charging_total_time = <21600>;
		battery,recharging_total_time = <5400>;
		battery,charging_reset_time = <0>;
		qcom,sec-battery-vadc = <&pm8916_vadc>;

		battery,swelling_drop_float_voltage = <4200>;
		battery,swelling_high_rechg_voltage = <4150>;
		battery,swelling_low_rechg_voltage = <4050>;

		charger {
			status = "disable";
			/* Charger */
			battery,charger_name = "max77843-charger";
			battery,chg_gpio_en = <0>;
			battery,chg_polarity_en = <0>;
			battery,chg_gpio_status = <0>;
			battery,chg_polarity_status = <0>;
			battery,chg_float_voltage = <4350>;
			battery,ovp_uvlo_check_type = <3>; /* SEC_BATTERY_OVP_UVLO_CHGPOLLING */
			battery,full_check_type = <7>; /* SEC_BATTERY_FULLCHARGED_CHGPSY */

			battery,input_current_limit = <1800 460 460 1800 460 900 1000 460 460 1000 820 1800 1800 460 1300 300 700 1300 1500 300 80 1800 460 1000 1667>;
			battery,fast_charging_current = <2100 0 460 2100 460 1200 1000 460 0 1200 1000 2100 2100 0 1300 300 700 1300 1500 300 80 2100 0 1000 3000>;
			battery,full_check_current_1st = <275 0 275 275 275 275 275 275 0 275 275 275 275 0 275 275 275 275 275 275 275 275 0 275 275>;
			battery,full_check_current_2nd = <3000 0 3000 3000 3000 3000 3000 3000 0 3000 3000 3000 3000 0 3000 3000 3000 3000 3000 3000 3000 3000 0 3000 3000>;
		};

		max77843-fuelgauge {
			compatible = "samsung,max77843-fuelgauge";
			fuelgauge,fuel_alert_soc = <1>;
			fuelgauge,capacity_max = <1000>;
			fuelgauge,capacity_max_hv = <1000>;
			fuelgauge,capacity_max_margin = <50>;
			fuelgauge,capacity_min = <0>;
			fuelgauge,capacity_calculation_type = <0x17>;
			/* fuelgaguge,repeated_fuelalert; */
			/* battery_data */
			fuelgauge,qrtable20 = <0x0900>;
			fuelgauge,qrtable30 = <0x0780>;
			fuelgauge,rcomp0 = <0x63>;
			fuelgauge,rcomp_charging = <0x63>;
			fuelgauge,type_str = "SDI";
			fuelgauge,capacity = <0x19C8>; /* TR : 3300mAh */
			fuelgauge,low_battery_comp_voltage = <3500>;
			fuelgauge,low_battery_table = <(-5000) 0 0 (-1250) 0 3320 (-750) 97 3451 (-100) 96 3461 0 0 3456>;
		};
	};
};
