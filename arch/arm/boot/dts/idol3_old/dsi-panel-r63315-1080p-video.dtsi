/* Copyright (c) 2013, The Linux Foundation. All rights reserved.
 *
 * This program is free software; you can redistribute it and/or modify
 * it under the terms of the GNU General Public License version 2 and
 * only version 2 as published by the Free Software Foundation.
 *
 * This program is distributed in the hope that it will be useful,
 * but WITHOUT ANY WARRANTY; without even the implied warranty of
 * MERCHANTABILITY or FITNESS FOR A PARTICULAR PURPOSE.  See the
 * GNU General Public License for more details.
 */

/*---------------------------------------------------------------------------
 * This file is autogenerated file using gcdb parser. Please do not edit it.
 * Update input XML file to add a new entry or update variable in this file
 * VERSION = "1.0"
 *---------------------------------------------------------------------------*/
 
&mdss_mdp {
	dsi_r63315_1080p_vid: qcom,mdss_dsi_r63315_1080p_video{
		compatible = "qcom,mdss-dsi-panel";
		status = "disable";
		qcom,mdss-dsi-panel-name = "r63315 1080p videomode panel";
		qcom,mdss-dsi-panel-controller = <&mdss_dsi0>;
		qcom,mdss-dsi-panel-type = "dsi_video_mode";
		qcom,mdss-dsi-panel-destination = "display_1";
		qcom,mdss-dsi-pixel-packing = <0>; /* used for 16bit mode*/
        qcom,mdss-dsi-panel-framerate = <60>;
        qcom,mdss-dsi-virtual-channel-id = <0>;
		qcom,mdss-dsi-stream = <0>;
		qcom,mdss-dsi-panel-width = <1080>;
		qcom,mdss-dsi-panel-height = <1920>;
		qcom,mdss-dsi-h-front-porch = <100>;//<200>;
		qcom,mdss-dsi-h-back-porch = <60>;//<175>;
		qcom,mdss-dsi-h-pulse-width = <20>;
		qcom,mdss-dsi-h-sync-skew = <0>;
		qcom,mdss-dsi-v-back-porch = <4>;//<10>;
		qcom,mdss-dsi-v-front-porch = <8>;//<20>;
		qcom,mdss-dsi-v-pulse-width = <2>;//<2>;
		qcom,mdss-dsi-h-left-border = <0>;
		qcom,mdss-dsi-h-right-border = <0>;
		qcom,mdss-dsi-v-top-border = <0>;
		qcom,mdss-dsi-v-bottom-border = <0>;
		qcom,mdss-pan-physical-width-dimension = <0>;
		qcom,mdss-pan-physical-height-dimension = <0>;
		qcom,mdss-dsi-bpp = <24>;
		qcom,mdss-dsi-color-order = <0>;
		qcom,mdss-dsi-underflow-color = <0xff>;
		qcom,mdss-dsi-border-color = <0>;
		qcom,mdss-dsi-reset-command = [
            05 01 00 00 78 00 02 11 00
            05 01 00 00 14 00 02 29 00
            05 01 00 00 14 00 02 38 00
        ];
		qcom,mdss-dsi-on-command = [
		

	     
            23 01 00 00 00 00 02
				B0 04
            29 01 00 00 00 00 07
				B3 14 00 00 00 00 00
            29 01 00 00 00 00 03
				 B6 3A b3
            23 01 00 00 00 00 02
				 C0 00
            29 01 00 00 00 00 23
				C1 84 60 10 EB FF 6F CE FF FF 17 12 58 73 AE 31 20 C6 FF FF 1F F3 FF 5F 10 10 10 10 00 62 01 22 22 00 01
            29 01 00 00 00 00 08
				C2 31 F7 80 06 08 80 00
	     29 01 00 00 00 00 17
                            C4 70 00 00 00 00 00 00 00 00 0C 06 00 00 00 00 00 00 00 00 00 0C 06
            29 01 00 00 00 00 29
				C6 00 08 67 08 67 00 00 00 00 00 00 00 00 00 00 00 00 16 18 08 00 08 67 08 67 00 00 00 00 00 00 00 00 00 00 00 00 16 18 08
    /*        29 01 00 00 00 00 1F    
                            C7 00 13 1a 22 2f 3b 44 52 36 3c 4f 5f 67 6b 72 00 13 1a 22 2f 3b 44 52 36 3c 4f 5f 67 6b 72     */
            29 01 00 00 00 00 14
				C8 00 00 00 00 00 fc 00 00 00 00  00 fc 00 00 00 00 00 fc 00
	     29 01 00 00 00 00 0A
				CB 31 FC 3F 8C 00 00 00 00 C0
	     23 01 00 00 00 00 02
                            CC 0B
            29 01 00 00 00 00 0B
				D0 11 81 BB 19 99 4C 19 19 0c 00
            29 01 00 00 00 00 1A
				D3 1B 33 BB BB B3 33 33 33 01 01 00 A0 D8 A0 0D 48 48 44 3B 32 72 07 3D BF 33
            29 01 00 00 00 00 08
				D5 05 00 00 01 4a 01 4a
            23 01 00 00 00 00 02
				D6 01
		     05 01 00 00 0A 00 02 29 00
            05 01 00 00 78 00 02 11 00

	     
		];
		qcom,mdss-dsi-off-command = [05 01 00 00 32 00 02 28 00
					05 01 00 00 78 00 02 10 00];

		qcom,mdss-dsi-on-command-state = "dsi_lp_mode";
		qcom,mdss-dsi-off-command-state = "dsi_hs_mode";
		qcom,mdss-dsi-h-sync-pulse = <1>;
		qcom,mdss-dsi-traffic-mode = "non_burst_sync_event";
		qcom,mdss-dsi-lane-map = "lane_map_3012";
		qcom,mdss-dsi-bllp-eof-power-mode;
		qcom,mdss-dsi-bllp-power-mode;
		qcom,mdss-dsi-lane-0-state;
		qcom,mdss-dsi-lane-1-state;
		qcom,mdss-dsi-lane-2-state;
		qcom,mdss-dsi-lane-3-state;
		qcom,mdss-dsi-panel-timings = [d7 1c 12 00 42 42 18 20 17 03 04 00];
		qcom,mdss-dsi-t-clk-post = <0x04>;
		qcom,mdss-dsi-t-clk-pre = <0x24>;
		qcom,mdss-dsi-bl-min-level = <1>;
		qcom,mdss-dsi-bl-max-level = <255>;
		qcom,mdss-dsi-interleave-mode = <0>;
		qcom,mdss-dsi-dma-trigger = "trigger_sw";
		qcom,mdss-dsi-mdp-trigger = "none";
		qcom,mdss-dsi-bl-pmic-control-type = "bl_ctrl_wled";
		qcom,mdss-dsi-reset-sequence = <1 20>, <0 2>, <1 20>;
	};
};
