/* Copyright (c) 2013, The Linux Foundation. All rights reserved.
 *
 * This program is free software; you can redistribute it and/or modify
 * it under the terms of the GNU General Public License version 2 and
 * only version 2 as published by the Free Software Foundation.
 *
 * This program is distributed in the hope that it will be useful,
 * but WITHOUT ANY WARRANTY; without even the implied warranty of
 * MERCHANTABILITY or FITNESS FOR A PARTICULAR PURPOSE.  See the
 * GNU General Public License for more details.
 */

/*---------------------------------------------------------------------------
 * This file is autogenerated file using gcdb parser. Please do not edit it.
 * Update input XML file to add a new entry or update variable in this file
 * VERSION = "1.0"
 *---------------------------------------------------------------------------*/
&mdss_mdp {
	dsi_orise8012a_tmfwvga_cmd: qcom,mdss_dsi_orise8012a_tmfwvga_cmd {
		qcom,mdss-dsi-panel-name = "orise8012a tmfwvga command mode dsi panel";
		qcom,mdss-dsi-project-name = "pd1309f_ex";
		qcom,mdss-dsi-panel-controller = <&mdss_dsi0>;
		qcom,mdss-dsi-panel-type = "dsi_cmd_mode";
		qcom,mdss-dsi-panel-destination = "display_1";
		qcom,mdss-dsi-panel-framerate = <60>;
		qcom,mdss-dsi-virtual-channel-id = <0>;
		qcom,mdss-dsi-stream = <0>;
		qcom,mdss-dsi-panel-id = <0x10>;
		qcom,mdss-dsi-panel-width = <480>;
		qcom,mdss-dsi-panel-height = <854>;
		qcom,mdss-dsi-h-front-porch = <76>;
		qcom,mdss-dsi-h-back-porch = <76>;
		qcom,mdss-dsi-h-pulse-width = <70>;//5
		qcom,mdss-dsi-h-sync-skew = <0>;
		qcom,mdss-dsi-v-back-porch = <27>;
		qcom,mdss-dsi-v-front-porch = <6>;//16
		qcom,mdss-dsi-v-pulse-width = <5>;
		qcom,mdss-dsi-h-left-border = <0>;
		qcom,mdss-dsi-h-right-border = <0>;
		qcom,mdss-dsi-v-top-border = <0>;
		qcom,mdss-dsi-v-bottom-border = <0>;
		qcom,mdss-dsi-bpp = <24>;
		qcom,mdss-dsi-underflow-color = <0xff>;
		qcom,mdss-dsi-border-color = <0>;
		qcom,mdss-dsi-on-command = [
		      39 01 00 00 00 00 02 00 00                                                                                            
					39 01 00 00 00 00 04 FF 80 12 01                                                                                    
					39 01 00 00 00 00 02 00 80                                                                                           
					39 01 00 00 00 00 03 FF 80 12                                                                                      
					39 01 00 00 00 00 02 00 B4                                                                                          
					39 01 00 00 00 00 02 C0 55	                                                                                         
					39 01 00 00 00 00 02 00 90                                                                                         
					39 01 00 00 00 00 04 C5 02 76 01		                                                                                   
					39 01 00 00 00 00 02 00 00                                                                                           
					39 01 00 00 00 00 03 D8 6A 6A	                                                                                     
					39 01 00 00 00 00 02 00 81                                                                                           
					39 01 00 00 00 00 02 C0 57                                                                                  
					39 01 00 00 00 00 02 00 90	                                                                                           
					39 01 00 00 00 00 02 B3 02			                                                                                       
					39 01 00 00 00 00 02 00 80	                                                                                                               
					39 01 00 00 00 00 03 C1 25 55                                                                                        
					39 01 00 00 00 00 02 00 81	                                                                                           			
				  39 01 00 00 00 00 02 C4 83		                                                                                         			  
					39 01 00 00 00 00 02 00 82	 		                                                                                     			  
					39 01 00 00 00 00 02 C5 a0	 	                                                                                         			  
					39 01 00 00 00 00 02 00 B1                                                                                           			   
					39 01 00 00 00 00 02 C5 20
                    39 01 00 00 00 00 02 00 C6                                                                                           			   
					39 01 00 00 00 00 02 B0 01						
					39 01 00 00 00 00 02 00 80                                                                                          
					39 01 00 00 00 00 0D CE 8a 03 00 89 03 00 88 03 00 87 03 00                                              
					39 01 00 00 00 00 02 00 90                                                                              
					39 01 00 00 00 00 0D CE 38 0e 00 38 0d 00 00 00 00 00 00 00                                               
					39 01 00 00 00 00 02 00 A0                                                                               
					39 01 00 00 00 00 0F CE 38 06 03 56 00 18 00 38 05 03 57 00 18 00                                     
					39 01 00 00 00 00 02 00 b0                                                                             
					39 01 00 00 00 00 0F CE 38 04 03 58 00 18 00 38 03 03 59 00 18 00                                     
					39 01 00 00 00 00 02 00 c0                                                                          
					39 01 00 00 00 00 0F CE 38 02 03 5a 00 18 00 38 01 03 5b 00 18 00                                     
					39 01 00 00 00 00 02 00 d0                                                                             
					39 01 00 00 00 00 0F CE 38 00 03 5c 00 18 00 30 00 03 5d 00 18 00                                 
					39 01 00 00 00 00 02 00 C0                                                                           
					39 01 00 00 00 00 0C CF 02 02 20 20 00 00 01 00 00 00 00                                             
					39 01 00 00 00 00 02 00 C0                                                                             
					39 01 00 00 00 00 10 CB 15 15 00 00 15 15 15 15 15 15 15 00 00 00 00                                    
					39 01 00 00 00 00 02 00 d0                                                                            
					39 01 00 00 00 00 10 CB 00 00 00 00 00 00 00 00 00 00 15 15 15 15 15                                   
					39 01 00 00 00 00 02 00 e0                                                                            
					39 01 00 00 00 00 0B CB 15 15 00 00 15 15 00 00 00 00                                           
					39 01 00 00 00 00 02 00 80                                                                      
					39 01 00 00 00 00 0B CC 26 25 00 00 0C 0A 10 0E 02 04                                           
					39 01 00 00 00 00 02 00 90                                                                    
					39 01 00 00 00 00 10 CC 06 00 00 00 00 00 00 00 00 00 00 00 00 00 00                            
					39 01 00 00 00 00 02 00 a0                                                                      
					39 01 00 00 00 00 10 CC 05 03 01 0d 0f 09 0b 00 00 25 26 00 00 00 00                            
					39 01 00 00 00 00 02 00 b0                                                                      
					39 01 00 00 00 00 0B CC 25 26 00 00 0b 0d 0f 09 01 03                                           
					39 01 00 00 00 00 02 00 c0                                                                       
					39 01 00 00 00 00 10 CC 05 00 00 00 00 00 00 00 00 00 00 00 00 00 00                              
					39 01 00 00 00 00 02 00 d0                                                                       
					39 01 00 00 00 00 10 CC 06 04 02 0a 10 0e 0c 00 00 26 25 00 00 00 00                              
					39 01 00 00 00 00 02 00 00                                                                         
					39 01 00 00 00 00 15 E1 10 3d 4d 5b 6d 7a 7c a6 95 ad 58 44 58 37 36 2b 1e 11 0a 03		     
					39 01 00 00 00 00 02 00 00                                                                   
					39 01 00 00 00 00 15 E2 10 3d 4d 5b 6d 7a 7c a6 95 ad 58 44 58 37 36 2b 1e 11 0a 03
					39 01 00 00 00 00 02 00 00
					39 01 00 00 00 00 22 EC 40 44 44 44 44 44 44 44 44 44 44 44 44 44 44 44 44 44 44 44 44 44 44 44 44 44 44 44 44 44 44 44 04
					39 01 00 00 00 00 02 00 00
					39 01 00 00 00 00 22 ED 40 43 43 34 34 44 43 43 34 34 34 44 43 43 34 34 44 43 43 34 34 44 43 43 34 34 34 44 43 43 34 34 04
					39 01 00 00 00 00 02 00 00
					39 01 00 00 00 00 22 EE 40 34 44 34 44 34 44 34 44 34 44 34 44 34 44 34 44 34 44 34 44 34 44 34 44 34 44 34 44 34 44 34 04  
					39 01 00 00 00 00 02 00 83                                                                                    
					39 01 00 00 00 00 02 c1 50                                                                                     
					39 01 00 00 00 00 02 00 80                                                                                     
					39 01 00 00 00 00 02 c4 30                                                                                     
					39 01 00 00 00 00 02 00 8A                                                                                     
					39 01 00 00 00 00 02 c4 40                                                                                     
					39 01 00 00 00 00 02 00 92                                                                                     
					39 01 00 00 00 00 02 c4 08                                                                                     
					39 01 00 00 00 00 02 00 B1                                                                                     
					39 01 00 00 00 00 02 B0 B2                                                                                     
					39 01 00 00 00 00 02 00 91                                                                                     
					39 01 00 00 00 00 02 C1 08                                                                                     
					39 01 00 00 00 00 02 00 AA                                                                                     
					39 01 00 00 00 00 02 C0 AA                                                                                     
					39 01 00 00 00 00 02 00 D0
					39 01 00 00 00 00 02 C0 C0     
					39 01 00 00 00 00 02 00 80                                                                                     
					39 01 00 00 00 00 03 FF FF FF                                                                                  
					39 01 00 00 00 00 02 00 00                                                                                    
					39 01 00 00 00 00 04 FF FF FF FF                                                                            
					39 01 00 00 00 00 02 00 00
                    39 01 00 00 00 00 03 99 35 45	
                    05 01 00 00 00 00 02 35 00		
					05 01 00 00 78 00 02 11 00
					05 01 00 00 14 00 02 29 00
					39 01 00 00 00 00 02 00 00
					39 01 00 00 00 00 03 99 00 00
			];
		qcom,mdss-dsi-off-command = [
		      39 01 00 00 00 00 02 00 00
		      39 01 00 00 00 00 03 99 35 45
		      05 01 00 00 32 00 02 28 00
					05 01 00 00 78 00 02 10 00
					39 01 00 00 00 00 02 00 00
          39 01 00 00 00 00 03 99 00 00
          ];
		qcom,mdss-dsi-on-command-state = "dsi_lp_mode";
		qcom,mdss-dsi-off-command-state = "dsi_lp_mode";
		qcom,mdss-dsi-h-sync-pulse = <1>;
		qcom,mdss-dsi-traffic-mode = "burst_mode";
		qcom,mdss-dsi-bllp-eof-power-mode;
		qcom,mdss-dsi-bllp-power-mode;
		qcom,mdss-dsi-lane-0-state;
		qcom,mdss-dsi-lane-1-state;
		/*qcom,mdss-dsi-lane-2-state;
		qcom,mdss-dsi-lane-3-state;*/
		qcom,mdss-dsi-lp11-init;
		qcom,mdss-dsi-init-delay-us = <10000>;
		qcom,mdss-dsi-te-pin-select = <24>;
		qcom,mdss-dsi-wr-mem-start = <0x2c>;
		qcom,mdss-dsi-te-dcs-command = <1>;
		qcom,mdss-dsi-te-check-enable;
		qcom,mdss-dsi-te-using-te-pin;
		qcom,mdss-dsi-panel-timings = [83 1c 12 00 40 42 18 28 23 03 04 00];
		qcom,mdss-dsi-t-clk-post = <0x04>;
		qcom,mdss-dsi-t-clk-pre = <0x1B>;
		qcom,mdss-dsi-bl-min-level = <1>;
		qcom,mdss-dsi-bl-max-level = <255>;
		qcom,mdss-dsi-dma-trigger = "trigger_sw";
		qcom,mdss-dsi-mdp-trigger = "none";
		qcom,mdss-dsi-bl-pmic-control-type = "bl_ctrl_wled";
	//	qcom,mdss-dsi-bl-pmic-pwm-frequency = <42>;
	//	qcom,mdss-dsi-bl-pmic-bank-select = <3>;
	//	qcom,mdss-dsi-pwm-gpio = <&pm8226_mpps 2 0>;
	//	qcom,mdss-dsi-bl-pmic-bank-select-rc = <1>;
	//	qcom,mdss-dsi-pwm-gpio-rc = <&pm8226_gpios 3 0>;
	//	qcom,mdss-dsi-bl-pmic-pwm-frequency-rc = <47>;
		qcom,mdss-dsi-reset-sequence = <1 20>, <0 20>, <1 20>;
		/*qcom,mdss-pan-physical-width-dimension = <59>;
		qcom,mdss-pan-physical-height-dimension = <104>;*/

	};
};
