/* Copyright (c) 2013-2014, The Linux Foundation. All rights reserved.
 *
 * This program is free software; you can redistribute it and/or modify
 * it under the terms of the GNU General Public License version 2 and
 * only version 2 as published by the Free Software Foundation.
 *
 * This program is distributed in the hope that it will be useful,
 * but WITHOUT ANY WARRANTY; without even the implied warranty of
 * MERCHANTABILITY or FITNESS FOR A PARTICULAR PURPOSE.  See the
 * GNU General Public License for more details.
 */

&mdss_mdp {
	dsi_pd1505l_otm9605a_540_baoming_vid: qcom,mdss_dsi_pd1505l_otm9605a_540p_video_baoming {
		qcom,mdss-dsi-panel-name = "pd1505l otm9605a 540p video mode baoming dsi panel";
		qcom,mdss-dsi-project-name = "pd1505l";
		qcom,mdss-dsi-panel-controller = <&mdss_dsi0>;                                        
		qcom,mdss-dsi-panel-type = "dsi_video_mode";                                               
		qcom,mdss-dsi-panel-destination = "display_1";                                        
		qcom,mdss-dsi-panel-id = <0x31>;                                                                 
		qcom,mdss-dsi-panel-framerate = <60>;
		qcom,mdss-dsi-virtual-channel-id = <0>;
		qcom,mdss-dsi-stream = <0>;
		qcom,mdss-dsi-panel-width = <540>;
		qcom,mdss-dsi-panel-height = <960>;
		qcom,mdss-dsi-h-front-porch = <35>; 
		qcom,mdss-dsi-h-back-porch = <100>;  
		qcom,mdss-dsi-h-pulse-width = <4>;
		qcom,mdss-dsi-h-sync-skew = <0>;
		qcom,mdss-dsi-v-back-porch = <16>;
		qcom,mdss-dsi-v-front-porch = <15>;
		qcom,mdss-dsi-v-pulse-width = <4>;
		qcom,mdss-dsi-h-left-border = <0>;
		qcom,mdss-dsi-h-right-border = <0>;
		qcom,mdss-dsi-v-top-border = <0>;
		qcom,mdss-dsi-v-bottom-border = <0>;
		qcom,mdss-dsi-bpp = <24>;
		qcom,mdss-dsi-underflow-color = <0x00>;
		qcom,mdss-dsi-border-color = <0>;
		qcom,mdss-dsi-pixel-packing = "tight";
		qcom,mdss-dsi-on-command = [
					29 01 00 00 00 00 02 00 00 
                    29 01 00 00 00 00 04 FF 96 05 01 
                    29 01 00 00 00 00 02 00 80 
                    29 01 00 00 00 00 03 FF 96 05 
                    29 01 00 00 00 00 02 00 92 
                    29 01 00 00 00 00 03 FF 10 02 
                    29 01 00 00 00 00 02 00 A6 
                    29 01 00 00 00 00 02 C1 01 
                    29 01 00 00 00 00 02 00 89 
                    29 01 00 00 00 00 02 C0 01 
                    29 01 00 00 00 00 02 00 80 
                    29 01 00 00 00 00 03 C1 36 66 
                    29 01 00 00 00 00 02 00 B1 
                    29 01 00 00 00 00 02 C5 28 
                    29 01 00 00 00 00 02 00 80 
                    29 01 00 00 00 00 02 C4 9A 
                    29 01 00 00 00 00 02 00 C0 
                    29 01 00 00 00 00 02 C5 00 
                    29 01 00 00 00 00 02 00 B2 
                    29 01 00 00 00 00 05 F5 15 00 15 00 
                    29 01 00 00 00 00 02 00 93 
                    29 01 00 00 00 00 02 C5 03 
                    29 01 00 00 00 00 02 00 A0 
                    29 01 00 00 00 00 02 C1 00 
                    29 01 00 00 00 00 02 00 C5 
                    29 01 00 00 00 00 02 B0 03 
                    29 01 00 00 00 00 02 00 91 
                    29 01 00 00 00 00 02 C5 19 
                    29 01 00 00 00 00 02 00 92 
                    29 01 00 00 00 00 02 C5 01 
                    29 01 00 00 00 00 02 00 00 
                    29 01 00 00 00 00 03 D8 67 67 
                    29 01 00 00 00 00 02 00 00 
                    29 01 00 00 00 00 11 E1 00 13 1a 0e 07 10 0b 0b 03 07 0c 08 0f 0C 08 00 
                    29 01 00 00 00 00 02 00 00 
                    29 01 00 00 00 00 11 E2 00 13 1a 0e 07 10 0C 0a 03 06 0c 09 10 0C 07 00 
                    29 01 00 00 00 00 02 00 00 
                    29 01 00 00 00 00 22 EC 40 44 44 44 44 44 44 44 44 44 44 44 44 44 44 44 44 44 44 44 44 44 44 44 44 44 44 44 44 44 44 44 04 
                    29 01 00 00 00 00 02 00 00 
                    29 01 00 00 00 00 22 ED 40 34 44 44 34 44 44 43 44 34 44 44 34 44 44 43 44 34 44 44 34 44 44 43 44 34 44 44 34 44 44 43 04 
                    29 01 00 00 00 00 02 00 00 
                    29 01 00 00 00 00 22 EE 40 44 44 44 44 44 44 44 44 44 44 44 44 44 44 44 44 44 44 44 44 44 44 44 44 44 44 44 44 44 44 44 04 
                    29 01 00 00 00 00 02 00 80 
                    29 01 00 00 00 00 0B CB 00 00 00 00 00 00 00 00 00 00 
                    29 01 00 00 00 00 02 00 90 
                    29 01 00 00 00 00 10 CB 00 00 00 00 00 00 00 00 00 00 00 00 00 00 00 
                    29 01 00 00 00 00 02 00 A0 
                    29 01 00 00 00 00 10 CB 00 00 00 00 00 00 00 00 00 00 00 00 00 00 00 
                    29 01 00 00 00 00 02 00 B0 
                    29 01 00 00 00 00 0B CB 00 00 00 00 00 00 00 00 00 00 
                    29 01 00 00 00 00 02 00 C0 
                    29 01 00 00 00 00 10 CB 00 00 04 04 04 04 04 00 00 00 00 00 00 00 00 
                    29 01 00 00 00 00 02 00 D0 
                    29 01 00 00 00 00 10 CB 00 00 00 00 00 00 00 04 04 04 04 04 00 00 00 
                    29 01 00 00 00 00 02 00 E0 
                    29 01 00 00 00 00 0B CB 00 00 00 00 00 00 00 00 00 00 
                    29 01 00 00 00 00 02 00 F0 
                    29 01 00 00 00 00 0B CB FF FF FF FF FF FF FF FF FF FF 
                    29 01 00 00 00 00 02 00 80 
                    29 01 00 00 00 00 0B CC 00 00 0B 09 01 25 26 00 00 00 
                    29 01 00 00 00 00 02 00 90 
                    29 01 00 00 00 00 10 CC 00 00 00 00 00 00 00 00 00 00 00 00 0C 0A 02 
                    29 01 00 00 00 00 02 00 A0 
                    29 01 00 00 00 00 10 CC 25 26 00 00 00 00 00 00 00 00 00 00 00 00 00 
                    29 01 00 00 00 00 02 00 B0 
                    29 01 00 00 00 00 0B CC 00 00 0A 0C 02 26 25 00 00 00 
                    29 01 00 00 00 00 02 00 C0 
                    29 01 00 00 00 00 10 CC 00 00 00 00 00 00 00 00 00 00 00 00 09 0B 01 
                    29 01 00 00 00 00 02 00 D0 
                    29 01 00 00 00 00 10 CC 26 25 00 00 00 00 00 00 00 00 00 00 00 00 00 
                    29 01 00 00 00 00 02 00 80 
                    29 01 00 00 00 00 0D CE 86 01 00 85 01 00 0F 00 00 0F 00 00 
                    29 01 00 00 00 00 02 00 90 
                    29 01 00 00 00 00 0F CE F0 00 00 F0 00 00 F0 00 00 F0 00 00 00 00 
                    29 01 00 00 00 00 02 00 A0 
                    29 01 00 00 00 00 0F CE 18 03 83 C2 87 0B 00 18 02 83 C4 86 0B 00 
                    29 01 00 00 00 00 02 00 B0 
                    29 01 00 00 00 00 0F CE 18 05 83 C3 00 04 00 18 04 83 C5 00 04 00 
                    29 01 00 00 00 00 02 00 C0 
                    29 01 00 00 00 00 0F CE F0 00 00 10 00 00 00 F0 00 00 10 00 00 00 
                    29 01 00 00 00 00 02 00 D0 
                    29 01 00 00 00 00 0F CE F0 00 00 10 00 00 00 F0 00 00 10 00 00 00 
                    29 01 00 00 00 00 02 00 C0 
                    29 01 00 00 00 00 0B CF 02 02 20 20 00 00 01 81 00 07 
                    29 01 00 00 00 00 02 00 B4 
                    29 01 00 00 00 00 03 C0 50 48 
                    29 01 00 00 00 00 02 00 D2 
                    29 01 00 00 00 00 02 B0 04 
                    29 01 00 00 00 00 02 00 94 
                    29 01 00 00 00 00 03 C5 55 55 
                    29 01 00 00 00 00 02 00 80 
                    29 01 00 00 00 00 0F CF F0 00 00 10 00 00 00 F0 00 00 10 00 00 00 
                    29 01 00 00 00 00 02 00 90 
                    29 01 00 00 00 00 0F CF F0 00 00 10 00 00 00 F0 00 00 10 00 00 00 
                    29 01 00 00 00 00 02 00 A0 
                    29 01 00 00 00 00 0F CF F0 00 00 10 00 00 00 F0 00 00 10 00 00 00 
                    29 01 00 00 00 00 02 00 B0 
                    29 01 00 00 00 00 0F CF F0 00 00 10 00 00 00 F0 00 00 10 00 00 00 
                    29 01 00 00 00 00 02 00 84 
                    29 01 00 00 00 00 02 C4 00 
                    29 01 00 00 00 00 02 00 86 
                    29 01 00 00 00 00 02 C4 00 
                    //resolve green screen
					29 01 00 00 00 00 02 00 80 
                    29 01 00 00 00 00 03 FF 00 00
					29 01 00 00 00 00 02 00 00 
                    29 01 00 00 00 00 04 FF 00 00 00
					//end
                    29 01 00 00 78 00 02 11 00 
                    29 01 00 00 14 00 02 29 00   
					];
		qcom,mdss-dsi-off-command = [05 01 00 00 14 00 02 28 00
					05 01 00 00 78 00 02 10 00];
		qcom,mdss-dsi-on-command-state = "dsi_lp_mode";
		qcom,mdss-dsi-off-command-state = "dsi_hs_mode";
		qcom,mdss-dsi-h-sync-pulse = <1>;
		qcom,mdss-dsi-traffic-mode = "burst_mode";
		qcom,mdss-dsi-bllp-eof-power-mode;
		qcom,mdss-dsi-bllp-power-mode;
		qcom,mdss-dsi-hbp-power-mode;
		qcom,mdss-dsi-lane-0-state;
		qcom,mdss-dsi-lane-1-state;
		//qcom,mdss-dsi-lane-2-state;
		//qcom,mdss-dsi-lane-3-state;

		// 2 line timing  242Mhz
		qcom,mdss-dsi-panel-timings = [8B 1E 14 00 44 48 18 22 19 03 04 00];
		qcom,mdss-dsi-t-clk-post = <0x04>;
		qcom,mdss-dsi-t-clk-pre = <0x19>;  

		qcom,mdss-dsi-lp11-init;
		qcom,mdss-dsi-init-delay-us = <10000>;
		qcom,mdss-dsi-bl-min-level = <1>;
		qcom,mdss-dsi-bl-max-level = <255>;
		qcom,mdss-dsi-dma-trigger = "trigger_sw";
		qcom,mdss-dsi-mdp-trigger = "none";
		qcom,mdss-dsi-reset-sequence = <1 5>, <0 1>, <1 20>;
		qcom,mdss-pan-physical-width-dimension = <58>;
		qcom,mdss-pan-physical-height-dimension = <103>;
		qcom,esd-check-enabled;
		qcom,mdss-dsi-panel-status-command = [06 01 00 01 05 00 02 0A 08];
		qcom,mdss-dsi-panel-status-command-state = "dsi_lp_mode";
		qcom,mdss-dsi-panel-status-check-mode = "reg_read";
		qcom,mdss-dsi-panel-status-value = <0x9c>;
		qcom,mdss-dsi-rx-eot-ignore;
		qcom,mdss-dsi-tx-eot-append;
	};
};
