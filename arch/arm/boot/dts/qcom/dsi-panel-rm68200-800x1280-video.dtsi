/* Copyright (c) 2013, The Linux Foundation. All rights reserved.
 *
 * This program is free software; you can redistribute it and/or modify
 * it under the terms of the GNU General Public License version 2 and
 * only version 2 as published by the Free Software Foundation.
 *
 * This program is distributed in the hope that it will be useful,
 * but WITHOUT ANY WARRANTY; without even the implied warranty of
 * MERCHANTABILITY or FITNESS FOR A PARTICULAR PURPOSE.  See the
 * GNU General Public License for more details.
 */

/*---------------------------------------------------------------------------
 * This file is autogenerated file using gcdb parser. Please do not edit it.
 * Update input XML file to add a new entry or update variable in this file
 * VERSION = "1.0"
 *---------------------------------------------------------------------------*/
&mdss_mdp {
	dsi_rm68200_800x1280_video: qcom,mdss_dsi_rm68200_800x1280_video {
		qcom,mdss-dsi-panel-name = "rm68200 800x1280 video mode dsi panel";
		qcom,mdss-dsi-panel-controller = <&mdss_dsi0>;
		qcom,mdss-dsi-panel-type = "dsi_video_mode";
		qcom,mdss-dsi-panel-destination = "display_1";
		qcom,mdss-dsi-panel-framerate = <60>;
		qcom,mdss-dsi-virtual-channel-id = <0>;
		qcom,mdss-dsi-stream = <0>;
		qcom,mdss-dsi-panel-width = <800>;
		qcom,mdss-dsi-panel-height = <1280>;
		qcom,mdss-dsi-h-front-porch = <100>;
		qcom,mdss-dsi-h-back-porch = <80>;
		qcom,mdss-dsi-h-pulse-width = <24>;
		qcom,mdss-dsi-h-sync-skew = <0>;
		qcom,mdss-dsi-v-back-porch = <24>;
		qcom,mdss-dsi-v-front-porch = <24>;
		qcom,mdss-dsi-v-pulse-width = <10>;
		qcom,mdss-dsi-h-left-border = <0>;
		qcom,mdss-dsi-h-right-border = <0>;
		qcom,mdss-dsi-v-top-border = <0>;
		qcom,mdss-dsi-v-bottom-border = <0>;
		qcom,mdss-pan-physical-width-dimension = <107>;
		qcom,mdss-pan-physical-height-dimension = <172>;
		qcom,mdss-dsi-bpp = <24>;
		qcom,mdss-dsi-color-order = "rgb_swap_rgb";
		qcom,mdss-dsi-underflow-color = <0x00>;
		qcom,mdss-dsi-border-color = <0>;
		qcom,mdss-dsi-on-command = [29 01 00 00 00 00 02 FE 04
				29 01 00 00 00 00 02 60 0A
				29 01 00 00 00 00 02 61 0B
				29 01 00 00 00 00 02 62 0F
				29 01 00 00 00 00 02 63 0C
				29 01 00 00 00 00 02 64 04
				29 01 00 00 00 00 02 65 0E
				29 01 00 00 00 00 02 66 0E
				29 01 00 00 00 00 02 67 0A
				29 01 00 00 00 00 02 68 16
				29 01 00 00 00 00 02 69 0B
				29 01 00 00 00 00 02 6A 13
				29 01 00 00 00 00 02 6B 07
				29 01 00 00 00 00 02 6C 0E
				29 01 00 00 00 00 02 6D 15
				29 01 00 00 00 00 02 6E 0D
				29 01 00 00 00 00 02 6F 00
				29 01 00 00 00 00 02 70 00
				29 01 00 00 00 00 02 71 0B
				29 01 00 00 00 00 02 72 0F
				29 01 00 00 00 00 02 73 0C
				29 01 00 00 00 00 02 74 04
				29 01 00 00 00 00 02 75 0E
				29 01 00 00 00 00 02 76 0E
				29 01 00 00 00 00 02 77 0A
				29 01 00 00 00 00 02 78 16
				29 01 00 00 00 00 02 79 0B
				29 01 00 00 00 00 02 7A 13
				29 01 00 00 00 00 02 7B 07
				29 01 00 00 00 00 02 7C 0E
				29 01 00 00 00 00 02 7D 15
				29 01 00 00 00 00 02 7E 0D
				29 01 00 00 00 00 02 7F 00
				29 01 00 00 00 00 02 FE 00
				29 01 00 00 00 00 02 35 01
				29 01 00 00 78 00 01 11
				29 01 00 00 00 00 01 29];
		qcom,mdss-dsi-off-command = [29 01 00 00 78 00 02 28 00
				29 01 00 00 05 00 02 10 00];
		qcom,mdss-dsi-on-command-state = "dsi_lp_mode";
		qcom,mdss-dsi-off-command-state = "dsi_hs_mode";
		qcom,mdss-dsi-h-sync-pulse = <1>;
		qcom,mdss-dsi-traffic-mode = "non_burst_sync_event";
		qcom,mdss-dsi-lane-map = "lane_map_0123";
		qcom,mdss-dsi-bllp-eof-power-mode;
		qcom,mdss-dsi-bllp-power-mode;
		qcom,mdss-dsi-lp11-init;
		qcom,mdss-dsi-lane-0-state;
		qcom,mdss-dsi-lane-1-state;
		qcom,mdss-dsi-lane-2-state;
		qcom,mdss-dsi-lane-3-state;
		qcom,mdss-dsi-panel-timings = [8B 1E 14 00 44 48 18 22 19 03 04 00];
		qcom,mdss-dsi-t-clk-post = <0x4>;
		qcom,mdss-dsi-t-clk-pre = <0x1C>;
		qcom,mdss-dsi-bl-min-level = <1>;
		qcom,mdss-dsi-bl-max-level = <128>;
		qcom,mdss-dsi-dma-trigger = "trigger_sw";
		qcom,mdss-dsi-mdp-trigger = "none";
		qcom,mdss-dsi-bl-pmic-control-type = "bl_ctrl_cadiz";
		qcom,mdss-dsi-reset-sequence = <1 5>, <0 2>, <1 20>;
	};
};
