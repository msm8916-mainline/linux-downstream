/* Copyright (c) 2013, The Linux Foundation. All rights reserved.
 *
 * This program is free software; you can redistribute it and/or modify
 * it under the terms of the GNU General Public License version 2 and
 * only version 2 as published by the Free Software Foundation.
 *
 * This program is distributed in the hope that it will be useful,
 * but WITHOUT ANY WARRANTY; without even the implied warranty of
 * MERCHANTABILITY or FITNESS FOR A PARTICULAR PURPOSE.  See the
 * GNU General Public License for more details.
 */

/*---------------------------------------------------------------------------
 * This file is autogenerated file using gcdb parser. Please do not edit it.
 * Update input XML file to add a new entry or update variable in this file
 * VERSION = "1.0"
 *---------------------------------------------------------------------------*/
&mdss_mdp {
	dsi_s6d7aa0_800x1280_video: qcom,mdss_dsi_s6d7aa0_800x1280_video {
		qcom,mdss-dsi-panel-name = "s6d7aa0 800x1280 video mode dsi panel";
		qcom,mdss-dsi-panel-controller = <&mdss_dsi0>;
		qcom,mdss-dsi-panel-type = "dsi_video_mode";
		qcom,mdss-dsi-panel-destination = "display_1";
		qcom,mdss-dsi-panel-framerate = <60>;
		qcom,mdss-dsi-virtual-channel-id = <0>;
		qcom,mdss-dsi-stream = <0>;
		qcom,mdss-dsi-panel-width = <800>;
		qcom,mdss-dsi-panel-height = <1280>;
		qcom,mdss-dsi-h-front-porch = <40>;
		qcom,mdss-dsi-h-back-porch = <40>;
		qcom,mdss-dsi-h-pulse-width = <4>;
		qcom,mdss-dsi-h-sync-skew = <0>;
		qcom,mdss-dsi-v-back-porch = <15>;
		qcom,mdss-dsi-v-front-porch = <15>;
		qcom,mdss-dsi-v-pulse-width = <3>;
		qcom,mdss-dsi-h-left-border = <0>;
		qcom,mdss-dsi-h-right-border = <0>;
		qcom,mdss-dsi-v-top-border = <0>;
		qcom,mdss-dsi-v-bottom-border = <0>;
		qcom,mdss-dsi-bpp = <24>;
		qcom,mdss-dsi-color-order = "rgb_swap_rgb";
		qcom,mdss-dsi-underflow-color = <0xff>;
		qcom,mdss-dsi-border-color = <0>;
		qcom,mdss-dsi-on-command = [29 01 00 00 00 00 03 F0 5A 5A
				29 01 00 00 00 00 03 F1 5A 5A
				29 01 00 00 00 00 03 FC A5 A5
				29 01 00 00 00 00 03 D0 00 10
				29 01 00 00 00 00 02 B1 10
				29 01 00 00 00 00 05 B2 14 22 2F 04
				29 01 00 00 00 00 02 B5 01
				29 01 00 00 00 00 09 EE 00 00 1F 00 00 00 1F 00
				29 01 00 00 00 00 0E EF 56 34 43 65 90 80 24 80 00 91 11 11 11
				29 01 00 00 00 00 21 F7 04 08 09 0A 0B 0C 0D 0E 0F 16 17 10 01 01 01 01 04 08 09 0A 0B 0C 0D 0E 0F 16 17 10 01 01 01 01
				29 01 00 00 00 00 06 F2 02 08 08 40 10
				29 01 00 00 00 00 07 F6 60 25 26 00 00 00
				29 01 00 00 00 00 12 FA 04 35 07 0B 12 0B 10 16 1A 24 2C 33 3B 3B 33 34 33
				29 01 00 00 00 00 12 FB 04 35 07 0B 12 0B 10 16 1A 24 2C 33 3B 3B 33 34 33
				29 01 00 00 00 00 0B F3 01 C4 E0 62 D4 83 37 3C 24 00
				29 01 00 00 00 00 24 F4 00 02 03 26 03 02 09 00 07 16 16 03 00 08 08 03 19 1C 12 1C 1D 1E 1A 09 01 04 02 61 74 75 72 83 80 80 F0
				29 01 00 00 00 00 02 B0 01
				29 01 00 00 00 00 14 F5 2F 2F 5F AB 98 52 0F 33 43 04 59 54 52 05 40 40 5D 59 40
				29 01 00 00 00 00 04 BC 01 4E 08
				29 01 00 00 00 00 06 E1 03 10 1C A0 10
				29 01 00 00 00 00 06 FD 16 10 11 20 09
				29 01 00 00 00 00 01 35
				29 01 00 00 1E 00 01 11
				29 01 00 00 96 00 04 C3 40 00 28
				29 01 00 00 C8 00 01 29];
		qcom,mdss-dsi-off-command = [29 01 00 00 50 00 01 28
				29 01 00 00 00 00 04 C3 40 00 20
				29 01 00 00 22 00 01 10];
		qcom,mdss-dsi-on-command-state = "dsi_lp_mode";
		qcom,mdss-dsi-off-command-state = "dsi_hs_mode";
		qcom,mdss-dsi-h-sync-pulse = <1>;
		qcom,mdss-dsi-traffic-mode = "non_burst_sync_event";
		qcom,mdss-dsi-lane-map = "lane_map_0123";
		qcom,mdss-dsi-bllp-eof-power-mode;
		qcom,mdss-dsi-bllp-power-mode;
		qcom,mdss-dsi-lane-0-state;
		qcom,mdss-dsi-lane-1-state;
		qcom,mdss-dsi-lane-2-state;
		qcom,mdss-dsi-lane-3-state;
		qcom,mdss-dsi-panel-timings = [7b 1a 10 00 3e 40 16 1e 15 03 04 00];
		qcom,mdss-dsi-t-clk-post = <0x4>;
		qcom,mdss-dsi-t-clk-pre = <0x1a>;
		qcom,mdss-dsi-bl-min-level = <1>;
		qcom,mdss-dsi-bl-max-level = <128>;
		qcom,mdss-dsi-dma-trigger = "trigger_sw";
		qcom,mdss-dsi-mdp-trigger = "none";
		qcom,mdss-dsi-bl-pmic-control-type = "bl_ctrl_cadiz";
		qcom,mdss-dsi-reset-sequence = <1 5>, <0 2>, <1 120>;
	};
};
