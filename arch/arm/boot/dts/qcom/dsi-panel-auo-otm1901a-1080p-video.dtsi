/* Copyright (c) 2013, The Linux Foundation. All rights reserved.
 *
 * This program is free software; you can redistribute it and/or modify
 * it under the terms of the GNU General Public License version 2 and
 * only version 2 as published by the Free Software Foundation.
 *
 * This program is distributed in the hope that it will be useful,
 * but WITHOUT ANY WARRANTY; without even the implied warranty of
 * MERCHANTABILITY or FITNESS FOR A PARTICULAR PURPOSE.  See the
 * GNU General Public License for more details.
 */

/*---------------------------------------------------------------------------
 * This file is autogenerated file using gcdb parser. Please do not edit it.
 * Update input XML file to add a new entry or update variable in this file
 * VERSION = "1.0"
 *---------------------------------------------------------------------------*/
&mdss_mdp {
	dsi_auo_otm1901a_1080p_video: qcom,mdss_dsi_auo_otm1901a_1080p_video {
		qcom,mdss-dsi-panel-name = "auo otm1901a 1080p video mode dsi panel";
		qcom,mdss-dsi-panel-controller = <&mdss_dsi0>;
		qcom,mdss-dsi-panel-type = "dsi_video_mode";
		qcom,mdss-dsi-panel-destination = "display_1";
		qcom,mdss-dsi-panel-framerate = <60>;
		qcom,mdss-dsi-virtual-channel-id = <0>;
		qcom,mdss-dsi-stream = <0>;
		qcom,mdss-dsi-panel-width = <1080>;
		qcom,mdss-dsi-panel-height = <1920>;
		qcom,mdss-dsi-h-front-porch = <4>;
		qcom,mdss-dsi-h-back-porch = <52>;
		qcom,mdss-dsi-h-pulse-width = <52>;
		qcom,mdss-dsi-h-sync-skew = <0>;
		qcom,mdss-dsi-v-back-porch = <7>;
		qcom,mdss-dsi-v-front-porch = <8>;
		qcom,mdss-dsi-v-pulse-width = <1>;
		qcom,mdss-dsi-h-left-border = <0>;
		qcom,mdss-dsi-h-right-border = <0>;
		qcom,mdss-dsi-v-top-border = <0>;
		qcom,mdss-dsi-v-bottom-border = <0>;
		qcom,mdss-dsi-bpp = <24>;
		qcom,mdss-dsi-color-order = "rgb_swap_rgb";
		qcom,mdss-dsi-underflow-color = <0xff>;
		qcom,mdss-dsi-border-color = <0>;
		qcom,mdss-dsi-on-command = [29 01 00 00 00 00 02 00 00
	29 01 00 00 0A 00 05 FF 19 01 01 00
	29 01 00 00 00 00 02 00 80
	29 01 00 00 0A 00 03 FF 19 01
	29 01 00 00 00 00 02 00 00
	29 01 00 00 00 00 19 E1 0C 19 1F 2C 31 3A 44 54 5D 70 7C 83 77 73 6C 5C 49 38 2B 25 1A 13 07 02
	29 01 00 00 00 00 02 00 00
	29 01 00 00 00 00 19 E2 04 0F 1A 28 2E 35 40 51 5A 6D 78 81 77 70 6A 58 46 34 27 21 16 11 05 00
	29 01 00 00 00 00 02 00 00
	29 01 00 00 00 00 19 E3 0C 19 1F 2C 31 3A 44 54 5D 70 7C 83 77 73 6C 5C 49 38 2B 25 1A 13 07 02
	29 01 00 00 00 00 02 00 00
	29 01 00 00 00 00 19 E4 04 0F 1A 28 2E 35 40 51 5A 6D 78 81 77 70 6A 58 46 34 27 21 16 11 05 00
	29 01 00 00 00 00 02 00 00
	29 01 00 00 00 00 19 E5 0C 19 1F 2C 31 3A 44 54 5D 70 7C 83 77 73 6C 5C 49 38 2B 25 1A 13 07 02
	29 01 00 00 00 00 02 00 00
	29 01 00 00 00 00 19 E6 04 0F 1A 28 2E 35 40 51 5A 6D 78 81 77 70 6A 58 46 34 27 21 16 11 05 00
	29 01 00 00 00 00 02 00 00
	29 01 00 00 00 00 22 EC 50 44 53 44 44 44 44 44 44 44 44 44 44 44 44 44 44 44 44 44 44 44 44 44 44 44 44 44 44 44 44 44 03
	29 01 00 00 00 00 02 00 00
	29 01 00 00 00 00 22 ED 50 44 53 44 44 44 44 44 44 44 44 44 44 44 44 44 44 44 44 44 44 44 44 44 44 44 44 44 44 44 44 44 03
	29 01 00 00 00 00 02 00 00
	29 01 00 00 00 00 22 EE 50 44 53 44 44 44 44 44 44 44 44 44 44 44 44 44 44 44 44 44 44 44 44 44 44 44 44 44 44 44 44 44 03
	29 01 00 00 00 00 02 00 B0
	29 01 00 00 00 00 02 CA 04
	29 01 00 00 00 00 02 00 B3
	29 01 00 00 00 00 02 CA 48
	29 01 00 00 00 00 02 00 00
	29 01 00 00 00 00 04 FF FF FF FF 					
				29 01 00 00 00 00 02 51 23
				29 01 00 00 00 00 02 53 24
				29 01 00 00 00 00 02 5E 0C
				05 01 00 00 78 00 02 11 00
					05 01 00 00 00 00 02 29 00];
		qcom,mdss-dsi-off-command = [05 01 00 00 32 00 02 10 00
					29 01 00 00 00 00 02 53 00
					05 01 00 00 0A 00 02 28 00];
		qcom,mdss-dsi-on-command-state = "dsi_lp_mode";
		qcom,mdss-dsi-off-command-state = "dsi_lp_mode";
		qcom,mdss-dsi-h-sync-pulse = <1>;
		qcom,mdss-dsi-traffic-mode = "burst_mode";
		qcom,mdss-dsi-bllp-eof-power-mode;
		qcom,mdss-dsi-bllp-power-mode;
		qcom,mdss-dsi-lane-map = "lane_map_0123";
		qcom,mdss-dsi-lane-0-state;
		qcom,mdss-dsi-lane-1-state;
		qcom,mdss-dsi-lane-2-state;
		qcom,mdss-dsi-lane-3-state;
		qcom,mdss-dsi-panel-timings = [DB 36 22 00 62 66 28 3A 2B 03 04 00];
		qcom,mdss-dsi-t-clk-post = <0x03>;
		qcom,mdss-dsi-t-clk-pre = <0x29>;
		qcom,mdss-dsi-bl-min-level = <1>;
		qcom,mdss-dsi-bl-max-level = <255>;
		qcom,mdss-dsi-bl-pmic-pwm-frequency = <100>;
		qcom,mdss-dsi-bl-pmic-bank-select = <0>;
		qcom,mdss-dsi-dma-trigger = "trigger_sw";
		qcom,mdss-dsi-mdp-trigger = "none";
		qcom,mdss-dsi-bl-pmic-control-type = "bl_ctrl_dcs";
		qcom,mdss-dsi-reset-sequence = <1 1>, <0 1>, <1 5>;
		qcom,mdss-dsi-lp11-init;
		qcom,esd-check-enabled;
	        qcom,mdss-dsi-panel-status-command = [06 01 00 01 05 00 02 AC 00];
        	qcom,mdss-dsi-panel-status-command-state = "dsi_lp_mode";
	        qcom,mdss-dsi-panel-status-check-mode = "reg_read";
        	qcom,mdss-dsi-panel-status-value = <0x00>;
		qcom,mdss-pan-physical-width-dimension = <74>; //width of picture in mm (for xdpi)
		qcom,mdss-pan-physical-height-dimension = <132>; //height of picture in mm (for ydpi)
	};
};
