/* Copyright (c) 2013-2014, The Linux Foundation. All rights reserved.
 *
 * This program is free software; you can redistribute it and/or modify
 * it under the terms of the GNU General Public License version 2 and
 * only version 2 as published by the Free Software Foundation.
 *
 * This program is distributed in the hope that it will be useful,
 * but WITHOUT ANY WARRANTY; without even the implied warranty of
 * MERCHANTABILITY or FITNESS FOR A PARTICULAR PURPOSE.  See the
 * GNU General Public License for more details.
 */

&mdss_mdp {
	dsi_nt35596_1080_vid: qcom,mdss_dsi_nt35596_1080p_video {
		qcom,mdss-dsi-panel-name = "nt35596 1080p video mode dsi panel";
		qcom,mdss-dsi-panel-controller = <&mdss_dsi0>;
		qcom,mdss-dsi-panel-type = "dsi_video_mode";
		qcom,mdss-dsi-panel-destination = "display_1";
		qcom,mdss-dsi-panel-framerate = <60>;
		qcom,mdss-dsi-virtual-channel-id = <0>;
		qcom,mdss-dsi-stream = <0>;
		qcom,mdss-dsi-panel-id = <0x10>;
		qcom,mdss-dsi-panel-width = <1080>;
		qcom,mdss-dsi-panel-height = <1920>;
		qcom,mdss-dsi-h-front-porch = <60>;//30
		qcom,mdss-dsi-h-back-porch = <236>;//25
		qcom,mdss-dsi-h-pulse-width = <5>;//20
		qcom,mdss-dsi-h-sync-skew = <0>;
		qcom,mdss-dsi-v-back-porch = <8>;//6
		qcom,mdss-dsi-v-front-porch = <10>;////14
		qcom,mdss-dsi-v-pulse-width = <2>;
		qcom,mdss-dsi-h-left-border = <0>;
		qcom,mdss-dsi-h-right-border = <0>;
		qcom,mdss-dsi-v-top-border = <0>;
		qcom,mdss-dsi-v-bottom-border = <0>;
		qcom,mdss-dsi-bpp = <24>;
		qcom,mdss-dsi-underflow-color = <0xff>;
		qcom,mdss-dsi-border-color = <0>;
		qcom,mdss-dsi-on-command = [
		
			29 01 00 00 00 00 02 FF EE
			29 01 00 00 0A 00 02 18 40
			29 01 00 00 14 00 02 18 00
			29 01 00 00 00 00 02 FF 00
			29 01 00 00 00 00 02 FB 01
			29 01 00 00 00 00 02 35 01
			29 01 00 00 00 00 02 D3 0A
			29 01 00 00 00 00 02 D4 0A
			29 01 00 00 00 00 02 FF 01
			29 01 00 00 00 00 02 13 13
			29 01 00 00 00 00 02 FF 04
			29 01 00 00 00 00 02 FB 01
			29 01 00 00 00 00 02 08 04
			/*29 01 00 00 00 00 02 FF 01/////set VGH
			29 01 00 00 00 00 02 FB 01
			29 01 00 00 00 00 02 01 66
      29 01 00 00 00 00 02 02 50
      29 01 00 00 00 00 02 05 90
      29 01 00 00 00 00 02 06 14
      29 01 00 00 00 00 02 07 1E//*/			
			
			29 01 00 00 00 00 02 FF 00
			29 01 00 00 00 00 02 FB 01
			
			29 01 00 00 00 00 02 51 00
			29 01 00 00 00 00 02 53 24//2C
			29 01 00 00 00 00 02 55 01
			
			
			29 01 00 00 78 00 02 11 00
			29 01 00 00 14 00 02 29 00

];
		qcom,mdss-dsi-off-command = [05 01 00 00 32 00 02 28 00
					05 01 00 00 78 00 02 10 00];
		qcom,mdss-dsi-on-command-state = "dsi_lp_mode";
		qcom,mdss-dsi-off-command-state = "dsi_hs_mode";
		qcom,mdss-dsi-h-sync-pulse = <1>;
		qcom,mdss-dsi-traffic-mode = "burst_mode";
		qcom,mdss-dsi-lp11-init;
		qcom,mdss-dsi-init-delay-us = <10000>;
		qcom,mdss-dsi-bllp-eof-power-mode;
		qcom,mdss-dsi-bllp-power-mode;
		qcom,mdss-dsi-hbp-power-mode;////lrz add
		qcom,mdss-dsi-lane-0-state;
		qcom,mdss-dsi-lane-1-state;
		qcom,mdss-dsi-lane-2-state;
		qcom,mdss-dsi-lane-3-state;
		//qcom,mdss-dsi-panel-timings = [cf 32 20 00 5e 62 26 3A 2c 03 04 00];//f9 32 22 00 60 70 18 41 34 03 04 00
		qcom,mdss-dsi-panel-timings = [F8 3C 28 00 6e 72 2e 3E 35 03 04 00];
		qcom,mdss-dsi-t-clk-post = <0x02>;//1e
		qcom,mdss-dsi-t-clk-pre = <0x2D>;//38
		qcom,mdss-dsi-bl-min-level = <1>;
		qcom,mdss-dsi-bl-max-level = <255>;
		qcom,mdss-dsi-dma-trigger = "trigger_sw";
		qcom,mdss-dsi-mdp-trigger = "none";
		qcom,mdss-dsi-bl-pmic-control-type = "bl_ctrl_dcs";
		qcom,mdss-dsi-project-name = "pd1523a";
		qcom,mdss-pan-physical-width-dimension = <68>;
		qcom,mdss-pan-physical-height-dimension = <121>;
		qcom,mdss-dsi-reset-sequence = <1 5>, <0 5>, <1 5>,<0 5>, <1 20>;

	};
};
