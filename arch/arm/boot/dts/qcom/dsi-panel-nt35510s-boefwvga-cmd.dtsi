/* Copyright (c) 2013, The Linux Foundation. All rights reserved.
 *
 * This program is free software; you can redistribute it and/or modify
 * it under the terms of the GNU General Public License version 2 and
 * only version 2 as published by the Free Software Foundation.
 *
 * This program is distributed in the hope that it will be useful,
 * but WITHOUT ANY WARRANTY; without even the implied warranty of
 * MERCHANTABILITY or FITNESS FOR A PARTICULAR PURPOSE.  See the
 * GNU General Public License for more details.
 */

/*---------------------------------------------------------------------------
 * This file is autogenerated file using gcdb parser. Please do not edit it.
 * Update input XML file to add a new entry or update variable in this file
 * VERSION = "1.0"
 *---------------------------------------------------------------------------*/
&mdss_mdp {
	dsi_nt35510s_fwvga_cmd_boe: qcom,mdss_dsi_nt35510s_fwvga_cmd_boe {
		qcom,mdss-dsi-panel-name = "boent35510s fwvga command mode dsi panel";
		qcom,mdss-dsi-panel-controller = <&mdss_dsi0>;
		qcom,mdss-dsi-panel-type = "dsi_cmd_mode";
		qcom,mdss-dsi-panel-destination = "display_1";
		qcom,mdss-dsi-panel-framerate = <60>;
		qcom,mdss-dsi-virtual-channel-id = <0>;
		qcom,mdss-dsi-stream = <0>;
		qcom,mdss-dsi-panel-id = <0x30>;
		qcom,mdss-dsi-panel-width = <480>;
		qcom,mdss-dsi-panel-height = <854>;
		qcom,mdss-dsi-h-front-porch = <76>;
		qcom,mdss-dsi-h-back-porch = <76>;
		qcom,mdss-dsi-h-pulse-width = <70>;
		qcom,mdss-dsi-h-sync-skew = <0>;
		qcom,mdss-dsi-v-back-porch = <27>;
		qcom,mdss-dsi-v-front-porch = <6>;
		qcom,mdss-dsi-v-pulse-width = <5>;
		qcom,mdss-dsi-h-left-border = <0>;
		qcom,mdss-dsi-h-right-border = <0>;
		qcom,mdss-dsi-v-top-border = <0>;
		qcom,mdss-dsi-v-bottom-border = <0>;
		qcom,mdss-dsi-bpp = <24>;
		qcom,mdss-dsi-underflow-color = <0xff>;
		qcom,mdss-dsi-border-color = <0>;
		qcom,mdss-dsi-on-command = [
		            39 01 00 00 00 00 05 FF AA 55 A5 80
					39 01 00 00 00 00 02 6F 02
					39 01 00 00 00 00 02 F2 08
					39 01 00 00 00 00 02 6F 07
					39 01 00 00 00 00 02 F7 28
					//39 01 00 00 00 00 05 FF AA 55 A5 00
					39 01 00 00 00 00 06 F0 55 AA 52 08 01
					39 01 00 00 00 00 02 E0 01 
					39 01 00 00 00 00 02 B0 0F
					39 01 00 00 00 00 02 B1 0F
					39 01 00 00 00 00 02 B6 34
					39 01 00 00 00 00 02 B7 24
					39 01 00 00 00 00 02 B8 25
					39 01 00 00 00 00 02 B2 01
					39 01 00 00 00 00 04 BC 00 5E 00
					39 01 00 00 00 00 04 BD 00 72 00
					39 01 00 00 00 00 02 B5 0A
					39 01 00 00 00 00 02 B3 06
					39 01 00 00 00 00 02 B9 34
					39 01 00 00 00 00 02 BA 24
					39 01 00 00 00 00 02 BF	01				
					39 01 00 00 00 00 35 D1 00 4E 00 6A 00 70 00 7F 00 8B 00 AB 00 C4 00 EA 01 0D 01 46 01 79 01 C2 01 FF 02 01 02 3C 02 7B 02 A6 02 E0 03 09 03 44 03 6C 03 8F 03 B3 03 D5 03 F4 03 F5 
					39 01 00 00 00 00 35 D2 00 5A 00 5C 00 6F 00 80 00 8E 00 AB 00 C2 00 EB 01 0D 01 46 01 76 01 C1 01 FD 01 FF 02 37 02 77 02 9E 02 D6 02 FE 03 36 03 5A 03 82 03 AB 03 D3 03 FA 03 FB
					39 01 00 00 00 00 35 D3 00 01 00 02 00 0F 00 28 00 3F 00 64 00 82 00 B6 00 E1 01 24 01 5A 01 AF 01 F2 01 F4 02 2F 02 72 02 9B 02 D5 03 01 03 47 03 84 03 A1 03 B6 03 C4 03 CE 03 CF
					39 01 00 00 00 00 35 D4 00 4E 00 6A 00 70 00 7F 00 8B 00 AB 00 C4 00 EA 01 0D 01 46 01 79 01 C2 01 FF 02 01 02 3C 02 7B 02 A6 02 E0 03 09 03 44 03 6C 03 8F 03 B3 03 D5 03 F4 03 F5
					39 01 00 00 00 00 35 D5 00 5A 00 5C 00 6F 00 80 00 8E 00 AB 00 C2 00 EB 01 0D 01 46 01 76 01 C1 01 FD 01 FF 02 37 02 77 02 9E 02 D6 02 FE 03 36 03 5A 03 82 03 AB 03 D3 03 FA 03 FB
					39 01 00 00 00 00 35 D6 00 01 00 02 00 0F 00 28 00 3F 00 64 00 82 00 B6 00 E1 01 24 01 5A 01 AF 01 F2 01 F4 02 2F 02 72 02 9B 02 D5 03 01 03 47 03 84 03 A1 03 B6 03 C4 03 CE 03 CF
					39 01 00 00 00 00 06 F0 55 AA 52 08 00                              
					39 01 00 00 00 00 03 E0 00 01                                       
					39 01 00 00 00 00 0B E3 E2 E1 DF DD DA D7 CC C9 C0 B8
					39 01 00 00 00 00 02 B5 6B                                             
					39 01 00 00 00 00 02 B6 05                                             
					39 01 00 00 00 00 03 B7 00 00                                          
					39 01 00 00 00 00 05 B8 01 07 07 07                                    
					39 01 00 00 00 00 02 BA 01                                                
					39 01 00 00 00 00 02 BB 22                                                
					39 01 00 00 00 00 02 BC 00                                                
					39 01 00 00 00 00 04 CC 03 00 00                                         
					39 01 00 00 00 00 03 B1 6C 00 //7c video mode ;6c cmd mode                   
					39 01 00 00 00 00 06 BD 01 6C 08 32 00                               
					39 01 00 00 00 00 05 2A 00 00 01 DF                                    
					39 01 00 00 00 00 05 2B 00 00 03 55                                    
					39 01 00 00 00 00 02 35 00                                                      					
					05 01 00 00 78 00 02 11 00
					05 01 00 00 14 00 02 29 00
			];
		qcom,mdss-dsi-off-command = [05 01 00 00 32 00 02 28 00
					05 01 00 00 78 00 02 10 00];
		qcom,mdss-dsi-on-command-state = "dsi_lp_mode";
		qcom,mdss-dsi-off-command-state = "dsi_lp_mode";
		qcom,mdss-dsi-h-sync-pulse = <1>;
		qcom,mdss-dsi-traffic-mode = "burst_mode";
		qcom,mdss-dsi-bllp-eof-power-mode;
		qcom,mdss-dsi-bllp-power-mode;
		qcom,mdss-dsi-lane-0-state;
		qcom,mdss-dsi-lane-1-state;
		/*qcom,mdss-dsi-lane-2-state;
		qcom,mdss-dsi-lane-3-state;*/
		qcom,mdss-dsi-te-pin-select = <24>;
		qcom,mdss-dsi-wr-mem-start = <0x2c>;
		qcom,mdss-dsi-te-dcs-command = <1>;
		qcom,mdss-dsi-te-check-enable;
		qcom,mdss-dsi-te-using-te-pin;
		qcom,mdss-dsi-panel-timings = [83 1c 12 00 40 42 18 28 23 03 04 00];
		qcom,mdss-dsi-t-clk-post = <0x04>;
		qcom,mdss-dsi-t-clk-pre = <0x1B>;
		qcom,mdss-dsi-bl-min-level = <1>;
		qcom,mdss-dsi-bl-max-level = <255>;
		qcom,mdss-dsi-dma-trigger = "trigger_sw";
		qcom,mdss-dsi-mdp-trigger = "none";
		qcom,mdss-dsi-bl-pmic-control-type = "bl_ctrl_wled";
	//	qcom,mdss-dsi-bl-pmic-pwm-frequency = <42>;
	//	qcom,mdss-dsi-bl-pmic-bank-select = <3>;
	//	qcom,mdss-dsi-pwm-gpio = <&pm8226_mpps 2 0>;
	//	qcom,mdss-dsi-bl-pmic-bank-select-rc = <1>;
	//	qcom,mdss-dsi-pwm-gpio-rc = <&pm8226_gpios 3 0>;
	//	qcom,mdss-dsi-bl-pmic-pwm-frequency-rc = <47>;
		qcom,mdss-dsi-reset-sequence = <1 20>, <0 20>, <1 20>;
		qcom,mdss-pan-physical-width-dimension = <55>;
		qcom,mdss-pan-physical-height-dimension = <98>;

	};
};
