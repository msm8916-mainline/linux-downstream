/* Copyright (c) 2013, The Linux Foundation. All rights reserved.
 *
 * This program is free software; you can redistribute it and/or modify
 * it under the terms of the GNU General Public License version 2 and
 * only version 2 as published by the Free Software Foundation.
 *
 * This program is distributed in the hope that it will be useful,
 * but WITHOUT ANY WARRANTY; without even the implied warranty of
 * MERCHANTABILITY or FITNESS FOR A PARTICULAR PURPOSE.  See the
 * GNU General Public License for more details.
 */

/*---------------------------------------------------------------------------
 * This file is autogenerated file using gcdb parser. Please do not edit it.
 * Update input XML file to add a new entry or update variable in this file
 * VERSION = "1.0"
 *---------------------------------------------------------------------------*/
&mdss_mdp {
	dsi_nt35510s_fwvga_cmd_tm: qcom,mdss_dsi_nt35510s_fwvga_cmd_tm {
		qcom,mdss-dsi-panel-name = "tmnt35510s fwvga command mode dsi panel";
		qcom,mdss-dsi-project-name = "pd1309f_ex";
		qcom,mdss-dsi-panel-controller = <&mdss_dsi0>;
		qcom,mdss-dsi-panel-type = "dsi_cmd_mode";
		qcom,mdss-dsi-panel-destination = "display_1";
		qcom,mdss-dsi-panel-framerate = <60>;
		qcom,mdss-dsi-virtual-channel-id = <0>;
		qcom,mdss-dsi-stream = <0>;
		qcom,mdss-dsi-panel-id = <0x11>;
		qcom,mdss-dsi-panel-width = <480>;
		qcom,mdss-dsi-panel-height = <854>;
		qcom,mdss-dsi-h-front-porch = <76>;
		qcom,mdss-dsi-h-back-porch = <76>;
		qcom,mdss-dsi-h-pulse-width = <70>;
		qcom,mdss-dsi-h-sync-skew = <0>;
		qcom,mdss-dsi-v-back-porch = <27>;
		qcom,mdss-dsi-v-front-porch = <6>;
		qcom,mdss-dsi-v-pulse-width = <5>;
		qcom,mdss-dsi-h-left-border = <0>;
		qcom,mdss-dsi-h-right-border = <0>;
		qcom,mdss-dsi-v-top-border = <0>;
		qcom,mdss-dsi-v-bottom-border = <0>;
		qcom,mdss-dsi-bpp = <24>;
		qcom,mdss-dsi-underflow-color = <0xff>;
		qcom,mdss-dsi-border-color = <0>;
		qcom,mdss-dsi-on-command = [
		      29 01 00 00 00 00 05 FF AA 55 A5 80 	 
					29 01 00 00 00 00 02 6F 02  	
					29 01 00 00 00 00 02 F2 08          
					29 01 00 00 00 00 02 6F 07 
					29 01 00 00 00 00 02 F7 28 
					29 01 00 00 00 00 05 FF AA 55 A5 00         
					29 01 00 00 00 00 06 F0 55 AA 52 08 01     						
					29 01 00 00 00 00 04 B6 34 44 44   
					29 01 00 00 00 00 04 B0 0F 0F 0F 
					29 01 00 00 00 00 04 B7 24 34 34 
					29 01 00 00 00 00 04 B1 0F 0F 0F 
					29 01 00 00 00 00 04 B8 24 24 24       
					29 01 00 00 00 00 02 BF 01 
					29 01 00 00 00 00 04 B2 00 00 00 
					29 01 00 00 00 00 04 B3 08 08 08 
					29 01 00 00 00 00 04 B5 08 08 08 
					29 01 00 00 00 00 04 B9 34 34 34 
					29 01 00 00 00 00 04 BA 14 14 14 
					29 01 00 00 00 00 04 BC 00 78 00 
					29 01 00 00 00 00 04 BD 00 78 00 
					//29 01 00 00 00 00 02 EE 01 	
					//29 01 00 00 00 00 02 D7 01 
					29 01 00 00 00 00 35 D1 00 00 00 9B 00 C3 00 E1 00 F8 01 1C 01 3A 01 68 01 8C 01 C4 01 F0 02 37 02 71 02 73 02 A4 02 D9 02 FA 03 2A 03 48 03 71 03 8B 03 B3 03 CB 03 DE 03 F7 03 FF
					29 01 00 00 00 00 35 D2 01 4E 01 54 01 5E 01 69 01 73 01 84 01 94 01 B0 01 C5 01 EE 02 12 02 4E 02 80 02 82 02 AF 02 E3 03 02 03 33 03 50 03 7A 03 95 03 B8 03 CC 03 E3 03 FE 03 FF
					29 01 00 00 00 00 35 D3 00 F1 00 FA 01 0A 01 1A 01 28 01 40 01 57 01 7D 01 98 01 CA 01 F5 02 39 02 71 02 73 02 A5 02 D9 02 F9 03 2A 03 49 03 79 03 A1 03 D8 03 E0 03 E2 03 FB 03 FF
					29 01 00 00 00 00 35 D4 00 00 00 9B 00 C3 00 E1 00 F8 01 1C 01 3A 01 68 01 8C 01 C4 01 F0 02 37 02 71 02 73 02 A4 02 D9 02 FA 03 2A 03 48 03 71 03 8B 03 B3 03 CB 03 DE 03 F7 03 FF
					29 01 00 00 00 00 35 D5 01 4E 01 54 01 5E 01 69 01 73 01 84 01 94 01 B0 01 C5 01 EE 02 12 02 4E 02 80 02 82 02 AF 02 E3 03 02 03 33 03 50 03 7A 03 95 03 B8 03 CC 03 E3 03 FE 03 FF
					29 01 00 00 00 00 35 D6 00 F1 00 FA 01 0A 01 1A 01 28 01 40 01 57 01 7D 01 98 01 CA 01 F5 02 39 02 71 02 73 02 A5 02 D9 02 F9 03 2A 03 49 03 79 03 A1 03 D8 03 E0 03 E2 03 FB 03 FF
					29 01 00 00 00 00 06 F0 55 AA 52 08 00  
					29 01 00 00 00 00 03 B1 EC 00 
					////29 01 00 00 00 00 02 B4 10
					29 01 00 00 00 00 02 B5 6B 
					29 01 00 00 00 00 02 B6 05 
					29 01 00 00 00 00 03 B7 00 00 
					29 01 00 00 00 00 05 B8 01 07 07 07 
					29 01 00 00 00 00 04 BC 00 00 00 
					29 01 00 00 00 00 02 C1 19    
					29 01 00 00 00 00 0B C9 40 82 00 AA AA 81 C7 4B D8 05 
					29 01 00 00 00 00 02 35 00 
					29 01 00 00 00 00 05 2A 00 00 01 DF 
					29 01 00 00 00 00 05 2B 00 00 03 55 
					29 01 00 00 00 00 05 BD 01 84 0C 1B                          
					39 01 00 00 00 00 02 35 00                                                      					
					05 01 00 00 78 00 02 11 00
					05 01 00 00 14 00 02 29 00
			];
		qcom,mdss-dsi-off-command = [05 01 00 00 32 00 02 28 00
					05 01 00 00 78 00 02 10 00];
		qcom,mdss-dsi-on-command-state = "dsi_lp_mode";
		qcom,mdss-dsi-off-command-state = "dsi_lp_mode";
		qcom,mdss-dsi-h-sync-pulse = <1>;
		qcom,mdss-dsi-traffic-mode = "burst_mode";
		qcom,mdss-dsi-bllp-eof-power-mode;
		qcom,mdss-dsi-bllp-power-mode;
		qcom,mdss-dsi-lane-0-state;
		qcom,mdss-dsi-lane-1-state;
		/*qcom,mdss-dsi-lane-2-state;
		qcom,mdss-dsi-lane-3-state;*/
		qcom,mdss-dsi-lp11-init;
		qcom,mdss-dsi-init-delay-us = <10000>;
		qcom,mdss-dsi-te-pin-select = <24>;
		qcom,mdss-dsi-wr-mem-start = <0x2c>;
		qcom,mdss-dsi-te-dcs-command = <1>;
		qcom,mdss-dsi-te-check-enable;
		qcom,mdss-dsi-te-using-te-pin;
		qcom,mdss-dsi-panel-timings = [83 1c 12 00 40 42 18 28 23 03 04 00];
		qcom,mdss-dsi-t-clk-post = <0x04>;
		qcom,mdss-dsi-t-clk-pre = <0x1B>;
		qcom,mdss-dsi-bl-min-level = <1>;
		qcom,mdss-dsi-bl-max-level = <255>;
		qcom,mdss-dsi-dma-trigger = "trigger_sw";
		qcom,mdss-dsi-mdp-trigger = "none";
		qcom,mdss-dsi-bl-pmic-control-type = "bl_ctrl_wled";
	//	qcom,mdss-dsi-bl-pmic-pwm-frequency = <42>;
	//	qcom,mdss-dsi-bl-pmic-bank-select = <3>;
	//	qcom,mdss-dsi-pwm-gpio = <&pm8226_mpps 2 0>;
	//	qcom,mdss-dsi-bl-pmic-bank-select-rc = <1>;
	//	qcom,mdss-dsi-pwm-gpio-rc = <&pm8226_gpios 3 0>;
	//	qcom,mdss-dsi-bl-pmic-pwm-frequency-rc = <47>;
		qcom,mdss-dsi-reset-sequence = <1 10>, <0 10>, <1 40>;
		qcom,mdss-pan-physical-width-dimension = <55>;
		qcom,mdss-pan-physical-height-dimension = <98>;

	};
};
