/* Copyright (c) 2013, The Linux Foundation. All rights reserved.
 *
 * This program is free software; you can redistribute it and/or modify
 * it under the terms of the GNU General Public License version 2 and
 * only version 2 as published by the Free Software Foundation.
 *
 * This program is distributed in the hope that it will be useful,
 * but WITHOUT ANY WARRANTY; without even the implied warranty of
 * MERCHANTABILITY or FITNESS FOR A PARTICULAR PURPOSE.  See the
 * GNU General Public License for more details.
 */

qcom,alt3700mah-batterydata {
	qcom,fcc-mah = <3700>;					//fcc = full charg count == Full Battery capacity
	qcom,default-rbatt-mohm = <180>;			//The nominal battery resistance value
	qcom,rbatt-capacitive-mohm = <0>;			//M ohm
	qcom,flat-ocv-threshold-uv = <3400000>;			//Trickle charging V
	qcom,max-voltage-uv = <4300000>;
	qcom,v-cutoff-uv = <3300000>;
	qcom,chg-term-ua = <100000>;
	qcom,batt-id-kohm = <68>;
	qcom,battery-type = "ALT Li-Po 3700mAh";

	qcom,fcc-temp-lut {
		qcom,lut-col-legend = <(-20) 0 25 40 60>;
		qcom,lut-data = <3667 3670 3673 3673 3670>;
	};

	qcom,pc-temp-ocv-lut {
		qcom,lut-col-legend = <25>; //<(-20) 0 25 40 60>;
		qcom,lut-row-legend = 	<100 95 90 85 80>,
					<75 70 65 60 55>,
					<50 45 40 35 30>,
					<25 20 16 13 11>,
					<10 9 8 7 6>,
					<5 4 3 2 1>,
					<0>;
				
		qcom,lut-data = <4300>, //	<4175 4173 4167 4162 4157>,
				<4255>, //	<4097 4111 4112 4110 4107>,
				<4210>, //	<4039 4075 4072 4068 4064>,
				<4165>, //	<3963 4017 4025 4026 4025>,
				<4120>, //	<3920 3969 3984 3989 3988>,
				<4075>, //	<3887 3932 3957 3958 3955>,
				<4030>, //	<3856 3898 3929 3928 3925>,
				<3985>, //	<3830 3868 3900 3901 3898>,
				<3940>, //	<3808 3843 3858 3863 3862>,
				<3895>, //	<3793 3821 3827 3827 3827>,
				<3850>, //	<3779 3803 3807 3808 3807>,
				<3805>, //	<3768 3788 3792 3793 3792>,
				<3760>, //	<3757 3779 3780 3780 3779>,
				<3715>, //	<3746 3771 3772 3768 3768>,
				<3670>, //	<3734 3762 3765 3759 3749>,
				<3625>, //	<3722 3747 3753 3744 3730>,
				<3580>, //	<3707 3721 3731 3722 3709>,
				<3544>, //	<3693 3705 3704 3696 3683>,
				<3517>, //	<3678 3698 3687 3678 3667>,
				<3499>, //	<3664 3693 3683 3676 3665>,
				<3490>, //	<3656 3690 3682 3675 3664>,
				<3481>, //	<3646 3687 3681 3674 3662>,
				<3472>, //	<3634 3683 3680 3672 3661>,
				<3463>, //	<3618 3677 3676 3668 3656>,
				<3454>, //	<3599 3667 3667 3655 3639>,
				<3445>, //	<3573 3645 3638 3623 3603>,
				<3436>, //	<3541 3607 3591 3575 3554>,
				<3427>, //	<3496 3550 3528 3511 3490>,
				<3418>, //	<3428 3469 3445 3423 3400>,
				<3409>, //	<3312 3342 3308 3280 3250>,
				<3400>;	//	<3000 3000 3000 3000 3000>;
	};

	qcom,rbatt-sf-lut {
		qcom,lut-col-legend = <25>; //<(-20) 0 25 40 60>;
		qcom,lut-row-legend = 	<100 95 90 85 80>,
					<75 70 65 60 55>,
					<50 45 40 35 30>,
					<25 20 16 13 11>,
					<10 9 8 7 6>,
					<5 4 3 2 1>,
					<0>;
		qcom,lut-data = <100>,  //<909 216 100 85 84>,
				<100>,  //<859 238 106 88 86>,
				<100>,  //<860 237 105 88 86>,
				<100>,  //<808 239 107 90 88>,
				<100>,  //<801 234 111 94 90>,
				<100>,  //<801 230 118 97 92>,
				<100>,  //<801 224 123 100 95>,
				<100>,  //<807 221 128 106 99>,
				<100>,  //<818 221 111 101 97>,
				<100>,  //<841 225 101 88 87>,
				<101>,  //<870 229 101 88 87>,
				<102>,  //<906 235 103 91 90>,
				<103>,  //<950 243 106 93 93>,
				<104>,  //<998 253 110 93 96>,
				<105>,  //<1051 263 113 94 90>,
				<106>,  //<1116 272 113 91 88>,
				<107>,  //<1200 275 111 91 88>,
				<108>,  //<1312 298 108 90 87>,
				<109>,  //<1430 329 104 88 87>,
				<110>,  //<1484 351 107 91 89>,
				<111>,  //<1446 345 110 93 90>,
				<112>,  //<1398 344 112 94 90>,
				<113>,  //<1466 358 115 96 91>,
				<114>,  //<1490 357 117 96 90>,
				<115>,  //<1589 365 117 94 89>,
				<116>,  //<1828 379 111 91 88>,
				<117>,  //<2151 399 111 93 91>,
				<120>,  //<2621 436 117 98 95>,
				<130>,  //<3404 496 130 106 100>,
				<150>,  //<8212 616 150 1906 134>,
				<59087>;  //<135251 124940 59087 49820 29672>;
	};
};
