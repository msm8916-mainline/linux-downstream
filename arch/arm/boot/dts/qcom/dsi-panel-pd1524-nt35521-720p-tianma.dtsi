/* Copyright (c) 2013-2014, The Linux Foundation. All rights reserved.
 *
 * This program is free software; you can redistribute it and/or modify
 * it under the terms of the GNU General Public License version 2 and
 * only version 2 as published by the Free Software Foundation.
 *
 * This program is distributed in the hope that it will be useful,
 * but WITHOUT ANY WARRANTY; without even the implied warranty of
 * MERCHANTABILITY or FITNESS FOR A PARTICULAR PURPOSE.  See the
 * GNU General Public License for more details.
 */

&mdss_mdp {
	dsi_pd1524_nt35521s_720_vid: qcom,mdss_dsi_pd1524_nt35521s_720p_video {
		qcom,mdss-dsi-panel-name = "pd1524 nt35521s 720p video mode dsi panel";
		qcom,mdss-dsi-project-name = "pd1524";
		qcom,mdss-dsi-panel-controller = <&mdss_dsi0>;                                        
		qcom,mdss-dsi-panel-type = "dsi_video_mode";                                               
		qcom,mdss-dsi-panel-destination = "display_1";                                        
		qcom,mdss-dsi-panel-id = <0x10>;                                                                 
		qcom,mdss-dsi-panel-framerate = <60>;
		qcom,mdss-dsi-virtual-channel-id = <0>;
		qcom,mdss-dsi-stream = <0>;
		qcom,mdss-dsi-panel-width = <720>;
		qcom,mdss-dsi-panel-height = <1280>;
		qcom,mdss-dsi-h-front-porch = <86>; // 
		qcom,mdss-dsi-h-back-porch = <32>;  // 
		qcom,mdss-dsi-h-pulse-width = <12>;
		qcom,mdss-dsi-h-sync-skew = <0>;
		qcom,mdss-dsi-v-back-porch = <12>;
		qcom,mdss-dsi-v-front-porch = <62>;
		qcom,mdss-dsi-v-pulse-width = <4>;
		qcom,mdss-dsi-h-left-border = <0>;
		qcom,mdss-dsi-h-right-border = <0>;
		qcom,mdss-dsi-v-top-border = <0>;
		qcom,mdss-dsi-v-bottom-border = <0>;
		qcom,mdss-dsi-bpp = <24>;
		qcom,mdss-dsi-underflow-color = <0xff>;
		qcom,mdss-dsi-border-color = <0>;
		qcom,mdss-dsi-pixel-packing = "tight";
		qcom,mdss-dsi-on-command = [	
					29 01 00 00 00 00 05 FF AA 55 A5 80
					29 01 00 00 00 00 03 6F 11 00
					29 01 00 00 00 00 03 F7 20 00
					29 01 00 00 00 00 02 6F 11
					29 01 00 00 00 00 02 F3 01
					29 01 00 00 00 00 05 FF AA 55 25 00
					29 01 00 00 00 00 06 F0 55 AA 52 08 00
					29 01 00 00 00 00 02 6F 02
					29 01 00 00 00 00 02 B8 01
					29 01 00 00 00 00 03 BB 11 11
					29 01 00 00 00 00 03 BC 00 00
					29 01 00 00 00 00 02 C8 80
					29 01 00 00 00 00 02 B6 06
					29 01 00 00 00 00 06 F0 55 AA 52 08 01
					29 01 00 00 00 00 03 B0 0F 0F
					29 01 00 00 00 00 03 B1 0F 0F
					29 01 00 00 00 00 03 BC 80 00
					29 01 00 00 00 00 03 BD 80 00
					29 01 00 00 00 00 02 CA 00
					29 01 00 00 00 00 02 C0 04
					29 01 00 00 00 00 03 B5 03 03
					29 01 00 00 00 00 02 BE 48
					29 01 00 00 00 00 03 B3 19 19
					29 01 00 00 00 00 03 B4 0F 0F
					29 01 00 00 00 00 03 B9 34 34
					29 01 00 00 00 00 03 BA 15 15
					29 01 00 00 00 00 06 F0 55 AA 52 08 02
					29 01 00 00 00 00 02 EE 01
					29 01 00 00 00 00 11 B0 00 00 00 6E 00 9D 00 BB 00 D3 00 F7 01 14 01 42
					29 01 00 00 00 00 11 B1 01 66 01 9F 01 CC 02 12 02 4C 02 4D 02 82 02 BB
					29 01 00 00 00 00 11 B2 02 DD 03 09 03 27 03 4E 03 67 03 85 03 99 03 B1
					29 01 00 00 00 00 05 B3 03 D0 03 FF
					29 01 00 00 00 00 02 6F 0A
					29 01 00 00 00 00 02 F7 02
					29 01 00 00 00 00 02 6F 17
					29 01 00 00 00 00 02 F4 70
					29 01 00 00 00 00 02 6F 11
					29 01 00 00 00 00 02 F3 01
					29 01 00 00 00 00 06 F0 55 AA 52 08 06
					29 01 00 00 00 00 03 B0 08 31
					29 01 00 00 00 00 03 B1 2E 2D
					29 01 00 00 00 00 03 B2 12 10
					29 01 00 00 00 00 03 B3 34 34
					29 01 00 00 00 00 03 B4 34 34
					29 01 00 00 00 00 03 B5 34 34
					29 01 00 00 00 00 03 B6 34 34
					29 01 00 00 00 00 03 B7 34 34
					29 01 00 00 00 00 03 B8 34 16
					29 01 00 00 00 00 03 B9 00 02
					29 01 00 00 00 00 03 BA 03 01
					29 01 00 00 00 00 03 BB 17 34
					29 01 00 00 00 00 03 BC 34 34
					29 01 00 00 00 00 03 BD 34 34
					29 01 00 00 00 00 03 BE 34 34
					29 01 00 00 00 00 03 BF 34 34
					29 01 00 00 00 00 03 C0 31 34
					29 01 00 00 00 00 03 C1 11 13
					29 01 00 00 00 00 03 C2 2D 2E
					29 01 00 00 00 00 03 C3 31 09
					29 01 00 00 00 00 03 E5 18 19
					29 01 00 00 00 00 03 E6 11 10 
					29 01 00 00 00 00 03 C4 09 31
					29 01 00 00 00 00 03 C5 2D 2E
					29 01 00 00 00 00 03 C6 17 19
					29 01 00 00 00 00 03 C7 34 34
					29 01 00 00 00 00 03 C8 34 34
					29 01 00 00 00 00 03 C9 34 34
					29 01 00 00 00 00 03 CA 34 34
					29 01 00 00 00 00 03 CB 34 34
					29 01 00 00 00 00 03 CC 34 13
					29 01 00 00 00 00 03 CD 03 01
					29 01 00 00 00 00 03 CE 00 02
					29 01 00 00 00 00 03 CF 12 34
					29 01 00 00 00 00 03 D0 34 34
					29 01 00 00 00 00 03 D1 34 34
					29 01 00 00 00 00 03 D2 34 34
					29 01 00 00 00 00 03 D3 34 34
					29 01 00 00 00 00 03 D4 31 34
					29 01 00 00 00 00 03 D5 18 16
					29 01 00 00 00 00 03 D6 2E 2D
					29 01 00 00 00 00 03 D7 31 08 
					29 01 00 00 00 00 06 D8 00 00 00 00 00
					29 01 00 00 00 00 06 D9 00 00 00 00 00
					29 01 00 00 00 00 02 E7 00	 
					29 01 00 00 00 00 06 F0 55 AA 52 08 05
					29 01 00 00 00 00 02 ED 30
					29 01 00 00 00 00 06 F0 55 AA 52 08 03
					29 01 00 00 00 00 03 B1 20 00
					29 01 00 00 00 00 03 B0 20 00
					29 01 00 00 00 00 06 F0 55 AA 52 08 05
					29 01 00 00 00 00 02 E5 00
					29 01 00 00 00 00 06 F0 55 AA 52 08 05
					29 01 00 00 00 00 03 B0 17 06
					29 01 00 00 00 00 02 B8 00
					29 01 00 00 00 00 06 BD 03 03 01 00 03
					29 01 00 00 00 00 03 B1 17 06
					29 01 00 00 00 00 03 B9 00 03
					29 01 00 00 00 00 03 B2 17 06
					29 01 00 00 00 00 03 BA 00 00
					29 01 00 00 00 00 03 B3 17 06
					29 01 00 00 00 00 03 BB 00 00
					29 01 00 00 00 00 03 B4 17 06
					29 01 00 00 00 00 03 B5 17 06
					29 01 00 00 00 00 03 B6 17 06
					29 01 00 00 00 00 03 B7 17 06
					29 01 00 00 00 00 03 BC 00 03
					29 01 00 00 00 00 02 E5 06
					29 01 00 00 00 00 02 E6 06
					29 01 00 00 00 00 02 E7 06
					29 01 00 00 00 00 02 E8 06
					29 01 00 00 00 00 02 E9 06
					29 01 00 00 00 00 02 EA 06
					29 01 00 00 00 00 02 EB 06
					29 01 00 00 00 00 02 EC 06
					29 01 00 00 00 00 06 F0 55 AA 52 08 05
					29 01 00 00 00 00 02 C0 0B
					29 01 00 00 00 00 02 C1 09
					29 01 00 00 00 00 02 C2 0B
					29 01 00 00 00 00 02 C3 09			
					29 01 00 00 00 00 06 F0 55 AA 52 08 03
					29 01 00 00 00 00 06 B2 05 00 00 00 90
					29 01 00 00 00 00 06 B3 05 00 00 00 90
					29 01 00 00 00 00 06 B4 05 00 00 00 90
					29 01 00 00 00 00 06 B5 05 00 00 00 90					 
					29 01 00 00 00 00 06 F0 55 AA 52 08 05
					29 01 00 00 00 00 02 C4 10
					29 01 00 00 00 00 02 C5 10
					29 01 00 00 00 00 02 C6 10
					29 01 00 00 00 00 02 C7 10					 
					29 01 00 00 00 00 06 F0 55 AA 52 08 03
					29 01 00 00 00 00 06 B6 05 00 00 00 90
					29 01 00 00 00 00 06 B7 05 00 00 00 90
					29 01 00 00 00 00 06 B8 05 00 00 00 90
					29 01 00 00 00 00 06 B9 05 00 00 00 90					 					 
					29 01 00 00 00 00 06 F0 55 AA 52 08 05
					29 01 00 00 00 00 03 C8 07 20
					29 01 00 00 00 00 03 C9 03 20
					29 01 00 00 00 00 03 CA 07 00
					29 01 00 00 00 00 03 CB 03 00					 				 
					29 01 00 00 00 00 06 F0 55 AA 52 08 03
					29 01 00 00 00 00 06 BA 53 00 00 00 00
					29 01 00 00 00 00 06 BB 53 00 00 00 00
					29 01 00 00 00 00 06 BC 53 00 00 00 00
					29 01 00 00 00 00 06 BD 53 00 00 00 00					 
					29 01 00 00 00 00 06 F0 55 AA 52 08 05
					29 01 00 00 00 00 06 D1 00 05 00 07 10
					29 01 00 00 00 00 06 D2 00 05 04 07 10
					29 01 00 00 00 00 06 D3 00 00 0A 07 10
					29 01 00 00 00 00 06 D4 00 00 0A 07 10					 
					29 01 00 00 00 00 06 F0 55 AA 52 08 05
					29 01 00 00 00 00 08 D0 00 00 00 00 00 00 00
					29 01 00 00 00 00 0C D5 00 00 00 00 00 00 00 00 00 00 00
					29 01 00 00 00 00 0C D6 00 00 00 00 00 00 00 00 00 00 00
					29 01 00 00 00 00 0C D7 00 00 00 00 00 00 00 00 00 00 00
					29 01 00 00 00 00 06 D8 00 00 00 00 00					 
					29 01 00 00 00 00 06 F0 55 AA 52 08 03
					29 01 00 00 00 00 02 C4 60
					29 01 00 00 00 00 02 C5 40
					29 01 00 00 00 00 02 C6 60
					29 01 00 00 00 00 02 C7 40					 
					29 01 00 00 00 00 02 6F 01
					29 01 00 00 00 00 02 F9 46										 
					29 01 00 00 00 00 02 6F 11
					29 01 00 00 00 00 02 F3 01
					29 01 00 00 00 00 06 F0 55 AA 52 08 00
					29 01 00 00 00 00 03 B1 68 21  					
				//	29 01 00 00 00 00 02 51 FF
				//	29 01 00 00 00 00 02 53 24
				//	29 01 00 00 00 00 02 55 00					
					29 01 00 00 78 00 02 11 00
					29 01 00 00 32 00 02 29 00
				//	29 01 00 00 00 00 06 F0 55 AA 52 08 00
				//	29 01 00 00 00 00 05 EE 87 78 02 40 
					];
		qcom,mdss-dsi-off-command = [05 01 00 00 14 00 02 28 00
					05 01 00 00 78 00 02 10 00];
		qcom,mdss-dsi-on-command-state = "dsi_lp_mode";
		qcom,mdss-dsi-off-command-state = "dsi_hs_mode";
		qcom,mdss-dsi-h-sync-pulse = <1>;
	//	qcom,mdss-dsi-traffic-mode = "burst_mode";
		qcom,mdss-dsi-bllp-eof-power-mode;
		qcom,mdss-dsi-bllp-power-mode;
	//	qcom,mdss-dsi-hbp-power-mode;
		qcom,mdss-dsi-lane-0-state;
		qcom,mdss-dsi-lane-1-state;
		qcom,mdss-dsi-lane-2-state;
		qcom,mdss-dsi-lane-3-state;

		// 4 line timing  216Mhz
		qcom,mdss-dsi-panel-timings = [7B 1A 10 00 3E 40 16 1F 15 03 04 00];
		//qcom,mdss-dsi-panel-timings = [8B 1E 14 00 44 48 18 3A 19 03 04 00]; // 241Mhz, 246Mhz
		qcom,mdss-dsi-t-clk-post = <0x04>;
		qcom,mdss-dsi-t-clk-pre = <0x1A>;  

		qcom,mdss-dsi-lp11-init;
		qcom,mdss-dsi-init-delay-us = <10000>;
		qcom,mdss-dsi-bl-min-level = <1>;
		qcom,mdss-dsi-bl-max-level = <255>;
		qcom,mdss-dsi-dma-trigger = "trigger_sw";
		qcom,mdss-dsi-mdp-trigger = "none";
		qcom,mdss-dsi-reset-sequence = <1 5>, <0 5>, <1 20>;
		qcom,mdss-pan-physical-width-dimension = <58>;
		qcom,mdss-pan-physical-height-dimension = <103>;
		//qcom,esd-check-enabled;
		qcom,mdss-dsi-panel-status-command = [06 01 00 01 05 00 02 0A 08];
		qcom,mdss-dsi-panel-status-command-state = "dsi_lp_mode";
		qcom,mdss-dsi-panel-status-check-mode = "reg_read";
		qcom,mdss-dsi-panel-status-value = <0x9c>;
		qcom,mdss-dsi-rx-eot-ignore;
		qcom,mdss-dsi-tx-eot-append;
	};
};
