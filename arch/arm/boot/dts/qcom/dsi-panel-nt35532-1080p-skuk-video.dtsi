/* Copyright (c) 2014, The Linux Foundation. All rights reserved.
 *
 * This program is free software; you can redistribute it and/or modify
 * it under the terms of the GNU General Public License version 2 and
 * only version 2 as published by the Free Software Foundation.
 *
 * This program is distributed in the hope that it will be useful,
 * but WITHOUT ANY WARRANTY; without even the implied warranty of
 * MERCHANTABILITY or FITNESS FOR A PARTICULAR PURPOSE.  See the
 * GNU General Public License for more details.
 */

&mdss_mdp {
	dsi_nt35532_1080p_skuk_video: qcom,mdss_dsi_nt35532_1080p_skuk_video {
		qcom,mdss-dsi-panel-name = "nt35532 1080p video mode dsi panel skuk";
		qcom,mdss-dsi-panel-controller = <&mdss_dsi0>;
		qcom,mdss-dsi-panel-type = "dsi_video_mode";
		qcom,mdss-dsi-panel-destination = "display_1";
		qcom,mdss-dsi-panel-framerate = <60>;
		qcom,mdss-dsi-virtual-channel-id = <0>;
		qcom,mdss-dsi-stream = <0>;
		qcom,mdss-dsi-panel-width = <1080>;
		qcom,mdss-dsi-panel-height = <1920>;
		qcom,mdss-dsi-h-front-porch = <132>;
		qcom,mdss-dsi-h-back-porch = <32>;
		qcom,mdss-dsi-h-pulse-width = <8>;
		qcom,mdss-dsi-h-sync-skew = <0>;
		qcom,mdss-dsi-v-back-porch = <14>;//<18>;
		qcom,mdss-dsi-v-front-porch = <20>;//<10>;
		qcom,mdss-dsi-v-pulse-width = <2>;
		qcom,mdss-dsi-h-left-border = <0>;
		qcom,mdss-dsi-h-right-border = <0>;
		qcom,mdss-dsi-v-top-border = <0>;
		qcom,mdss-dsi-v-bottom-border = <50>;
		qcom,mdss-dsi-bpp = <24>;
		//qcom,mdss-dsi-color-order = "rgb_swap_rgb";
		qcom,mdss-dsi-underflow-color = <0xff>;
		qcom,mdss-dsi-border-color = <0>;
		qcom,mdss-dsi-on-command = [
			23 00 00 00 00 00 02 ff 01
			23 00 00 00 00 00 02 fb 01
			23 00 00 00 00 00 02 00 01
			23 00 00 00 00 00 02 01 44
			23 00 00 00 00 00 02 02 59
			23 00 00 00 00 00 02 04 0c
			23 00 00 00 00 00 02 05 2a
			23 00 00 00 00 00 02 06 55
			23 00 00 00 00 00 02 07 41//c1
			23 00 00 00 00 00 02 0d 98//8e
			23 00 00 00 00 00 02 0e 98//8e
			23 00 00 00 00 00 02 0f 60
			23 00 00 00 00 00 02 10 03
			23 00 00 00 00 00 02 11 50
			23 00 00 00 00 00 02 12 5a
			//23 00 00 00 00 00 02 14 40
			23 00 00 00 00 00 02 15 60
			23 00 00 00 00 00 02 16 17
			23 00 00 00 00 00 02 17 17
			23 00 00 00 00 00 02 2b 00
			23 00 00 00 00 00 02 68 13
			23 00 00 00 00 00 02 75 00
			23 00 00 00 00 00 02 76 35//0a
			23 00 00 00 00 00 02 77 00
			23 00 00 00 00 00 02 78 5a//45
			23 00 00 00 00 00 02 79 00
			23 00 00 00 00 00 02 7a 89//75
			23 00 00 00 00 00 02 7b 00
			23 00 00 00 00 00 02 7c a7//93
			23 00 00 00 00 00 02 7d 00
			23 00 00 00 00 00 02 7e be//ab
			23 00 00 00 00 00 02 7f 00
			23 00 00 00 00 00 02 80 d1//be
			23 00 00 00 00 00 02 81 00
			23 00 00 00 00 00 02 82 e1//cf
			23 00 00 00 00 00 02 83 00
			23 00 00 00 00 00 02 84 f1//df
			23 00 00 00 00 00 02 85 00
			23 00 00 00 00 00 02 86 ff//ed
			23 00 00 00 00 00 02 87 01
			23 00 00 00 00 00 02 88 2c//1c
			23 00 00 00 00 00 02 89 01
			23 00 00 00 00 00 02 8a 50//40
			23 00 00 00 00 00 02 8b 01
			23 00 00 00 00 00 02 8c 88//7a
			23 00 00 00 00 00 02 8d 01
			23 00 00 00 00 00 02 8e b5//a8
			23 00 00 00 00 00 02 8f 01
			23 00 00 00 00 00 02 90 fc//f0
			23 00 00 00 00 00 02 91 02
			23 00 00 00 00 00 02 92 34//2a
			23 00 00 00 00 00 02 93 02
			23 00 00 00 00 00 02 94 36//2c
			23 00 00 00 00 00 02 95 02
			23 00 00 00 00 00 02 96 6b//62
			23 00 00 00 00 00 02 97 02
			23 00 00 00 00 00 02 98 a6//9e
			23 00 00 00 00 00 02 99 02
			23 00 00 00 00 00 02 9a ca//c3
			23 00 00 00 00 00 02 9b 02
			23 00 00 00 00 00 02 9c fc//f6
			23 00 00 00 00 00 02 9d 03
			23 00 00 00 00 00 02 9e 1d//18
			23 00 00 00 00 00 02 9f 03
			23 00 00 00 00 00 02 a0 47//43
			23 00 00 00 00 00 02 a2 03
			23 00 00 00 00 00 02 a3 55//51
			23 00 00 00 00 00 02 a4 03
			23 00 00 00 00 00 02 a5 63//60
			23 00 00 00 00 00 02 a6 03
			23 00 00 00 00 00 02 a7 73//70
			23 00 00 00 00 00 02 a9 03
			23 00 00 00 00 00 02 aa 84//81
			23 00 00 00 00 00 02 ab 03
			23 00 00 00 00 00 02 ac 95
			23 00 00 00 00 00 02 ad 03
			23 00 00 00 00 00 02 ae a6//a4
			23 00 00 00 00 00 02 af 03
			23 00 00 00 00 00 02 b0 b9//b7
			23 00 00 00 00 00 02 b1 03
			23 00 00 00 00 00 02 b2 d1
			23 00 00 00 00 00 02 b3 00
			23 00 00 00 00 00 02 b4 0d//0a
			23 00 00 00 00 00 02 b5 00
			23 00 00 00 00 00 02 b6 5a//45
			23 00 00 00 00 00 02 b7 00
			23 00 00 00 00 00 02 b8 89//75
			23 00 00 00 00 00 02 b9 00
			23 00 00 00 00 00 02 ba a7//93
			23 00 00 00 00 00 02 bb 00
			23 00 00 00 00 00 02 bc be//ab
			23 00 00 00 00 00 02 bd 00
			23 00 00 00 00 00 02 be d1//be
			23 00 00 00 00 00 02 bf 00
			23 00 00 00 00 00 02 c0 e1//cf
			23 00 00 00 00 00 02 c1 00
			23 00 00 00 00 00 02 c2 f1//df
			23 00 00 00 00 00 02 c3 00
			23 00 00 00 00 00 02 c4 ff//ed
			23 00 00 00 00 00 02 c5 01
			23 00 00 00 00 00 02 c6 2c//1c
			23 00 00 00 00 00 02 c7 01
			23 00 00 00 00 00 02 c8 50//40
			23 00 00 00 00 00 02 c9 01
			23 00 00 00 00 00 02 ca 88//7a
			23 00 00 00 00 00 02 cb 01
			23 00 00 00 00 00 02 cc b5//a8
			23 00 00 00 00 00 02 cd 01
			23 00 00 00 00 00 02 ce fc//f0
			23 00 00 00 00 00 02 cf 02
			23 00 00 00 00 00 02 d0 34//2a
			23 00 00 00 00 00 02 d1 02
			23 00 00 00 00 00 02 d2 36//2c
			23 00 00 00 00 00 02 d3 02
			23 00 00 00 00 00 02 d4 6b//62
			23 00 00 00 00 00 02 d5 02
			23 00 00 00 00 00 02 d6 a6//9e
			23 00 00 00 00 00 02 d7 02
			23 00 00 00 00 00 02 d8 ca//c3
			23 00 00 00 00 00 02 d9 02
			23 00 00 00 00 00 02 da fc//f6
			23 00 00 00 00 00 02 db 03
			23 00 00 00 00 00 02 dc 1d//18
			23 00 00 00 00 00 02 dd 03
			23 00 00 00 00 00 02 de 47//43
			23 00 00 00 00 00 02 df 03
			23 00 00 00 00 00 02 e0 55//51
			23 00 00 00 00 00 02 e1 03
			23 00 00 00 00 00 02 e2 63//60
			23 00 00 00 00 00 02 e3 03
			23 00 00 00 00 00 02 e4 73//70
			23 00 00 00 00 00 02 e5 03
			23 00 00 00 00 00 02 e6 84//81
			23 00 00 00 00 00 02 e7 03
			23 00 00 00 00 00 02 e8 95
			23 00 00 00 00 00 02 e9 03
			23 00 00 00 00 00 02 ea a6//a4
			23 00 00 00 00 00 02 eb 03
			23 00 00 00 00 00 02 ec b9//b7
			23 00 00 00 00 00 02 ed 03
			23 00 00 00 00 00 02 ee d2//d1
			23 00 00 00 00 00 02 ef 00
			23 00 00 00 00 00 02 f0 35//0a
			23 00 00 00 00 00 02 f1 00
			23 00 00 00 00 00 02 f2 5a//45
			23 00 00 00 00 00 02 f3 00
			23 00 00 00 00 00 02 f4 89//75
			23 00 00 00 00 00 02 f5 00
			23 00 00 00 00 00 02 f6 a7//93
			23 00 00 00 00 00 02 f7 00
			23 00 00 00 00 00 02 f8 be//ab
			23 00 00 00 00 00 02 f9 00
			23 00 00 00 00 00 02 fa d1//be
			23 00 00 00 00 00 02 ff 02
			23 00 00 00 00 00 02 fb 01
			23 00 00 00 00 00 02 00 00
			23 00 00 00 00 00 02 01 e1//cf
			23 00 00 00 00 00 02 02 00
			23 00 00 00 00 00 02 03 f1//df
			23 00 00 00 00 00 02 04 00
			23 00 00 00 00 00 02 05 ff//ed
			23 00 00 00 00 00 02 06 01
			23 00 00 00 00 00 02 07 2c//1c
			23 00 00 00 00 00 02 08 01
			23 00 00 00 00 00 02 09 50//40
			23 00 00 00 00 00 02 0a 01
			23 00 00 00 00 00 02 0b 88//7a
			23 00 00 00 00 00 02 0c 01
			23 00 00 00 00 00 02 0d b5//a8
			23 00 00 00 00 00 02 0e 01
			23 00 00 00 00 00 02 0f fc//f0
			23 00 00 00 00 00 02 10 02
			23 00 00 00 00 00 02 11 34//2a
			23 00 00 00 00 00 02 12 02
			23 00 00 00 00 00 02 13 36//2c
			23 00 00 00 00 00 02 14 02
			23 00 00 00 00 00 02 15 6b//62
			23 00 00 00 00 00 02 16 02
			23 00 00 00 00 00 02 17 a6//9e
			23 00 00 00 00 00 02 18 02
			23 00 00 00 00 00 02 19 ca//c3
			23 00 00 00 00 00 02 1a 02
			23 00 00 00 00 00 02 1b fc//f6
			23 00 00 00 00 00 02 1c 03
			23 00 00 00 00 00 02 1d 1d//18
			23 00 00 00 00 00 02 1e 03
			23 00 00 00 00 00 02 1f 47//43
			23 00 00 00 00 00 02 20 03
			23 00 00 00 00 00 02 21 55//51
			23 00 00 00 00 00 02 22 03
			23 00 00 00 00 00 02 23 63//60
			23 00 00 00 00 00 02 24 03
			23 00 00 00 00 00 02 25 73//70
			23 00 00 00 00 00 02 26 03
			23 00 00 00 00 00 02 27 84//81
			23 00 00 00 00 00 02 28 03
			23 00 00 00 00 00 02 29 95
			23 00 00 00 00 00 02 2a 03
			23 00 00 00 00 00 02 2b a6//a4
			23 00 00 00 00 00 02 2d 03
			23 00 00 00 00 00 02 2f b9//b7
			23 00 00 00 00 00 02 30 03
			23 00 00 00 00 00 02 31 d2//d1
			23 00 00 00 00 00 02 32 00
			23 00 00 00 00 00 02 33 0d//0a
			23 00 00 00 00 00 02 34 00
			23 00 00 00 00 00 02 35 5a//45
			23 00 00 00 00 00 02 36 00
			23 00 00 00 00 00 02 37 89//75
			23 00 00 00 00 00 02 38 00
			23 00 00 00 00 00 02 39 a7//93
			23 00 00 00 00 00 02 3a 00
			23 00 00 00 00 00 02 3b be//ab
			23 00 00 00 00 00 02 3d 00
			23 00 00 00 00 00 02 3f d1//be
			23 00 00 00 00 00 02 40 00
			23 00 00 00 00 00 02 41 e1//cf
			23 00 00 00 00 00 02 42 00
			23 00 00 00 00 00 02 43 f1//df
			23 00 00 00 00 00 02 44 00
			23 00 00 00 00 00 02 45 ff//ed
			23 00 00 00 00 00 02 46 01
			23 00 00 00 00 00 02 47 2c//1c
			23 00 00 00 00 00 02 48 01
			23 00 00 00 00 00 02 49 50//40
			23 00 00 00 00 00 02 4a 01
			23 00 00 00 00 00 02 4b 88//7a
			23 00 00 00 00 00 02 4c 01
			23 00 00 00 00 00 02 4d b5//a8
			23 00 00 00 00 00 02 4e 01
			23 00 00 00 00 00 02 4f fc//f0
			23 00 00 00 00 00 02 50 02
			23 00 00 00 00 00 02 51 34//2a
			23 00 00 00 00 00 02 52 02
			23 00 00 00 00 00 02 53 36//2c
			23 00 00 00 00 00 02 54 02
			23 00 00 00 00 00 02 55 6b//62
			23 00 00 00 00 00 02 56 02
			23 00 00 00 00 00 02 58 a6//9e
			23 00 00 00 00 00 02 59 02
			23 00 00 00 00 00 02 5a ca//c3
			23 00 00 00 00 00 02 5b 02
			23 00 00 00 00 00 02 5c fc//f6
			23 00 00 00 00 00 02 5d 03
			23 00 00 00 00 00 02 5e 1d//18
			23 00 00 00 00 00 02 5f 03
			23 00 00 00 00 00 02 60 47//43
			23 00 00 00 00 00 02 61 03
			23 00 00 00 00 00 02 62 55//51
			23 00 00 00 00 00 02 63 03
			23 00 00 00 00 00 02 64 63//60
			23 00 00 00 00 00 02 65 03
			23 00 00 00 00 00 02 66 73//70
			23 00 00 00 00 00 02 67 03
			23 00 00 00 00 00 02 68 84//81
			23 00 00 00 00 00 02 69 03
			23 00 00 00 00 00 02 6a 95
			23 00 00 00 00 00 02 6b 03
			23 00 00 00 00 00 02 6c a6//a4
			23 00 00 00 00 00 02 6d 03
			23 00 00 00 00 00 02 6e b9//b7
			23 00 00 00 00 00 02 6f 03
			23 00 00 00 00 00 02 70 d2//d1
			23 00 00 00 00 00 02 71 00
			23 00 00 00 00 00 02 72 35//0a
			23 00 00 00 00 00 02 73 00
			23 00 00 00 00 00 02 74 5a//45
			23 00 00 00 00 00 02 75 00
			23 00 00 00 00 00 02 76 89//75
			23 00 00 00 00 00 02 77 00
			23 00 00 00 00 00 02 78 a7//93
			23 00 00 00 00 00 02 79 00
			23 00 00 00 00 00 02 7a be//ab
			23 00 00 00 00 00 02 7b 00
			23 00 00 00 00 00 02 7c d1//be
			23 00 00 00 00 00 02 7d 00
			23 00 00 00 00 00 02 7e e1//cf
			23 00 00 00 00 00 02 7f 00
			23 00 00 00 00 00 02 80 f1//df
			23 00 00 00 00 00 02 81 00
			23 00 00 00 00 00 02 82 ff//ed
			23 00 00 00 00 00 02 83 01
			23 00 00 00 00 00 02 84 2c//1c
			23 00 00 00 00 00 02 85 01
			23 00 00 00 00 00 02 86 50//40
			23 00 00 00 00 00 02 87 01
			23 00 00 00 00 00 02 88 88//7a
			23 00 00 00 00 00 02 89 01
			23 00 00 00 00 00 02 8a b5//a8
			23 00 00 00 00 00 02 8b 01
			23 00 00 00 00 00 02 8c fc//f0
			23 00 00 00 00 00 02 8d 02
			23 00 00 00 00 00 02 8e 34//2a
			23 00 00 00 00 00 02 8f 02
			23 00 00 00 00 00 02 90 36//2c
			23 00 00 00 00 00 02 91 02
			23 00 00 00 00 00 02 92 6b//62
			23 00 00 00 00 00 02 93 02
			23 00 00 00 00 00 02 94 a6//9e
			23 00 00 00 00 00 02 95 02
			23 00 00 00 00 00 02 96 ca//c3
			23 00 00 00 00 00 02 97 02
			23 00 00 00 00 00 02 98 fc//f6
			23 00 00 00 00 00 02 99 03
			23 00 00 00 00 00 02 9a 1d//18
			23 00 00 00 00 00 02 9b 03
			23 00 00 00 00 00 02 9c 47//43
			23 00 00 00 00 00 02 9d 03
			23 00 00 00 00 00 02 9e 55//51
			23 00 00 00 00 00 02 9f 03
			23 00 00 00 00 00 02 a0 63//60
			23 00 00 00 00 00 02 a2 03
			23 00 00 00 00 00 02 a3 73//70
			23 00 00 00 00 00 02 a4 03
			23 00 00 00 00 00 02 a5 84//81
			23 00 00 00 00 00 02 a6 03
			23 00 00 00 00 00 02 a7 95
			23 00 00 00 00 00 02 a9 03
			23 00 00 00 00 00 02 aa a6//a4
			23 00 00 00 00 00 02 ab 03
			23 00 00 00 00 00 02 ac b9//b7
			23 00 00 00 00 00 02 ad 03
			23 00 00 00 00 00 02 ae d2//d1
			23 00 00 00 00 00 02 af 00
			23 00 00 00 00 00 02 b0 0d//0a
			23 00 00 00 00 00 02 b1 00
			23 00 00 00 00 00 02 b2 5a//45
			23 00 00 00 00 00 02 b3 00
			23 00 00 00 00 00 02 b4 89//75
			23 00 00 00 00 00 02 b5 00
			23 00 00 00 00 00 02 b6 a7//93
			23 00 00 00 00 00 02 b7 00
			23 00 00 00 00 00 02 b8 be//ab
			23 00 00 00 00 00 02 b9 00
			23 00 00 00 00 00 02 ba d1//be
			23 00 00 00 00 00 02 bb 00
			23 00 00 00 00 00 02 bc e1//cf
			23 00 00 00 00 00 02 bd 00
			23 00 00 00 00 00 02 be f1//df
			23 00 00 00 00 00 02 bf 00
			23 00 00 00 00 00 02 c0 ff//ed
			23 00 00 00 00 00 02 c1 01
			23 00 00 00 00 00 02 c2 2c//1c
			23 00 00 00 00 00 02 c3 01
			23 00 00 00 00 00 02 c4 50//40
			23 00 00 00 00 00 02 c5 01
			23 00 00 00 00 00 02 c6 88//7a
			23 00 00 00 00 00 02 c7 01
			23 00 00 00 00 00 02 c8 b5//a8
			23 00 00 00 00 00 02 c9 01
			23 00 00 00 00 00 02 ca fc//f0
			23 00 00 00 00 00 02 cb 02
			23 00 00 00 00 00 02 cc 34//2a
			23 00 00 00 00 00 02 cd 02
			23 00 00 00 00 00 02 ce 36//2c
			23 00 00 00 00 00 02 cf 02
			23 00 00 00 00 00 02 d0 6b//62
			23 00 00 00 00 00 02 d1 02
			23 00 00 00 00 00 02 d2 a6//9e
			23 00 00 00 00 00 02 d3 02
			23 00 00 00 00 00 02 d4 ca//c3
			23 00 00 00 00 00 02 d5 02
			23 00 00 00 00 00 02 d6 fc//f6
			23 00 00 00 00 00 02 d7 03
			23 00 00 00 00 00 02 d8 1d//18
			23 00 00 00 00 00 02 d9 03
			23 00 00 00 00 00 02 da 47//43
			23 00 00 00 00 00 02 db 03
			23 00 00 00 00 00 02 dc 55//51
			23 00 00 00 00 00 02 dd 03
			23 00 00 00 00 00 02 de 63//60
			23 00 00 00 00 00 02 df 03
			23 00 00 00 00 00 02 e0 73//70
			23 00 00 00 00 00 02 e1 03
			23 00 00 00 00 00 02 e2 84//81
			23 00 00 00 00 00 02 e3 03
			23 00 00 00 00 00 02 e4 95
			23 00 00 00 00 00 02 e5 03
			23 00 00 00 00 00 02 e6 a6//a4
			23 00 00 00 00 00 02 e7 03
			23 00 00 00 00 00 02 e8 b9//b7
			23 00 00 00 00 00 02 e9 03
			23 00 00 00 00 00 02 ea d2//d1
			23 00 00 00 00 00 02 ff 05
			23 00 00 00 00 00 02 fb 01
			23 00 00 00 00 00 02 00 40
			23 00 00 00 00 00 02 01 40
			23 00 00 00 00 00 02 02 40
			23 00 00 00 00 00 02 03 40
			23 00 00 00 00 00 02 04 40
			23 00 00 00 00 00 02 05 07
			23 00 00 00 00 00 02 06 17
			23 00 00 00 00 00 02 07 19
			23 00 00 00 00 00 02 08 1b
			23 00 00 00 00 00 02 09 1d
			23 00 00 00 00 00 02 0a 1f
			23 00 00 00 00 00 02 0b 21
			23 00 00 00 00 00 02 0c 26
			23 00 00 00 00 00 02 0d 28
			23 00 00 00 00 00 02 0e 09
			23 00 00 00 00 00 02 0f 38
			23 00 00 00 00 00 02 10 38
			23 00 00 00 00 00 02 11 0f
			23 00 00 00 00 00 02 12 40
			23 00 00 00 00 00 02 13 40
			23 00 00 00 00 00 02 14 40
			23 00 00 00 00 00 02 15 40
			23 00 00 00 00 00 02 16 40
			23 00 00 00 00 00 02 17 40
			23 00 00 00 00 00 02 18 40
			23 00 00 00 00 00 02 19 06
			23 00 00 00 00 00 02 1a 16
			23 00 00 00 00 00 02 1b 18
			23 00 00 00 00 00 02 1c 1a
			23 00 00 00 00 00 02 1d 1c
			23 00 00 00 00 00 02 1e 1e
			23 00 00 00 00 00 02 1f 20
			23 00 00 00 00 00 02 20 26
			23 00 00 00 00 00 02 21 28
			23 00 00 00 00 00 02 22 08
			23 00 00 00 00 00 02 23 38
			23 00 00 00 00 00 02 24 38
			23 00 00 00 00 00 02 25 0e
			23 00 00 00 00 00 02 26 40
			23 00 00 00 00 00 02 27 40
			23 00 00 00 00 00 02 28 40
			23 00 00 00 00 00 02 29 40
			23 00 00 00 00 00 02 2a 40
			23 00 00 00 00 00 02 2b 40
			23 00 00 00 00 00 02 2d 40
			23 00 00 00 00 00 02 2f 08
			23 00 00 00 00 00 02 30 20
			23 00 00 00 00 00 02 31 1e
			23 00 00 00 00 00 02 32 1c
			23 00 00 00 00 00 02 33 1a
			23 00 00 00 00 00 02 34 18
			23 00 00 00 00 00 02 35 16
			23 00 00 00 00 00 02 36 26
			23 00 00 00 00 00 02 37 28
			23 00 00 00 00 00 02 38 06
			23 00 00 00 00 00 02 39 38
			23 00 00 00 00 00 02 3a 38
			23 00 00 00 00 00 02 3b 0e
			23 00 00 00 00 00 02 3d 40
			23 00 00 00 00 00 02 3f 40
			23 00 00 00 00 00 02 40 40
			23 00 00 00 00 00 02 41 40
			23 00 00 00 00 00 02 42 40
			23 00 00 00 00 00 02 43 40
			23 00 00 00 00 00 02 44 40
			23 00 00 00 00 00 02 45 09
			23 00 00 00 00 00 02 46 21
			23 00 00 00 00 00 02 47 1f
			23 00 00 00 00 00 02 48 1d
			23 00 00 00 00 00 02 49 1b
			23 00 00 00 00 00 02 4a 19
			23 00 00 00 00 00 02 4b 17
			23 00 00 00 00 00 02 4c 26
			23 00 00 00 00 00 02 4d 28
			23 00 00 00 00 00 02 4e 07
			23 00 00 00 00 00 02 4f 38
			23 00 00 00 00 00 02 50 38
			23 00 00 00 00 00 02 51 0f
			23 00 00 00 00 00 02 52 40
			23 00 00 00 00 00 02 53 40
			23 00 00 00 00 00 02 54 06
			23 00 00 00 00 00 02 55 21
			23 00 00 00 00 00 02 59 1b
			23 00 00 00 00 00 02 5b 02
			23 00 00 00 00 00 02 5c 02
			23 00 00 00 00 00 02 5d 01
			23 00 00 00 00 00 02 5e 25
			23 00 00 00 00 00 02 62 19
			23 00 00 00 00 00 02 63 02
			23 00 00 00 00 00 02 64 02
			23 00 00 00 00 00 02 66 48
			23 00 00 00 00 00 02 67 11
			23 00 00 00 00 00 02 68 02
			23 00 00 00 00 00 02 69 12
			23 00 00 00 00 00 02 6a 04
			23 00 00 00 00 00 02 6b 26
			23 00 00 00 00 00 02 6c 08
			23 00 00 00 00 00 02 6d 18
			23 00 00 00 00 00 02 6f 3c
			23 00 00 00 00 00 02 70 03
			23 00 00 00 00 00 02 72 22
			23 00 00 00 00 00 02 73 22
			23 00 00 00 00 00 02 7d 01
			23 00 00 00 00 00 02 7e 00
			23 00 00 00 00 00 02 7f 00
			23 00 00 00 00 00 02 80 00
			23 00 00 00 00 00 02 81 00
			23 00 00 00 00 00 02 85 fc
			23 00 00 00 00 00 02 86 fc
			23 00 00 00 00 00 02 b7 00
			23 00 00 00 00 00 02 bd a6
			23 00 00 00 00 00 02 be 08
			23 00 00 00 00 00 02 bf 12
			23 00 00 00 00 00 02 c8 00
			23 00 00 00 00 00 02 c9 00
			23 00 00 00 00 00 02 ca 00
			23 00 00 00 00 00 02 cb 00
			23 00 00 00 00 00 02 cc 09
			23 00 00 00 00 00 02 cf 88
			23 00 00 00 00 00 02 d0 00
			23 00 00 00 00 00 02 d1 00
			23 00 00 00 00 00 02 d2 00
			23 00 00 00 00 00 02 d3 00
			23 00 00 00 00 00 02 d4 40
			23 00 00 00 00 00 02 d5 11
			23 00 00 00 00 00 02 90 78
			23 00 00 00 00 00 02 91 0a
			23 00 00 00 00 00 02 92 1e
			23 00 00 00 00 00 02 d7 31
			23 00 00 00 00 00 02 d8 7e
			23 00 00 00 00 00 02 ff ee
			23 00 00 00 00 00 02 30 60
			23 00 00 00 00 00 02 ff 00
			23 00 00 00 00 00 02 51 00//0a
			23 00 00 00 00 00 02 53 24
			23 00 00 00 00 00 02 55 03
			05 01 00 00 78 00 02 11 00
			05 01 00 00 00 00 02 29 00
			23 00 00 00 00 00 02 d3 10//09//1e
			23 00 00 00 00 00 02 d4 14//0a//02//03//0a
			23 00 00 00 00 00 02 d5 28//5a//1e
			23 00 00 00 00 00 02 d6 84//64//0a
			];
		qcom,mdss-dsi-off-command = [
			05 01 00 00 14 00 02 28 00
			05 01 00 00 50 00 02 10 00];
		qcom,mdss-dsi-on-command-state = "dsi_lp_mode";
		qcom,mdss-dsi-off-command-state = "dsi_hs_mode";
		qcom,mdss-dsi-panel-status-command = [06 01 00 01 05 00 02 0A 08];
		qcom,mdss-dsi-panel-status-command-state = "dsi_lp_mode";
		qcom,mdss-dsi-panel-status-check-mode = "reg_read";	//"reg_read_nt35596";
		qcom,mdss-dsi-panel-status-value = <0x9c>;
		qcom,esd-check-enabled;
		qcom,mdss-dsi-tx-eot-append;
		//qcom,mdss-dsi-rx-eot-ignore;
		qcom,mdss-dsi-h-sync-pulse = <1>;
		qcom,mdss-dsi-traffic-mode = "burst_mode";
		//qcom,mdss-dsi-lane-map = "lane_map_0123";
		qcom,mdss-dsi-bllp-eof-power-mode;
		qcom,mdss-dsi-bllp-power-mode;
		qcom,mdss-dsi-lane-0-state;
		qcom,mdss-dsi-lane-1-state;
		qcom,mdss-dsi-lane-2-state;
		qcom,mdss-dsi-lane-3-state;
		qcom,mdss-dsi-panel-timings = [e7 36 24 00 68 6a 2a 3a 2d 03 04 00];
		qcom,mdss-dsi-t-clk-post = <0x03>;
		qcom,mdss-dsi-t-clk-pre = <0x2b>;
		qcom,mdss-dsi-bl-min-level = <1>;
		qcom,mdss-dsi-bl-max-level = <255>;
		qcom,mdss-dsi-dma-trigger = "trigger_sw";
		qcom,mdss-dsi-mdp-trigger = "none";
		qcom,mdss-dsi-bl-pmic-control-type = "bl_ctrl_dcs";
		//qcom,mdss-dsi-bl-pmic-pwm-frequency = <30>;
		//qcom,mdss-dsi-bl-pmic-bank-select = <0>;
		//qcom,mdss-dsi-pwm-gpio = <&pm8916_mpps 4 0>;
		qcom,mdss-dsi-reset-sequence = <1 10>, <0 10>, <1 10>, <0 10>, <1 15>;
	};
};
