/* Copyright (c) 2013-2014, The Linux Foundation. All rights reserved.
 *
 * This program is free software; you can redistribute it and/or modify
 * it under the terms of the GNU General Public License version 2 and
 * only version 2 as published by the Free Software Foundation.
 *
 * This program is distributed in the hope that it will be useful,
 * but WITHOUT ANY WARRANTY; without even the implied warranty of
 * MERCHANTABILITY or FITNESS FOR A PARTICULAR PURPOSE.  See the
 * GNU General Public License for more details.
 */

&mdss_mdp {
	dsi_tryotm1901a_1080p_vid: qcom,mdss_dsi_tryotm1901a_1080p_video {
		qcom,mdss-dsi-panel-name = "tryotm1901a 1080p video mode dsi panel";
		qcom,mdss-dsi-panel-controller = <&mdss_dsi0>;
		qcom,mdss-dsi-panel-type = "dsi_video_mode";
		qcom,mdss-dsi-panel-destination = "display_1";
		qcom,mdss-dsi-panel-framerate = <60>;
		qcom,mdss-dsi-virtual-channel-id = <0>;
		qcom,mdss-dsi-stream = <0>;
		qcom,mdss-dsi-panel-id = <0x01>; 
		qcom,mdss-dsi-panel-width = <1080>;
		qcom,mdss-dsi-panel-height = <1920>;
		qcom,mdss-dsi-h-front-porch = <93>;//should be large than 32
		qcom,mdss-dsi-h-back-porch = <93>;//25
		qcom,mdss-dsi-h-pulse-width = <5>;//20
		qcom,mdss-dsi-h-sync-skew = <0>;
		qcom,mdss-dsi-v-back-porch = <8>;//6
		qcom,mdss-dsi-v-front-porch = <10>;////14
		qcom,mdss-dsi-v-pulse-width = <2>;		
		qcom,mdss-dsi-h-left-border = <0>;
		qcom,mdss-dsi-h-right-border = <0>;
		qcom,mdss-dsi-v-top-border = <0>;
		qcom,mdss-dsi-v-bottom-border = <0>;
		qcom,mdss-dsi-bpp = <24>;
		qcom,mdss-dsi-underflow-color = <0xff>;
		qcom,mdss-dsi-border-color = <0>;
		
		qcom,mdss-dsi-on-command = [
			39 01 00 00 00 00 02 00 00
			39 01 00 00 00 00 04 FF 19 01 01 //00//
			39 01 00 00 00 00 02 00 80
			39 01 00 00 00 00 03 FF 19 01
			39 01 00 00 00 00 02 00 00
			39 01 00 00 00 00 02 1C 33
			39 01 00 00 00 00 02 00 A0
			39 01 00 00 00 00 02 C1 E8
			39 01 00 00 00 00 02 00 A7
			39 01 00 00 00 00 02 C1 00
			39 01 00 00 00 00 02 00 90
			39 01 00 00 00 00 07 c0 00 2F 00 00 00 01
			39 01 00 00 00 00 02 00 C0
			39 01 00 00 00 00 07 c0 00 2F 00 00 00 01
			39 01 00 00 00 00 02 00 9A
			39 01 00 00 00 00 02 C0 1E
			39 01 00 00 00 00 02 00 AC
			39 01 00 00 00 00 02 C0 06
			39 01 00 00 00 00 02 00 DC
			39 01 00 00 00 00 02 C0 06
			39 01 00 00 00 00 02 00 81
			39 01 00 00 00 00 02 A5 06
			//39 01 00 00 00 00 02 00 80
			//39 01 00 00 00 00 02 C4 1F
			39 01 00 00 00 00 02 00 82
			39 01 00 00 00 00 02 C4 F0
			39 01 00 00 00 00 02 00 92
			39 01 00 00 00 00 02 E9 00
			39 01 00 00 00 00 02 00 90
			39 01 00 00 00 00 02 F3 01
			39 01 00 00 00 00 02 00 93
			39 01 00 00 00 00 02 C5 1E//19
			39 01 00 00 00 00 02 00 95
			39 01 00 00 00 00 02 C5 32//2D
			39 01 00 00 00 00 02 00 97
			39 01 00 00 00 00 02 C5 19
			39 01 00 00 00 00 02 00 99
			39 01 00 00 00 00 02 C5 2D
			39 01 00 00 00 00 02 00 9B
			39 01 00 00 00 00 03 C5 33 30
			39 01 00 00 00 00 02 00 00
			39 01 00 00 00 00 03 D9 00 AB
			39 01 00 00 00 00 02 00 00
			39 01 00 00 00 00 03 D8 1F 1F
			39 01 00 00 00 00 02 00 B3
			39 01 00 00 00 00 02 C0 CC
			39 01 00 00 00 00 02 00 BC
			39 01 00 00 00 00 02 C0 00
			39 01 00 00 00 00 02 00 84
			39 01 00 00 00 00 02 C4 22
			39 01 00 00 00 00 02 00 94
			39 01 00 00 00 00 02 C1 84//C4
			39 01 00 00 00 00 02 00 98
			39 01 00 00 00 00 02 C1 74
			39 01 00 00 00 00 02 00 80
			39 01 00 00 00 00 02 C4 38//C1
			39 01 00 00 00 00 02 00 CD
			39 01 00 00 00 00 02 F5 19
			39 01 00 00 00 00 02 00 DB
			39 01 00 00 00 00 02 F5 19
			39 01 00 00 00 00 02 00 F5
			39 01 00 00 00 00 02 C1 40
			39 01 00 00 00 00 02 00 B9
			39 01 00 00 00 00 02 C0 11
			39 01 00 00 00 00 02 00 8D
			39 01 00 00 00 00 02 F5 20
			39 01 00 00 00 00 02 00 80
			39 01 00 00 00 00 0f C0 00 7F 00 0A 0A 00 7F 0A 0A 00 7F 00 0A 0A
			/*39 01 00 00 00 00 0F C0 00 86 00 0A 0A 00 86 0A 0A 00 86 00 0A 0A
			39 01 00 00 00 00 02 00 F7
			39 01 00 00 00 00 05 C3 04 19 04 04
			39 01 00 00 00 00 02 00 80
			39 01 00 00 00 00 02 C4 13
			39 01 00 00 00 00 02 00 9B
			39 01 00 00 00 00 04 C5 11 10 75
			39 01 00 00 00 00 02 00 C1
			39 01 00 00 00 00 02 C5 44*/
			39 01 00 00 00 00 02 00 F0
			39 01 00 00 00 00 07 C3 00 00 00 00 00 80
			39 01 00 00 00 00 02 00 A0
			39 01 00 00 00 00 08 C0 00 00 0A 00 00 1E 06
			39 01 00 00 00 00 02 00 D0
			39 01 00 00 00 00 08 C0 00 00 0A 00 00 1E 06
			39 01 00 00 00 00 02 00 90
			39 01 00 00 00 00 05 C2 82 00 36 47
			
			39 01 00 00 00 00 02 00 B0 
			39 01 00 00 00 00 09 C2 01 00 3E 4A 01 01 3E 4A 
			39 01 00 00 00 00 02 00 80 
			39 01 00 00 00 00 0D C3 84 04 01 00 09 01 83 04 01 00 09 01 

			39 01 00 00 00 00 02 00 80 
			39 01 00 00 00 00 10 CC 09 0D 11 12 13 14 15 16 17 18 0E 28 28 28 28 
			39 01 00 00 00 00 02 00 90 
			39 01 00 00 00 00 10 CC 0D 09 12 11 13 14 15 16 17 18 0E 28 28 28 28 

			39 01 00 00 00 00 02 00 A0 
			39 01 00 00 00 00 10 CC 1D 1E 1F 19 1A 1B 1C 20 21 22 23 24 25 26 27 

			39 01 00 00 00 00 02 00 B0 //ckv set
			39 01 00 00 00 00 09 CC 01 02 03 05 06 07 04 08 

			39 01 00 00 00 00 02 00 C0 //ckv set
			39 01 00 00 00 00 0D CC 00 00 00 00 00 00 00 00 00 00 00 77 

			39 01 00 00 00 00 02 00 D0 //ckv period video
			39 01 00 00 00 00 0D CC FF 00 30 C0 0F 30 00 00 33 03 00 77 

			39 01 00 00 00 00 02 00 DE 
			39 01 00 00 00 00 02 CC 00 //
			39 01 00 00 00 00 02 00 80 
			39 01 00 00 00 00 10 CB 00 00 00 00 00 00 00 00 00 00 30 00 00 00 00 

			39 01 00 00 00 00 02 00 90 
			39 01 00 00 00 00 10 CB 30 00 FF 00 00 00 00 00 00 00 00 00 00 00 00 

			39 01 00 00 00 00 02 00 A0 
			39 01 00 00 00 00 10 CB 15 15 05 F5 01 01 00 00 00 00 01 00 00 00 00 

			39 01 00 00 00 00 02 00 B0 
			39 01 00 00 00 00 10 CB 00 01 FD 00 00 00 00 00 00 00 00 00 00 00 00 

			39 01 00 00 00 00 02 00 C0 
			39 01 00 00 00 00 09 CB 00 00 00 00 00 00 77 77 

			39 01 00 00 00 00 02 00 D0 
			39 01 00 00 00 00 09 CB 00 00 00 00 00 00 77 77 

			39 01 00 00 00 00 02 00 E0 
			39 01 00 00 00 00 09 CB 00 00 00 01 01 01 77 77 

			39 01 00 00 00 00 02 00 F0 
			39 01 00 00 00 00 09 CB 11 11 11 11 11 11 77 77 
			39 01 00 00 00 00 02 00 80 
			39 01 00 00 00 00 10 CD 3F 3F 3F 3F 3F 3F 3F 3F 01 12 11 03 04 0B 17 

			39 01 00 00 00 00 02 00 90 
			39 01 00 00 00 00 0C CD 3D 02 3D 25 25 25 1F 20 21 25 25 

			39 01 00 00 00 00 02 00 A0 
			39 01 00 00 00 00 10 CD 3F 3F 3F 3F 3F 3F 3F 3F 01 12 11 03 04 0B 17 

			39 01 00 00 00 00 02 00 B0 
			39 01 00 00 00 00 0C CD 17 02 3D 25 25 25 1F 20 21 25 25 
		


			39 01 00 00 00 00 02 00 D4   //LTPS Ground Period for Gate Precharge
			39 01 00 00 00 00 05 C3 01 01 01 01 

			39 01 00 00 00 00 02 00 F7 
			39 01 00 00 00 00 05 C3 03 1B 00 00 

			39 01 00 00 00 00 02 00 F2   //Gate slew rate
			39 01 00 00 00 00 04 C1 80 0F 0F 

			39 01 00 00 00 00 02 00 B0 
			39 01 00 00 00 00 02 CA 04 
			39 01 00 00 00 00 02 00 B1 
			39 01 00 00 00 00 02 CA 04 
			39 01 00 00 00 00 02 00 B3 
			39 01 00 00 00 00 02 CA 48 

			//disable ERROR report by Huawei
			39 01 00 00 00 00 02 00 90 
			39 01 00 00 00 00 02 B0 00 
			39 01 00 00 00 00 02 00 D0 
			39 01 00 00 00 00 05 F5 00 00 00 00 

			39 01 00 00 00 00 02 00 80
			39 01 00 00 00 00 02 C4 18

			//39 01 00 00 00 00 02 00 A2
			//39 01 00 00 00 00 02 C0 0F

			//39 01 00 00 00 00 02 00 D2
			//39 01 00 00 00 00 02 C0 0F

			//39 01 00 00 00 00 02 00 96
			//39 01 00 00 00 00 04 CD 25 25 25

			39 01 00 00 00 00 02 00 00
			39 01 00 00 00 00 04 FF FF FF FF 

			39 01 00 00 00 00 02 51 FF               
			39 01 00 00 00 00 02 53 24


			39 01 00 00 78 00 02 11 00
			39 01 00 00 00 00 02 29 00

			//39 01 00 00 00 00 02 00 00///unlock cmd
			//39 01 00 00 00 00 03 99 00 00
		];
		qcom,mdss-dsi-off-command = [		
		//39 01 00 00 00 00 02 00 00
		//39 01 00 00 00 00 03 99 95 27///unlock cmd
		05 01 00 00 32 00 02 28 00
		05 01 00 00 78 00 02 10 00
		//39 01 00 00 00 00 02 00 00
		//39 01 00 00 00 00 03 99 00 00
		];
		qcom,mdss-dsi-on-command-state = "dsi_lp_mode";
		qcom,mdss-dsi-off-command-state = "dsi_hs_mode";
		qcom,mdss-dsi-h-sync-pulse = <1>;
		qcom,mdss-dsi-traffic-mode = "burst_mode";
		qcom,mdss-dsi-bllp-eof-power-mode;
		qcom,mdss-dsi-bllp-power-mode;
		//qcom,mdss-dsi-hbp-power-mode;////lrz add 
		qcom,mdss-dsi-lane-0-state;
		qcom,mdss-dsi-lane-1-state;
		qcom,mdss-dsi-lane-2-state;
		qcom,mdss-dsi-lane-3-state;
		//qcom,mdss-dsi-panel-timings = [f9 32 22 00 60 70 18 41 34 03 04 00];
		qcom,mdss-dsi-panel-timings = [f9 38 26 00 68 6C 2A 3E 35 03 04 00];
		qcom,mdss-dsi-t-clk-post = <0x02>;
		qcom,mdss-dsi-t-clk-pre = <0x27>;
		qcom,mdss-dsi-bl-min-level = <1>;
		qcom,mdss-dsi-bl-max-level = <255>;
		qcom,mdss-dsi-dma-trigger = "trigger_sw";
		qcom,mdss-dsi-mdp-trigger = "none";
		qcom,mdss-dsi-bl-pmic-control-type = "bl_ctrl_dcs";
		qcom,mdss-dsi-project-name = "pd1523a";
		qcom,mdss-pan-physical-width-dimension = <68>;
		qcom,mdss-pan-physical-height-dimension = <121>;
		qcom,mdss-dsi-reset-sequence = <1 5>, <0 5>, <1 5>,<0 5>, <1 20>;

	};
};
