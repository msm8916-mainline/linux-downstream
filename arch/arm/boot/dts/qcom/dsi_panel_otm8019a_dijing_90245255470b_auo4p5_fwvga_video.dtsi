/* Copyright (c) 2013, The Linux Foundation. All rights reserved.
 *
 * This program is free software; you can redistribute it and/or modify
 * it under the terms of the GNU General Public License version 2 and
 * only version 2 as published by the Free Software Foundation.
 *
 * This program is distributed in the hope that it will be useful,
 * but WITHOUT ANY WARRANTY; without even the implied warranty of
 * MERCHANTABILITY or FITNESS FOR A PARTICULAR PURPOSE.  See the
 * GNU General Public License for more details.
 */

/*---------------------------------------------------------------------------
 * This file is autogenerated file using gcdb parser. Please do not edit it.
 * Update input XML file to add a new entry or update variable in this file
 * VERSION = "1.0"
 *---------------------------------------------------------------------------*/
 /*
 Date            Author          IC                Module        Why
2015-05-20	     xingbin    	otm8019A		   dijing       add dijing lcd for AL620
 */
&mdss_mdp {
	otm8019a_dijing_90245255470b_auo4p5_fwvga_vid: qcom,otm8019a_dijing_90245255470b_auo4p5_fwvga {
		qcom,mdss-dsi-panel-name = "dijing_otm8019a_90245255470b_auo4p5_fwvga";
		qcom,mdss-dsi-panel-code-version="@20150520";
		qcom,mdss-dsi-panel-controller = <&mdss_dsi0>;
		qcom,mdss-dsi-panel-type = "dsi_video_mode";
		qcom,mdss-dsi-panel-destination = "display_1";
		qcom,mdss-dsi-panel-framerate = <60>;
		qcom,mdss-dsi-virtual-channel-id = <0>;
		qcom,mdss-dsi-stream = <0>;
		qcom,mdss-dsi-panel-width = <480>;
		qcom,mdss-dsi-panel-height = <854>;
		qcom,mdss-dsi-h-front-porch = <60>;
		qcom,mdss-dsi-h-back-porch = <60>;
		qcom,mdss-dsi-h-pulse-width = <12>;
		qcom,mdss-dsi-h-sync-skew = <0>;
		qcom,mdss-dsi-v-back-porch = <20>;
		qcom,mdss-dsi-v-front-porch = <16>;
		qcom,mdss-dsi-v-pulse-width = <2>;
		qcom,mdss-dsi-h-left-border = <0>;
		qcom,mdss-dsi-h-right-border = <0>;
		qcom,mdss-dsi-v-top-border = <0>;
		qcom,mdss-dsi-v-bottom-border = <0>;
		qcom,mdss-dsi-bpp = <24>;
		qcom,mdss-dsi-color-order = <0>;
		qcom,mdss-dsi-underflow-color = <0xff>;
		qcom,mdss-dsi-border-color = <0>;
		qcom,mdss-dsi-pixel-packing = <0>;
		qcom,mdss-dsi-on-command = [ 
		39 01 00 00 00 00 02 00 00
		39 01 00 00 00 00 04 FF 80 19 01
		39 01 00 00 00 00 02 00 80
		39 01 00 00 00 00 03 FF 80 19
		39 01 00 00 00 00 02 00 80
		39 01 00 00 00 00 07 CE 83 01 1A 82 01 1A
		39 01 00 00 00 00 02 00 90
		39 01 00 00 00 00 07 CE 13 54 1A 13 55 1A
		39 01 00 00 00 00 02 00 A0
		39 01 00 00 00 00 0f CE 18 05 03 55 00 1A 00 18 04 03 56 00 1A 00
		39 01 00 00 00 00 02 00 B0
		39 01 00 00 00 00 0f CE 18 07 03 57 00 1A 00 18 06 03 58 00 1A 00
		39 01 00 00 00 00 02 00 C0
		39 01 00 00 00 00 0f CE 18 07 03 57 00 12 1A 18 06 03 58 00 12 1A
		39 01 00 00 00 00 02 00 D0
		39 01 00 00 00 00 0f CE 18 05 03 58 00 12 1A 18 04 03 59 00 12 1A
		39 01 00 00 00 00 02 00 C0
		39 01 00 00 00 00 0b CF 00 00 00 00 00 00 01 04 00 00
		39 01 00 00 00 00 02 00 80
		39 01 00 00 00 00 0a CB 00 00 00 00 00 00 00 00 00
		39 01 00 00 00 00 02 00 90
		39 01 00 00 00 00 10 CB 00 00 00 00 00 00 00 00 00 00 00 00 00 00 00
		39 01 00 00 00 00 02 00 A0
		39 01 00 00 00 00 02 CB 00
		39 01 00 00 00 00 02 00 A5
		39 01 00 00 00 00 0b CB 00 00 00 00 00 00 00 00 00 00
		39 01 00 00 00 00 02 00 B0
		39 01 00 00 00 00 07 CB 00 00 00 00 00 00
		39 01 00 00 00 00 02 00 C0
		39 01 00 00 00 00 10 CB 15 00 15 15 15 15 15 00 00 00 00 00 00 00 00
		39 01 00 00 00 00 02 00 D0
		39 01 00 00 00 00 02 CB 00
		39 01 00 00 00 00 02 00 D5
		39 01 00 00 00 00 0b CB 00 00 00 00 00 00 00 00 00 15
		39 01 00 00 00 00 02 00 E0
		39 01 00 00 00 00 07 CB 15 15 15 15 00 15
		39 01 00 00 00 00 02 00 F0
		39 01 00 00 00 00 09 CB FF FF FF FF FF FF FF FF
		39 01 00 00 00 00 02 00 80
		39 01 00 00 00 00 0b CC 01 00 0B 09 0F 0D 05 00 00 00
		39 01 00 00 00 00 02 00 90
		39 01 00 00 00 00 07 CC 00 00 00 00 00 00
		39 01 00 00 00 00 02 00 9A
		39 01 00 00 00 00 06 CC 00 00 00 00 00
		39 01 00 00 00 00 02 00 A0
		39 01 00 00 00 00 0c CC 00 00 00 00 06 0E 10 0A 0C 00 02
		39 01 00 00 00 00 02 00 B0
		39 01 00 00 00 00 0b CC 06 00 0C 0A 0E 10 02 00 00 00
		39 01 00 00 00 00 02 00 C0
		39 01 00 00 00 00 07 CC 00 00 00 00 00 00
		39 01 00 00 00 00 02 00 CA
		39 01 00 00 00 00 06 CC 00 00 00 00 00
		39 01 00 00 00 00 02 00 D0
		39 01 00 00 00 00 0c CC 00 00 00 00 01 0F 0D 09 0B 00 05
		39 01 00 00 00 00 02 00 90
		39 01 00 00 00 00 03 C5 4E 76
		39 01 00 00 00 00 02 00 00
		39 01 00 00 00 00 03 D8 97 97
		39 01 00 00 00 00 02 00 00
		39 01 00 00 00 00 02 D9 3E
		39 01 00 00 00 00 02 00 A0
		39 01 00 00 00 00 02 C1 E8
		39 01 00 00 00 00 02 00 80
		39 01 00 00 00 00 03 C1 00 03
		39 01 00 00 00 00 02 00 90
		39 01 00 00 00 00 07 C0 00 15 00 00 00 03
		39 01 00 00 00 00 02 00 98
		39 01 00 00 00 00 02 C0 00
		39 01 00 00 00 00 02 00 A9
		39 01 00 00 00 00 02 C0 0A
		39 01 00 00 00 00 02 00 B0
		39 01 00 00 00 00 04 C1 20 00 00
		39 01 00 00 00 00 02 00 E1
		39 01 00 00 00 00 03 C0 40 30
		39 01 00 00 00 00 02 00 90
		39 01 00 00 00 00 03 B6 B4 5A
		39 01 00 00 00 00 02 00 90
		39 01 00 00 00 00 02 B3 02
		39 01 00 00 00 00 02 00 92
		39 01 00 00 00 00 02 B3 40
		39 01 00 00 00 00 02 00 B4
		39 01 00 00 00 00 02 C0 00
		39 01 00 00 00 00 02 00 00
		39 01 00 00 00 00 15 E1 00 0D 18 25 32 42 45 74 67 83 7E 66 76 4F 4C 3C 2D 1E 13 00
		39 01 00 00 00 00 02 00 00
		39 01 00 00 00 00 15 E2 00 0D 18 25 32 42 45 74 67 83 7E 66 76 4F 4C 3C 2D 1E 13 00
		39 01 00 00 00 00 02 00 80
		39 01 00 00 00 00 02 C4 30
		39 01 00 00 00 00 02 00 9A
		39 01 00 00 00 00 02 C0 0A
		39 01 00 00 00 00 02 00 B0
		39 01 00 00 00 00 04 C1 20 00 00
		39 01 00 00 00 00 02 00 80
		39 01 00 00 00 00 03 C1 03 33
		39 01 00 00 00 00 02 00 90
		39 01 00 00 00 00 02 B6 B4
		39 01 00 00 00 00 02 00 00
		39 01 00 00 00 00 02 FB 01
		39 01 00 00 00 00 02 00 00
		39 01 00 00 00 00 04 FF FF FF FF
		39 01 00 00 78 00 02 11 00
		39 01 00 00 14 00 02 29 00
		];
		qcom,mdss-dsi-off-command = [05 01 00 00 32 00 02 28 00
					05 01 00 00 78 00 02 10 00];
		qcom,mdss-dsi-on-command-state = "dsi_lp_mode";
		qcom,mdss-dsi-off-command-state = "dsi_lp_mode";
		qcom,mdss-dsi-lp11-init;
		qcom,mdss-dsi-h-sync-pulse = <1>;
		qcom,mdss-dsi-traffic-mode = <2>;
		qcom,mdss-dsi-lane-map = <0>;
		qcom,mdss-dsi-bllp-eof-power-mode;
		qcom,mdss-dsi-bllp-power-mode;
		qcom,mdss-dsi-lane-0-state;
		qcom,mdss-dsi-lane-1-state;
		/*qcom,mdss-dsi-lane-2-state;
		qcom,mdss-dsi-lane-3-state;*/
		qcom,mdss-dsi-panel-timings = [76 18 10 00 3C 3E 14 1C 12 03 04 00];
		qcom,mdss-dsi-t-clk-post = <0x04>;
		qcom,mdss-dsi-t-clk-pre = <0x19>;
		qcom,mdss-dsi-bl-min-level = <0>;
		qcom,mdss-dsi-bl-max-level = <255>;
		qcom,mdss-dsi-dma-trigger = <4>;
		qcom,mdss-dsi-mdp-trigger = <0>;
		qcom,mdss-pan-bl-levels = <1 255>;
		qcom,mdss-dsi-bl-pmic-control-type = "bl_ctrl_pwm"; 
		qcom,mdss-dsi-bl-pmic-bank-select = <0>;
		qcom,mdss-dsi-bl-pmic-pwm-frequency = <100>; 
		qcom,mdss-dsi-pwm-gpio = <&pm8909_mpps 2 0>; 
		qcom,mdss-dsi-reset-sequence = <1 10>, <0 10>, <1 120>;
	};
};