/* Copyright (c) 2013, The Linux Foundation. All rights reserved.
 *
 * This program is free software; you can redistribute it and/or modify
 * it under the terms of the GNU General Public License version 2 and
 * only version 2 as published by the Free Software Foundation.
 *
 * This program is distributed in the hope that it will be useful,
 * but WITHOUT ANY WARRANTY; without even the implied warranty of
 * MERCHANTABILITY or FITNESS FOR A PARTICULAR PURPOSE.  See the
 * GNU General Public License for more details.
 */

/*---------------------------------------------------------------------------
 * This file is autogenerated file using gcdb parser. Please do not edit it.
 * Update input XML file to add a new entry or update variable in this file
 * VERSION = "1.0"
 *---------------------------------------------------------------------------*/
&mdss_mdp {
	dsi_ili6136s_800x1280_video: qcom,mdss_dsi_ili6136s_800x1280_video {
		qcom,mdss-dsi-panel-name = "ili6136s 800x1280 video mode dsi panel";
		qcom,mdss-dsi-panel-controller = <&mdss_dsi0>;
		qcom,mdss-dsi-panel-type = "dsi_video_mode";
		qcom,mdss-dsi-panel-destination = "display_1";
		qcom,mdss-dsi-panel-framerate = <60>;
		qcom,mdss-dsi-virtual-channel-id = <0>;
		qcom,mdss-dsi-stream = <0>;
		qcom,mdss-dsi-panel-width = <800>;
		qcom,mdss-dsi-panel-height = <1280>;
		qcom,mdss-dsi-h-front-porch = <40>;
		qcom,mdss-dsi-h-back-porch = <40>;
		qcom,mdss-dsi-h-pulse-width = <4>;
		qcom,mdss-dsi-h-sync-skew = <0>;
		qcom,mdss-dsi-v-back-porch = <15>;
		qcom,mdss-dsi-v-front-porch = <15>;
		qcom,mdss-dsi-v-pulse-width = <3>;
		qcom,mdss-dsi-h-left-border = <0>;
		qcom,mdss-dsi-h-right-border = <0>;
		qcom,mdss-dsi-v-top-border = <0>;
		qcom,mdss-dsi-v-bottom-border = <0>;
		qcom,mdss-dsi-bpp = <24>;
		qcom,mdss-dsi-color-order = "rgb_swap_rgb";
		qcom,mdss-dsi-underflow-color = <0xff>;
		qcom,mdss-dsi-border-color = <0>;
		qcom,mdss-dsi-on-command = [29 01 00 00 00 00 04 FF 61 36 08
				29 01 00 00 00 00 02 1C A0
				29 01 00 00 00 00 04 FF 61 36 08
				29 01 00 00 00 00 02 4C 08
				29 01 00 00 00 00 04 FF 61 36 08
				29 01 00 00 00 00 02 E9 0B
				29 01 00 00 00 00 04 FF 61 36 06
				29 01 00 00 00 00 02 72 01
				29 01 00 00 00 00 04 FF 61 36 08
				29 01 00 00 00 00 02 93 08
				29 01 00 00 00 00 04 FF 61 36 01
				29 01 00 00 00 00 02 60 14
				29 01 00 00 00 00 04 FF 61 36 07
				29 01 00 00 00 00 02 1A 05
				29 01 00 00 00 00 04 FF 61 36 07
				29 01 00 00 00 00 02 16 1F
				29 01 00 00 00 00 04 FF 61 36 07
				29 01 00 00 00 00 02 0D 05
				29 01 00 00 00 00 04 FF 61 36 07
				29 01 00 00 00 00 02 0A 03
				29 01 00 00 00 00 04 FF 61 36 07
				29 01 00 00 00 00 02 0E 35
				29 01 00 00 00 00 04 FF 61 36 07
				29 01 00 00 00 00 02 0B 1F
				29 01 00 00 00 00 04 FF 61 36 08
				29 01 00 00 00 00 02 E9 0B
				29 01 00 00 00 00 04 FF 61 36 00
				29 01 00 00 96 00 02 11 00
				29 01 00 00 0A 00 02 29 00];
		qcom,mdss-dsi-off-command = [29 01 00 00 14 00 02 28 00
				29 01 00 00 B4 00 02 10 00];
		qcom,mdss-dsi-on-command-state = "dsi_lp_mode";
		qcom,mdss-dsi-off-command-state = "dsi_hs_mode";
		qcom,mdss-dsi-h-sync-pulse = <1>;
		qcom,mdss-dsi-traffic-mode = "non_burst_sync_event";
		qcom,mdss-dsi-lane-map = "lane_map_0123";
		qcom,mdss-dsi-bllp-eof-power-mode;
		qcom,mdss-dsi-bllp-power-mode;
		qcom,mdss-dsi-lane-0-state;
		qcom,mdss-dsi-lane-1-state;
		qcom,mdss-dsi-lane-2-state;
		qcom,mdss-dsi-lane-3-state;
		qcom,mdss-dsi-panel-timings = [7b 1a 10 00 3e 40 16 1e 15 03 04 00];
		qcom,mdss-dsi-t-clk-post = <0x4>;
		qcom,mdss-dsi-t-clk-pre = <0x1a>;
		qcom,mdss-dsi-bl-min-level = <1>;
		qcom,mdss-dsi-bl-max-level = <128>;
		qcom,mdss-dsi-dma-trigger = "trigger_sw";
		qcom,mdss-dsi-mdp-trigger = "none";
		qcom,mdss-dsi-bl-pmic-control-type = "bl_ctrl_cadiz";
		qcom,mdss-dsi-reset-sequence = <1 5>, <0 2>, <1 20>;
	};
};
