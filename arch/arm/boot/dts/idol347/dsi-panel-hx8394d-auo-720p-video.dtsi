/* Copyright (c) 2014, The Linux Foundation. All rights reserved.
 *
 * This program is free software; you can redistribute it and/or modify
 * it under the terms of the GNU General Public License version 2 and
 * only version 2 as published by the Free Software Foundation.
 *
 * This program is distributed in the hope that it will be useful,
 * but WITHOUT ANY WARRANTY; without even the implied warranty of
 * MERCHANTABILITY or FITNESS FOR A PARTICULAR PURPOSE.  See the
 * GNU General Public License for more details.
 */

/*---------------------------------------------------------------------------
 * This file is autogenerated file using gcdb parser. Please do not edit it.
 * Update input XML file to add a new entry or update variable in this file
 * VERSION = "1.0"
 *---------------------------------------------------------------------------*/
&mdss_mdp {
	dsi_hx8394d_auo_720_vid: qcom,mdss_dsi_hx8394d_auo_720p_video {
		qcom,mdss-dsi-panel-name = "hx8394d auo 720p video mode dsi panel";
		qcom,mdss-dsi-panel-controller = <&mdss_dsi0>;
		qcom,mdss-dsi-panel-type = "dsi_video_mode";
		qcom,mdss-dsi-panel-destination = "display_1";
		qcom,mdss-dsi-panel-framerate = <60>;
		qcom,mdss-dsi-virtual-channel-id = <0>;
		qcom,mdss-dsi-stream = <0>;
		qcom,mdss-dsi-panel-width = <720>;
		qcom,mdss-dsi-panel-height = <1280>;
		qcom,mdss-dsi-h-front-porch = <52>;
		qcom,mdss-dsi-h-back-porch = <100>;
		qcom,mdss-dsi-h-pulse-width = <24>;
		qcom,mdss-dsi-h-sync-skew = <0>;
                qcom,mdss-dsi-v-front-porch = <9>;
		qcom,mdss-dsi-v-back-porch = <5>;
		qcom,mdss-dsi-v-pulse-width = <2>;
		qcom,mdss-dsi-h-left-border = <0>;
		qcom,mdss-dsi-h-right-border = <0>;
		qcom,mdss-dsi-v-top-border = <0>;
		qcom,mdss-dsi-v-bottom-border = <0>;
		qcom,mdss-dsi-bpp = <24>;
		qcom,mdss-dsi-underflow-color = <0xff>;
		qcom,mdss-dsi-border-color = <0>;
		qcom,mdss-dsi-on-command = [39 01 00 00 00 00 04 b9 ff 83 94
				//39 01 00 00 00 00 03 ba 73 83
                                //39 01 00 00 00 00 0c ba 73 43 20 65 B2 09 09 40 10 00 00
                                39 01 00 00 00 00 0c ba 73 83 A0 65 B2 3F 4F 40 50 00 00
				39 01 00 00 00 00 10 b1 6c 12 12 34 04 11 f1 80 9f a0 23 80 c0 d2 58
				39 01 00 00 00 00 10 b2 00 64 05 07 22 1c 08 08 1c 4d 00 03 20 46 48
				39 01 00 00 00 00 0d b4 00 ff 03 5a 03 5a 03 5a 01 70 01 70
				39 01 00 00 00 00 02 bc 07
				//39 01 00 00 00 00 04 bf 41 0e 01
                                39 01 00 00 00 00 2b e0 12 2d 36 30 33 39 39 4a 09 0c 0e 18 0f 12 15 13 14 06 10 10 18 12 2d 36 30 33 39 39 4a 09 0c 0e 18 0f 12 15 13 14 0a 16 18 18 
				39 01 00 00 00 00 1f d3 00 06 00 01 01 10 00 32 10 00 00 00 32 15 04 35 04 32 15 14 05 14 37 33 00 00 37 00 07 37
				39 01 00 00 00 00 2d d5 18 18 18 18 18 18 18 18 18 18 18 18 18 18 25 24 27 26 18 18 47 46 43 42 41 40 45 44 05 04 01 00 07 06 03 02 21 20 23 22 18 18 18 18
				39 01 00 00 00 00 2d d6 18 18 18 18 18 18 18 18 18 18 18 18 18 18 22 23 20 21 18 18 00 01 04 05 06 07 02 03 02 03 06 07 00 01 04 05 26 27 24 25 18 18 18 18
                               //20150320 add
                                39 01 00 00 00 00 02 BD 01
                                39 01 00 00 00 00 25 D8 AA AB EF FF FF F0 AA AB EF FF FF F0 AA AB EF FF FF F0 AA AB EF FF FF F0 AA AB EF FF FF F0 AA AB EF FF FF F0
                                39 01 00 00 00 00 02 BD 02
                                39 01 00 00 00 00 0D D8 AA AB EF FF FF F0 AA AB EF FF FF F0

 
				39 01 00 00 00 00 02 cc 01
                                39 01 00 00 00 00 03 b6 62 62
				39 01 00 00 00 00 03 c0 30 14
				39 01 00 00 00 00 05 c7 00 c0 40 c0
                                39 01 00 00 00 00 02 36 02
                                39 01 00 00 00 00 02 35 00
				05 01 00 00 78 00 02 11 00
				05 01 00 00 0a 00 02 29 00];
		qcom,mdss-dsi-off-command = [ 05 01 00 00 78 00 02 10 00];
		qcom,mdss-dsi-on-command-state = "dsi_lp_mode";
		qcom,mdss-dsi-off-command-state = "dsi_hs_mode";
                /*LCD read register Check start*/
                qcom,esd-check-enabled;
		qcom,mdss-dsi-panel-status-command = [06 01 00 01 05 00 01 09];           //send command
                qcom,mdss-dsi-panel-status-command_for_one = [14 01 00 01 05 00 01 d9];   //send command one
		qcom,mdss-dsi-panel-status-command-state = "dsi_hs_mode";                 //user to lp mode read
		qcom,mdss-dsi-panel-status-check-mode = "reg_read_hx8394d";               //"reg_read_hx8394d";
		qcom,mdss-dsi-panel-status-value = <0x81 0x73 0x06>;                      //register return value1
                qcom,mdss-dsi-panel-status-value_for_one = <0x80>;                        //register return value2
                /*LCD read register Check End*/
		qcom,mdss-dsi-h-sync-pulse = <1>;
		qcom,mdss-dsi-traffic-mode = "burst_mode";//"non_burst_sync_pulse";//
		qcom,mdss-dsi-bllp-eof-power-mode;
		qcom,mdss-dsi-bllp-power-mode;
		qcom,mdss-dsi-lane-0-state;
		qcom,mdss-dsi-lane-1-state;
		qcom,mdss-dsi-lane-2-state;
		qcom,mdss-dsi-lane-3-state;
		qcom,mdss-dsi-panel-timings = [7b 1a 10 00 3e 40 16 1f 15 03 04 00];
		qcom,mdss-dsi-t-clk-post = <0x04>;
		qcom,mdss-dsi-t-clk-pre = <0x1A>;
		qcom,mdss-dsi-bl-min-level = <1>;
		qcom,mdss-dsi-bl-max-level = <255>;
                /*LCD LP11 Start*/
                //qcom,mdss-dsi-hfp-power-mode;
		//qcom,mdss-dsi-hbp-power-mode;
		//qcom,mdss-dsi-hsa-power-mode;
                /*LCD LP11 End*/
                /*Before reset, beginning LP11*/
                qcom,mdss-dsi-lp11-init;
		qcom,mdss-dsi-init-delay-us = <50000>;
                /*Before reset, beginning LP11*/
                qcom,mdss-dsi-bl-pmic-pwm-frequency = <33>;
                qcom,mdss-dsi-bl-pmic-bank-select = <0>;
		qcom,mdss-dsi-dma-trigger = "trigger_sw";
		qcom,mdss-dsi-mdp-trigger = "none";
		qcom,mdss-dsi-bl-pmic-control-type = "bl_ctrl_pwm";
		qcom,mdss-dsi-reset-sequence = <1 50>, <0 20>, <1 120>;
		qcom,mdss-pan-physical-width-dimension = <59>;
		qcom,mdss-pan-physical-height-dimension = <104>;

	};
};
