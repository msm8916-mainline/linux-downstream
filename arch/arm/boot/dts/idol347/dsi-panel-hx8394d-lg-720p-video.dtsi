/* Copyright (c) 2014, The Linux Foundation. All rights reserved.
 *
 * This program is free software; you can redistribute it and/or modify
 * it under the terms of the GNU General Public License version 2 and
 * only version 2 as published by the Free Software Foundation.
 *
 * This program is distributed in the hope that it will be useful,
 * but WITHOUT ANY WARRANTY; without even the implied warranty of
 * MERCHANTABILITY or FITNESS FOR A PARTICULAR PURPOSE.  See the
 * GNU General Public License for more details.
 */

/*---------------------------------------------------------------------------
 * This file is autogenerated file using gcdb parser. Please do not edit it.
 * Update input XML file to add a new entry or update variable in this file
 * VERSION = "1.0"
 *---------------------------------------------------------------------------*/
&mdss_mdp {
	dsi_hx8394d_lg_720_vid: qcom,mdss_dsi_hx8394d_lg_720p_video {
		qcom,mdss-dsi-panel-name = "hx8394d lg 720p video mode dsi panel";
		qcom,mdss-dsi-panel-controller = <&mdss_dsi0>;
		qcom,mdss-dsi-panel-type = "dsi_video_mode";
		qcom,mdss-dsi-panel-destination = "display_1";
		qcom,mdss-dsi-panel-framerate = <60>;
		qcom,mdss-dsi-virtual-channel-id = <0>;
		qcom,mdss-dsi-stream = <0>;
		qcom,mdss-dsi-panel-width = <720>;
		qcom,mdss-dsi-panel-height = <1280>;
		qcom,mdss-dsi-h-front-porch = <60>;//jhyu add hi8394d-lg
		qcom,mdss-dsi-h-back-porch = <40>;//jhyu add hi8394d-lg
		qcom,mdss-dsi-h-pulse-width = <24>;//jhyu add hi8394d-lg
		qcom,mdss-dsi-h-sync-skew = <0>;
		qcom,mdss-dsi-v-back-porch = <9>;//jhyu add hi8394d-lg
		qcom,mdss-dsi-v-front-porch = <2>;//jhyu add hi8394d-lg
		qcom,mdss-dsi-v-pulse-width = <2>;//jhyu add hi8394d-lg
		qcom,mdss-dsi-h-left-border = <0>;
		qcom,mdss-dsi-h-right-border = <0>;
		qcom,mdss-dsi-v-top-border = <0>;
		qcom,mdss-dsi-v-bottom-border = <0>;
		qcom,mdss-dsi-bpp = <24>;
		qcom,mdss-dsi-underflow-color = <0xff>;
		qcom,mdss-dsi-border-color = <0>;
		qcom,mdss-dsi-on-command = [39 01 00 00 00 00 04 b9 ff 83 94
				39 01 00 00 00 00 03 ba 73 83
				39 01 00 00 00 00 10 b1 6c 08 0c 23 02 31 f1 80 e0 50 23 80 c0 00 00
				39 01 00 00 00 00 06 b2 00 64 0e 0d 32
				39 01 00 00 00 00 0d b4 00 ff 03 6c 03 48 03 6c 01 70 05 6b
				39 01 00 00 00 00 04 bf 41 0e 01
				39 01 00 00 00 00 21 d3 30 00 00 2c 18 08 00 32 10 07 00 07 32 15 07 05 07 32 10 00 00 00 37 33 0b 0b 37 10 07 07 10 08
				39 01 00 00 00 00 2d d5 18 18 18 18 18 18 18 18 19 19 18 18 18 18 18 18 1a 1a 18 18 1b 1b 02 03 18 18 00 01 06 07 04 05 20 21 22 23 18 18 18 18 18 18 18 18
				39 01 00 00 00 00 02 cc 09
				39 01 00 00 00 00 2b E0 00 07 0c 35 33 38 19 3b 07 0a 0c 17 0e 11 14 12 13 05 0F 10 14 00 07 0c 35 33 38 1a 38 07 0a 0c 17 0e 11 12 12 13 05 0F 10 14
				39 01 00 00 00 00 03 b6 f3 f3
				39 01 00 00 00 00 05 c7 00 c0 40 c0
				05 01 00 00 c8 00 02 11 00
				05 01 00 00 c8 00 02 29 00];
		qcom,mdss-dsi-off-command = [05 01 00 00 00 00 02 28 00
				05 01 00 00 00 00 02 10 00];
		qcom,mdss-dsi-on-command-state = "dsi_lp_mode";
		qcom,mdss-dsi-off-command-state = "dsi_hs_mode";
                //qcom,mdss-dsi-panel-status-check-mode = "bta_check";  //BTA Check
		qcom,mdss-dsi-h-sync-pulse = <1>;
		qcom,mdss-dsi-traffic-mode = "burst_mode";
		qcom,mdss-dsi-bllp-eof-power-mode;
		qcom,mdss-dsi-bllp-power-mode;
		qcom,mdss-dsi-lane-0-state;
		qcom,mdss-dsi-lane-1-state;
		qcom,mdss-dsi-lane-2-state;
		qcom,mdss-dsi-lane-3-state;
		qcom,mdss-dsi-panel-timings = [76 18 10 00 3c 3e 14 1c 12 03 04 00];
		qcom,mdss-dsi-t-clk-post = <0x04>;
		qcom,mdss-dsi-t-clk-pre = <0x19>;
		qcom,mdss-dsi-bl-min-level = <1>;
		qcom,mdss-dsi-bl-max-level = <255>; //<4095>;
		qcom,mdss-dsi-dma-trigger = "trigger_sw";
		qcom,mdss-dsi-mdp-trigger = "none";
		qcom,mdss-dsi-bl-pmic-control-type = "bl_ctrl_pwm"; //"bl_ctrl_wled";
		qcom,mdss-dsi-reset-sequence = <1 20>, <0 1>, <1 20>;
		qcom,mdss-pan-physical-width-dimension = <59>;
		qcom,mdss-pan-physical-height-dimension = <104>;

	};
};
