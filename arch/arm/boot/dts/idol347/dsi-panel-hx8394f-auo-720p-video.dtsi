/* Copyright (c) 2014, The Linux Foundation. All rights reserved.
 *
 * This program is free software; you can redistribute it and/or modify
 * it under the terms of the GNU General Public License version 2 and
 * only version 2 as published by the Free Software Foundation.
 *
 * This program is distributed in the hope that it will be useful,
 * but WITHOUT ANY WARRANTY; without even the implied warranty of
 * MERCHANTABILITY or FITNESS FOR A PARTICULAR PURPOSE.  See the
 * GNU General Public License for more details.
 */

/*---------------------------------------------------------------------------
 * This file is autogenerated file using gcdb parser. Please do not edit it.
 * Update input XML file to add a new entry or update variable in this file
 * VERSION = "1.0"
 *---------------------------------------------------------------------------*/
&mdss_mdp {
	dsi_hx8394f_auo_720_vid: qcom,mdss_dsi_hx8394f_auo_720p_video {
		qcom,mdss-dsi-panel-name = "hx8394f auo 720p video mode dsi panel";
		qcom,mdss-dsi-panel-controller = <&mdss_dsi0>;
		qcom,mdss-dsi-panel-type = "dsi_video_mode";
		qcom,mdss-dsi-panel-destination = "display_1";
		qcom,mdss-dsi-panel-framerate = <60>;
		qcom,mdss-dsi-virtual-channel-id = <0>;
		qcom,mdss-dsi-stream = <0>;
		qcom,mdss-dsi-panel-width = <720>;
		qcom,mdss-dsi-panel-height = <1280>;
		qcom,mdss-dsi-h-front-porch = <240>;               //<52>;
		qcom,mdss-dsi-h-back-porch =  <80>;                //<100>;
		qcom,mdss-dsi-h-pulse-width = <48>;                //<24>;
		qcom,mdss-dsi-h-sync-skew = <0>;
                qcom,mdss-dsi-v-front-porch = <9>;
		qcom,mdss-dsi-v-back-porch = <5>;
		qcom,mdss-dsi-v-pulse-width = <2>;
		qcom,mdss-dsi-h-left-border = <0>;
		qcom,mdss-dsi-h-right-border = <0>;
		qcom,mdss-dsi-v-top-border = <0>;
		qcom,mdss-dsi-v-bottom-border = <0>;
		qcom,mdss-dsi-bpp = <24>;
		qcom,mdss-dsi-underflow-color = <0xff>;
		qcom,mdss-dsi-border-color = <0>;
		qcom,mdss-dsi-on-command = [39 01 00 00 00 00 04 b9 ff 83 94
                                39 01 00 00 00 00 07 ba 63 03 68 6b B2 c0
				39 01 00 00 00 00 0b b1 50 0e 6e 09 33 54 71 71 4e 43
				39 01 00 00 00 00 07 b2 00 80 64 05 07 2f  
				39 01 00 00 00 00 16 b4 01 65 01 65 01 65 01 05 7e 35 00 3f 01 65 01 65 01 65 01 05 7e 
                                39 01 00 00 00 00 3b e0 0e 10 1b 22 29 2b 30 2e 5e 70 82 82 8b 9e a3 a4 b2 b3 ae bc ca 63 61 64 68 6b 78 7f 7f 00 03 12 1a 25 2b 30 2e 5e 70 82 82 8b 9d a2 a5 b1 b3 ae bc ca 63 61 64 68 6b 78 7f 7f  
                                //liulei change 0825 improve IS and GAMMA 
				39 01 00 00 00 00 22 d3 00 00 0f 0f 01 01 10 00 32 10 00 00 00 32 15 04 35 04 32 15 14 05 14 37 33 00 00 37 00 07 37 05 40
				39 01 00 00 00 00 2d d5 18 18 18 18 18 18 18 18 18 18 18 18 18 18 25 24 27 26 18 18 47 46 43 42 41 40 45 44 05 04 01 00 07 06 03 02 21 20 23 22 18 18 18 18
				39 01 00 00 00 00 2d d6 18 18 18 18 18 18 18 18 18 18 18 18 18 18 22 23 20 21 18 18 00 01 04 05 06 07 02 03 02 03 06 07 00 01 04 05 06 07 04 15 18 18 18 18
				39 01 00 00 00 00 02 cc 03
                         	39 01 00 00 00 00 03 c0 1f 73
				39 01 00 00 00 00 02 d4 02
                                39 01 00 00 00 00 02 36 02
                                39 01 00 00 00 00 02 35 00
				05 01 00 00 96 00 02 11 00
				05 01 00 00 32 00 02 29 00];
		qcom,mdss-dsi-off-command = [ 05 01 00 00 78 00 02 10 00];
		qcom,mdss-dsi-on-command-state = "dsi_lp_mode";
		qcom,mdss-dsi-off-command-state = "dsi_hs_mode";
                /*LCD read register Check start*/
                qcom,esd-check-enabled;
		qcom,mdss-dsi-panel-status-command = [06 01 00 01 05 00 01 09];           //send command
                qcom,mdss-dsi-panel-status-command_for_one = [14 01 00 01 05 00 01 45];   //send command one
		qcom,mdss-dsi-panel-status-command-state = "dsi_lp_mode";                 //user to lp mode read
		qcom,mdss-dsi-panel-status-check-mode = "reg_read_hx8394f";               //"reg_read_hx8394d";
		qcom,mdss-dsi-panel-status-value = <0x81 0x73 0x06>;                      //register return value1
                qcom,mdss-dsi-panel-status-value_for_one = <0x05 0x73>;                        //register return value2
                /*LCD read register Check End*/
                /*LCD every line entering LP11 Start*/
                qcom,mdss-dsi-hfp-power-mode;
		//qcom,mdss-dsi-hbp-power-mode;
		//qcom,mdss-dsi-hsa-power-mode;
                /*LCD every line entering LP11 End*/
		qcom,mdss-dsi-h-sync-pulse = <1>;
		qcom,mdss-dsi-traffic-mode = "burst_mode";
		qcom,mdss-dsi-bllp-eof-power-mode;
		qcom,mdss-dsi-bllp-power-mode;
		qcom,mdss-dsi-lane-0-state;
		qcom,mdss-dsi-lane-1-state;
		qcom,mdss-dsi-lane-2-state;
		qcom,mdss-dsi-lane-3-state;
		qcom,mdss-dsi-panel-timings = [94 20 14 00 46 48 1A 24 18 03 04 00];//[7a 1a 12 00 3e 42 16 1e 14 03 04 00];
		qcom,mdss-dsi-t-clk-post = <0x04>;//<0x04>;
		qcom,mdss-dsi-t-clk-pre =  <0x1D>;//<0x1A>;
		qcom,mdss-dsi-bl-min-level = <1>;
		qcom,mdss-dsi-bl-max-level = <255>;
                /*Before reset, beginning LP11*/
                qcom,mdss-dsi-lp11-init;
		qcom,mdss-dsi-init-delay-us = <50000>;
                /*Before reset, beginning LP11*/
                qcom,mdss-dsi-bl-pmic-pwm-frequency = <33>;
                qcom,mdss-dsi-bl-pmic-bank-select = <0>;
		qcom,mdss-dsi-dma-trigger = "trigger_sw";
		qcom,mdss-dsi-mdp-trigger = "none";
		qcom,mdss-dsi-bl-pmic-control-type = "bl_ctrl_pwm";
		qcom,mdss-dsi-reset-sequence = <1 50>, <0 20>, <1 120>;
		qcom,mdss-pan-physical-width-dimension = <59>;
		qcom,mdss-pan-physical-height-dimension = <104>;

	};
};
