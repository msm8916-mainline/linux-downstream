/* Copyright (c) 2013-2014, The Linux Foundation. All rights reserved.
 *
 * This program is free software; you can redistribute it and/or modify
 * it under the terms of the GNU General Public License version 2 and
 * only version 2 as published by the Free Software Foundation.
 *
 * This program is distributed in the hope that it will be useful,
 * but WITHOUT ANY WARRANTY; without even the implied warranty of
 * MERCHANTABILITY or FITNESS FOR A PARTICULAR PURPOSE.  See the
 * GNU General Public License for more details.
 */

&mdss_mdp {
	dsi_nt35521_auo_720_vid: qcom,mdss_dsi_nt35521_auo_720p_video {
		qcom,mdss-dsi-panel-name = "nt35521 auo 720p video mode dsi panel";
		qcom,mdss-dsi-panel-controller = <&mdss_dsi0>;
		qcom,mdss-dsi-panel-type = "dsi_video_mode";
		qcom,mdss-dsi-panel-destination = "display_1";
		qcom,mdss-dsi-panel-framerate = <60>;
		qcom,mdss-dsi-virtual-channel-id = <0>;
		qcom,mdss-dsi-stream = <0>;
		qcom,mdss-dsi-panel-width = <720>;
		qcom,mdss-dsi-panel-height = <1280>;
		qcom,mdss-dsi-h-front-porch = <44>;
		qcom,mdss-dsi-h-back-porch = <55>;
		qcom,mdss-dsi-h-pulse-width = <11>;
		qcom,mdss-dsi-h-sync-skew = <0>;
                qcom,mdss-dsi-v-front-porch = <14>;
		qcom,mdss-dsi-v-back-porch = <15>;
		qcom,mdss-dsi-v-pulse-width = <1>;
		qcom,mdss-dsi-h-left-border = <0>;
		qcom,mdss-dsi-h-right-border = <0>;
		qcom,mdss-dsi-v-top-border = <0>;
		qcom,mdss-dsi-v-bottom-border = <0>;
		qcom,mdss-dsi-bpp = <24>;
		qcom,mdss-dsi-underflow-color = <0xff>;
		qcom,mdss-dsi-border-color = <0>;
		//qcom,mdss-dsi-pixel-packing = "tight";
		qcom,mdss-dsi-on-command = [29 01 00 00 00 00 06 F0 55 AA 52 08 00
				29 01 00 00 00 00 03 B1 68 21
				29 01 00 00 00 00 02 B6 01
				29 01 00 00 00 00 05 B8 01 02 08 02
				29 01 00 00 00 00 03 BB 11 11
				29 01 00 00 00 00 03 BC 00 00
				29 01 00 00 00 00 06 BD 01 A3 20 10 01
                                29 01 00 00 00 00 02 C8 80
                                29 01 00 00 00 00 06 F0 55 AA 52 08 01
                                29 01 00 00 00 00 03 B0 0F 0F
                                29 01 00 00 00 00 03 B1 0F 0F
                                29 01 00 00 00 00 03 B3 1E 1E
                                29 01 00 00 00 00 03 B4 18 18
                                29 01 00 00 00 00 03 B5 05 05
                                29 01 00 00 00 00 03 B9 34 34
                                29 01 00 00 00 00 03 BA 24 24
                                29 01 00 00 00 00 03 BC 78 00
                                29 01 00 00 00 00 03 BD 78 00
				29 01 00 00 00 00 02 BE 42    //Vcom 50
				29 01 00 00 00 00 02 C0 0C
				29 01 00 00 00 00 02 CA 00
                                29 01 00 00 00 00 06 F0 55 AA 52 08 02
                                29 01 00 00 00 00 02 EE 01
				29 01 00 00 00 00 11 B0 00 AF 00 B9 00 CC 00 DD 00 EC 01 06 01 1B 01 40
				29 01 00 00 00 00 11 B1 01 5F 01 94 01 C0 02 05 02 3D 02 3F 02 71 02 AA
				29 01 00 00 00 00 11 B2 02 D2 02 FC 03 1B 03 45 03 60 03 7E 03 92 03 A8
				29 01 00 00 00 00 05 B3 03 BC 03 FF
                                29 01 00 00 00 00 06 F0 55 AA 52 08 03
                                29 01 00 00 00 00 03 B0 20 00
                                29 01 00 00 00 00 03 B1 20 00
                                29 01 00 00 00 00 06 B2 04 00 52 01 51
                                29 01 00 00 00 00 06 B3 04 00 52 01 51
                                29 01 00 00 00 00 06 B6 04 00 52 01 51
                                29 01 00 00 00 00 06 B7 04 00 52 01 51
                                29 01 00 00 00 00 06 BA 44 00 60 01 72
                                29 01 00 00 00 00 06 BB 44 00 60 01 72
                                29 01 00 00 00 00 06 BC 53 00 03 00 48
                                29 01 00 00 00 00 06 BD 53 00 03 00 48
                                29 01 00 00 00 00 02 C4 40
				29 01 00 00 00 00 02 C5 40
				29 01 00 00 00 00 06 F0 55 AA 52 08 05
				29 01 00 00 00 00 03 B0 17 06
                                29 01 00 00 00 00 02 B8 00
                                29 01 00 00 00 00 06 BD 0F 03 03 00 03
				29 01 00 00 00 00 03 B1 17 06
                                29 01 00 00 00 00 02 B9 00

				29 01 00 00 00 00 03 B2 17 06
                                29 01 00 00 00 00 02 BA 00

				29 01 00 00 00 00 03 B3 17 06
                                29 01 00 00 00 00 02 BB 00

				29 01 00 00 00 00 03 B4 17 06
				29 01 00 00 00 00 03 B5 17 06
				29 01 00 00 00 00 03 B6 17 06
				29 01 00 00 00 00 03 B7 17 06		
				29 01 00 00 00 00 02 BC 00
                                29 01 00 00 00 00 02 E5 06
				29 01 00 00 00 00 02 E6 06
				29 01 00 00 00 00 02 E7 06
				29 01 00 00 00 00 02 E8 06
				29 01 00 00 00 00 02 E9 0A
				29 01 00 00 00 00 02 EA 06
				29 01 00 00 00 00 02 EB 06
				29 01 00 00 00 00 02 EC 06
				29 01 00 00 00 00 02 ED 30
				29 01 00 00 00 00 02 C0 07
                                29 01 00 00 00 00 02 C1 05
				29 01 00 00 00 00 02 C4 82
				29 01 00 00 00 00 02 C5 80
				29 01 00 00 00 00 03 C8 03 20
				29 01 00 00 00 00 03 C9 01 21
				29 01 00 00 00 00 03 CA 03 20
				29 01 00 00 00 00 03 CB 07 20
				29 01 00 00 00 00 0C D1 03 05 00 05 00 00 00 00 00 00 00
                                29 01 00 00 00 00 0C D2 03 05 00 03 00 00 00 00 00 00 00
                                29 01 00 00 00 00 0C D3 00 05 04 05 00 00 00 00 00 00 00
                                29 01 00 00 00 00 0C D4 00 05 04 03 00 00 00 00 00 00 00

				29 01 00 00 00 00 06 F0 55 AA 52 08 06

				29 01 00 00 00 00 03 B0 2E 2E
				29 01 00 00 00 00 03 B1 2E 2E
				29 01 00 00 00 00 03 B2 2E 2E
				29 01 00 00 00 00 03 B3 2E 09
				29 01 00 00 00 00 03 B4 0B 23
				29 01 00 00 00 00 03 B5 1D 1F
				29 01 00 00 00 00 03 B6 11 17
				29 01 00 00 00 00 03 B7 13 19
				29 01 00 00 00 00 03 B8 01 03
				29 01 00 00 00 00 03 B9 2E 2E

				29 01 00 00 00 00 03 BA 2E 2E
				29 01 00 00 00 00 03 BB 02 00
				29 01 00 00 00 00 03 BC 18 12
				29 01 00 00 00 00 03 BD 16 10

				29 01 00 00 00 00 03 BE 1E 1C
				29 01 00 00 00 00 03 BF 22 0A
				29 01 00 00 00 00 03 C0 08 2E
				29 01 00 00 00 00 03 C1 2E 2E
				29 01 00 00 00 00 03 C2 2E 2E
				29 01 00 00 00 00 03 C3 2E 2E
                                29 01 00 00 00 00 03 E5 25 24
				29 01 00 00 00 00 03 C4 2E 2E
				29 01 00 00 00 00 03 C5 2E 2E

				29 01 00 00 00 00 03 C6 2E 2E
				29 01 00 00 00 00 03 C7 2E 02
				29 01 00 00 00 00 03 C8 00 24
				29 01 00 00 00 00 03 C9 1E 1C
				29 01 00 00 00 00 03 CA 18 12
				29 01 00 00 00 00 03 CB 16 10
				29 01 00 00 00 00 03 CC 0A 08
				29 01 00 00 00 00 03 CD 2E 2E
				29 01 00 00 00 00 03 CE 2E 2E
				29 01 00 00 00 00 03 CF 09 0B

				29 01 00 00 00 00 03 D0 11 17
				29 01 00 00 00 00 03 D1 13 19
				29 01 00 00 00 00 03 D2 1D 1F
				29 01 00 00 00 00 03 D3 25 01
				29 01 00 00 00 00 03 D4 03 2E
				29 01 00 00 00 00 03 D5 2E 2E
				29 01 00 00 00 00 03 D6 2E 2E
				29 01 00 00 00 00 03 D7 2E 2E
                                29 01 00 00 00 00 03 E6 22 23
				29 01 00 00 00 00 06 D8 00 00 00 00 00
				29 01 00 00 00 00 06 D9 00 00 00 00 00
				23 01 00 00 00 00 02 E7 00
				05 01 00 00 78 00 02 11 00
				05 01 00 00 32 00 02 29 00];
		qcom,mdss-dsi-off-command = [05 01 00 00 05 00 02 28 00
					05 01 00 00 14 00 02 10 00];
		qcom,mdss-dsi-on-command-state = "dsi_lp_mode";
		qcom,mdss-dsi-off-command-state = "dsi_hs_mode";
		qcom,mdss-dsi-h-sync-pulse = <1>;
		qcom,mdss-dsi-traffic-mode = "burst_mode";
		qcom,mdss-dsi-bllp-eof-power-mode;
		qcom,mdss-dsi-bllp-power-mode;
		qcom,mdss-dsi-lane-0-state;
		qcom,mdss-dsi-lane-1-state;
		qcom,mdss-dsi-lane-2-state;
		qcom,mdss-dsi-lane-3-state;
		qcom,mdss-dsi-panel-timings = [76 18 10 00 3C 3E 14 1C 12 03 04 00];
		qcom,mdss-dsi-t-clk-post = <0x04>;
		qcom,mdss-dsi-t-clk-pre = <0x19>;
		qcom,mdss-dsi-bl-min-level = <1>;
		qcom,mdss-dsi-bl-max-level = <255>;
                qcom,mdss-dsi-bl-pmic-pwm-frequency = <33>;
                qcom,mdss-dsi-bl-pmic-bank-select = <0>;
		qcom,mdss-dsi-dma-trigger = "trigger_sw";
		qcom,mdss-dsi-mdp-trigger = "none";
		qcom,mdss-dsi-bl-pmic-control-type = "bl_ctrl_pwm";
		qcom,mdss-dsi-reset-sequence = <1 20>, <0 5>, <1 20>;

	};
};
