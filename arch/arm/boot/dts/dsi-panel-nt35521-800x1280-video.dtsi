/* Copyright (c) 2013, The Linux Foundation. All rights reserved.
 *
 * This program is free software; you can redistribute it and/or modify
 * it under the terms of the GNU General Public License version 2 and
 * only version 2 as published by the Free Software Foundation.
 *
 * This program is distributed in the hope that it will be useful,
 * but WITHOUT ANY WARRANTY; without even the implied warranty of
 * MERCHANTABILITY or FITNESS FOR A PARTICULAR PURPOSE.  See the
 * GNU General Public License for more details.
 */

/*---------------------------------------------------------------------------
 * This file is autogenerated file using gcdb parser. Please do not edit it.
 * Update input XML file to add a new entry or update variable in this file
 * VERSION = "1.0"
 *---------------------------------------------------------------------------*/
&mdss_mdp {
	dsi_nt35521_800x1280_video: qcom,mdss_dsi_nt35521_800x1280_video {
		qcom,mdss-dsi-panel-name = "nt35521 800x1280 video mode dsi panel";
		qcom,mdss-dsi-panel-controller = <&mdss_dsi0>;
		qcom,mdss-dsi-panel-type = "dsi_video_mode";
		qcom,mdss-dsi-panel-destination = "display_1";
		qcom,mdss-dsi-panel-framerate = <60>;
		qcom,mdss-dsi-virtual-channel-id = <0>;
		qcom,mdss-dsi-stream = <0>;
		qcom,mdss-dsi-panel-width = <800>;
		qcom,mdss-dsi-panel-height = <1280>;
		qcom,mdss-dsi-h-front-porch = <40>;
		qcom,mdss-dsi-h-back-porch = <40>;
		qcom,mdss-dsi-h-pulse-width = <4>;
		qcom,mdss-dsi-h-sync-skew = <0>;
		qcom,mdss-dsi-v-back-porch = <15>;
		qcom,mdss-dsi-v-front-porch = <15>;
		qcom,mdss-dsi-v-pulse-width = <3>;
		qcom,mdss-dsi-h-left-border = <0>;
		qcom,mdss-dsi-h-right-border = <0>;
		qcom,mdss-dsi-v-top-border = <0>;
		qcom,mdss-dsi-v-bottom-border = <0>;
		qcom,mdss-dsi-bpp = <24>;
		qcom,mdss-dsi-color-order = "rgb_swap_rgb";
		qcom,mdss-dsi-underflow-color = <0xff>;
		qcom,mdss-dsi-border-color = <0>;
		qcom,mdss-dsi-on-command = [39 01 00 00 00 00 05 FF  AA  55  A5  80
				39 01 00 00 00 00 03 6F  11  00
				39 01 00 00 00 00 03 F7  20  00
				15 01 00 00 00 00 02 6F  06
				15 01 00 00 00 00 02 F7  A0
				15 01 00 00 00 00 02 6F  19
				15 01 00 00 00 00 02 F7  12
				15 01 00 00 00 00 02 F4  03
				39 01 00 00 00 00 05 FF  AA  55  A5  00
				39 01 00 00 00 00 06 F0  55  AA  52  08  00
				15 01 00 00 00 00 02 C8  00
				39 01 00 00 00 00 03 B1  6C  01
				15 01 00 00 00 00 02 B6  08
				15 01 00 00 00 00 02 6F  02
				15 01 00 00 00 00 02 B8  08
				39 01 00 00 00 00 03 BB  74  44
				39 01 00 00 00 00 03 BC  00  00
				39 01 00 00 00 00 06 BD  02  B0  0C  0A  00
				39 01 00 00 00 00 06 F0  55  AA  52  08  01
				39 01 00 00 00 00 03 B0  05  05
				39 01 00 00 00 00 03 B1  05  05
				39 01 00 00 00 00 03 BC  90  01
				39 01 00 00 00 00 03 BD  90  01
				15 01 00 00 00 00 02 CA  00
				15 01 00 00 00 00 02 C0  04
				39 01 00 00 00 00 03 B3  37  37
				39 01 00 00 00 00 03 B4  19  19
				39 01 00 00 00 00 03 B9  44  44
				39 01 00 00 00 00 03 BA  24  24
				39 01 00 00 00 00 06 F0  55  AA  52  08  02
				15 01 00 00 00 00 02 EE  02
				39 01 00 00 00 00 05 EF  09  06  15  18
				39 01 00 00 00 00 07 B0  00  00  00  19  00  31
				15 01 00 00 00 00 02 6F  06
				39 01 00 00 00 00 07 B0  00  4B  00  63  00  95
				15 01 00 00 00 00 02 6F  0C
				39 01 00 00 00 00 05 B0  00  B4  00  F3
				39 01 00 00 00 00 07 B1  01  24  01  70  01  A6
				15 01 00 00 00 00 02 6F  06
				39 01 00 00 00 00 07 B1  01  FC  02  49  02  4C
				15 01 00 00 00 00 02 6F  0C
				39 01 00 00 00 00 05 B1  02  96  02  EC
				39 01 00 00 00 00 07 B2  03  1D  03  5A  03  81
				15 01 00 00 00 00 02 6F  06
				39 01 00 00 00 00 07 B2  03  A2  03  B6  03  CB
				15 01 00 00 00 00 02 6F  0C
				39 01 00 00 00 00 05 B2  03  D9  03  E8
				39 01 00 00 00 00 05 B3  03  F7  03  FF
				39 01 00 00 00 00 07 BC  00  00  00  19  00  31
				15 01 00 00 00 00 02 6F  06
				39 01 00 00 00 00 07 BC  00  4B  00  63  00  95
				15 01 00 00 00 00 02 6F  0C
				39 01 00 00 00 00 05 BC  00  B4  00  F3
				39 01 00 00 00 00 07 BD  01  24  01  70  01  A6
				15 01 00 00 00 00 02 6F  06
				39 01 00 00 00 00 07 BD  01  FC  02  49  02  4C
				15 01 00 00 00 00 02 6F  0C
				39 01 00 00 00 00 05 BD  02  96  02  EC
				39 01 00 00 00 00 07 BE  03  1D  03  5A  03  81
				15 01 00 00 00 00 02 6F  06
				39 01 00 00 00 00 07 BE  03  A2  03  B6  03  CB
				15 01 00 00 00 00 02 6F  0C
				39 01 00 00 00 00 05 BE  03  D9  03  E8
				39 01 00 00 00 00 05 BF  03  F7  03  FF
				39 01 00 00 00 00 06 F0  55  AA  52  08  06
				39 01 00 00 00 00 03 B0  00  10
				39 01 00 00 00 00 03 B1  12  14
				39 01 00 00 00 00 03 B2  16  18
				39 01 00 00 00 00 03 B3  1A  29
				39 01 00 00 00 00 03 B4  2A  08
				39 01 00 00 00 00 03 B5  31  31
				39 01 00 00 00 00 03 B6  31  31
				39 01 00 00 00 00 03 B7  31  31
				39 01 00 00 00 00 03 B8  31  0A
				39 01 00 00 00 00 03 B9  31  31
				39 01 00 00 00 00 03 BA  31  31
				39 01 00 00 00 00 03 BB  0B  31
				39 01 00 00 00 00 03 BC  31  31
				39 01 00 00 00 00 03 BD  31  31
				39 01 00 00 00 00 03 BE  31  31
				39 01 00 00 00 00 03 BF  09  2A
				39 01 00 00 00 00 03 C0  29  1B
				39 01 00 00 00 00 03 C1  19  17
				39 01 00 00 00 00 03 C2  15  13
				39 01 00 00 00 00 03 C3  11  01
				39 01 00 00 00 00 03 E5  31  31
				39 01 00 00 00 00 03 C4  09  1B
				39 01 00 00 00 00 03 C5  19  17
				39 01 00 00 00 00 03 C6  15  13
				39 01 00 00 00 00 03 C7  11  29
				39 01 00 00 00 00 03 C8  2A  01
				39 01 00 00 00 00 03 C9  31  31
				39 01 00 00 00 00 03 CA  31  31
				39 01 00 00 00 00 03 CB  31  31
				39 01 00 00 00 00 03 CC  31  0B
				39 01 00 00 00 00 03 CD  31  31
				39 01 00 00 00 00 03 CE  31  31
				39 01 00 00 00 00 03 CF  0A  31
				39 01 00 00 00 00 03 D0  31  31
				39 01 00 00 00 00 03 D1  31  31
				39 01 00 00 00 00 03 D2  31  31
				39 01 00 00 00 00 03 D3  00  2A
				39 01 00 00 00 00 03 D4  29  10
				39 01 00 00 00 00 03 D5  12  14
				39 01 00 00 00 00 03 D6  16  18
				39 01 00 00 00 00 03 D7  1A  08
				39 01 00 00 00 00 03 E6  31  31
				39 01 00 00 00 00 06 D8  00  00  00  54  00
				39 01 00 00 00 00 06 D9  00  15  00  00  00
				15 01 00 00 00 00 02 E7  00
				39 01 00 00 00 00 06 F0  55  AA  52  08  03
				39 01 00 00 00 00 03 B0  20  00
				39 01 00 00 00 00 03 B1  20  00
				39 01 00 00 00 00 06 B2  05  00  00  00  00
				39 01 00 00 00 00 06 B6  05  00  00  00  00
				39 01 00 00 00 00 06 B7  05  00  00  00  00
				39 01 00 00 00 00 06 BA  57  00  00  00  00
				39 01 00 00 00 00 06 BB  57  00  00  00  00
				39 01 00 00 00 00 05 C0  00  00  00  00
				39 01 00 00 00 00 05 C1  00  00  00  00
				15 01 00 00 00 00 02 C4  60
				15 01 00 00 00 00 02 C5  40
				39 01 00 00 00 00 06 F0  55  AA  52  08  05
				39 01 00 00 00 00 06 BD  03  01  03  03  03
				39 01 00 00 00 00 03 B0  17  06
				39 01 00 00 00 00 03 B1  17  06
				39 01 00 00 00 00 03 B2  17  06
				39 01 00 00 00 00 03 B3  17  06
				39 01 00 00 00 00 03 B4  17  06
				39 01 00 00 00 00 03 B5  17  06
				15 01 00 00 00 00 02 B8  00
				15 01 00 00 00 00 02 B9  00
				15 01 00 00 00 00 02 BA  00
				15 01 00 00 00 00 02 BB  02
				15 01 00 00 00 00 02 BC  00
				15 01 00 00 00 00 02 C0  07
				15 01 00 00 00 00 02 C4  80
				15 01 00 00 00 00 02 C5  A4
				39 01 00 00 00 00 03 C8  05  30
				39 01 00 00 00 00 03 C9  01  31
				39 01 00 00 00 00 04 CC  00  00  3C
				39 01 00 00 00 00 04 CD  00  00  3C
				39 01 00 00 00 00 06 D1  00  04  FD  07  10
				39 01 00 00 00 00 06 D2  00  05  02  07  10
				15 01 00 00 00 00 02 E5  06
				15 01 00 00 00 00 02 E6  06
				15 01 00 00 00 00 02 E7  06
				15 01 00 00 00 00 02 E8  06
				15 01 00 00 00 00 02 E9  06
				15 01 00 00 00 00 02 EA  06
				15 01 00 00 00 00 02 ED  30
				15 01 00 00 00 00 02 6F  11
				15 01 00 00 00 00 02 F3  01
				05 01 00 00 00 00 01 35
				15 01 00 00 00 00 02 53  2c
				15 01 00 00 00 00 02 55  03
				05 01 00 00 00 00 01 11
				05 01 00 00 87 00 01 29];
		qcom,mdss-dsi-off-command = [05 01 00 00 00 00 01 28
				05 01 00 00 64 00 01 10];
		qcom,mdss-dsi-on-command-state = "dsi_lp_mode";
		qcom,mdss-dsi-off-command-state = "dsi_hs_mode";
		qcom,mdss-dsi-h-sync-pulse = <1>;
		qcom,mdss-dsi-traffic-mode = "burst_mode";
		qcom,mdss-dsi-lane-map = "lane_map_0123";
		qcom,mdss-dsi-bllp-eof-power-mode;
		qcom,mdss-dsi-bllp-power-mode;
		qcom,mdss-dsi-lane-0-state;
		qcom,mdss-dsi-lane-1-state;
		qcom,mdss-dsi-lane-2-state;
		qcom,mdss-dsi-lane-3-state;
		qcom,mdss-dsi-panel-timings = [7b 1a 10 00 3e 40 16 1e 15 03 04 00];
		qcom,mdss-dsi-t-clk-post = <0x4>;
		qcom,mdss-dsi-t-clk-pre = <0x1a>;
		qcom,mdss-dsi-bl-min-level = <1>;
		qcom,mdss-dsi-bl-max-level = <255>;
		qcom,mdss-dsi-dma-trigger = "trigger_sw";
		qcom,mdss-dsi-mdp-trigger = "none";
		qcom,mdss-dsi-bl-pmic-control-type = "bl_ctrl_dcs";
		qcom,mdss-dsi-reset-sequence = <1 5>, <0 2>, <1 20>;
	};
};
