/* Copyright (c) 2014, The Linux Foundation. All rights reserved.
 *
 * This program is free software; you can redistribute it and/or modify
 * it under the terms of the GNU General Public License version 2 and
 * only version 2 as published by the Free Software Foundation.
 *
 * This program is distributed in the hope that it will be useful,
 * but WITHOUT ANY WARRANTY; without even the implied warranty of
 * MERCHANTABILITY or FITNESS FOR A PARTICULAR PURPOSE.  See the
 * GNU General Public License for more details.
 */

/*---------------------------------------------------------------------------
 * This file is autogenerated file using gcdb parser. Please do not edit it.
 * Update input XML file to add a new entry or update variable in this file
 * VERSION = "1.0"
 *---------------------------------------------------------------------------*/
&mdss_mdp {
	dsi_hx8379a_fwvga_vid: qcom,mdss_dsi_hx8379a_fwvga_video {
		qcom,mdss-dsi-panel-name = "hx8379a video mode dsi panel";
		qcom,mdss-dsi-panel-controller = <&mdss_dsi0>;
		qcom,mdss-dsi-panel-type = "dsi_video_mode";
		qcom,mdss-dsi-panel-destination = "display_1";
        qcom,mdss-dsi-panel-framerate = <50>;
		qcom,mdss-dsi-virtual-channel-id = <0>;
		qcom,mdss-dsi-stream = <0>;
		qcom,mdss-dsi-panel-width = <480>;
		qcom,mdss-dsi-panel-height = <854>;
		qcom,mdss-dsi-h-front-porch = <100>;
		qcom,mdss-dsi-h-back-porch = <100>;
		qcom,mdss-dsi-h-pulse-width = <4>;
		qcom,mdss-dsi-h-sync-skew = <0>;
		qcom,mdss-dsi-v-back-porch = <6>;
		qcom,mdss-dsi-v-front-porch = <20>;
		qcom,mdss-dsi-v-pulse-width = <4>;
		qcom,mdss-dsi-h-left-border = <0>;
		qcom,mdss-dsi-h-right-border = <0>;
		qcom,mdss-dsi-v-top-border = <0>;
		qcom,mdss-dsi-v-bottom-border = <0>;
		qcom,mdss-dsi-bpp = <24>;
		qcom,mdss-dsi-color-order = "rgb_swap_rgb";
		qcom,mdss-dsi-underflow-color = <0xff>;
		qcom,mdss-dsi-border-color = <0>;
		qcom,mdss-dsi-on-command = [
	        39 01 00 00 00 00 04
				B9 FF 83 79
	        39 01 00 00 00 00 03
				BA 51 93
	        39 01 00 00 00 00 20
				B1 00 50 44 EE 99 08 11 11 71 
				24 2C BF 3F 22 0a 6A F1 00 E6 
				E6 E6 E6 E6 00 04 05 0A 0B 04
				05 6F

	        39 01 00 00 00 00 0E
		        	B2 00 00 FE 08 0C 19 22 00 FF
		        	08 0C 19 20
                
	        39 01 00 00 00 00 20
		        	B4 80 06 00 32 10 03 32 13 5F
		        	32 10 08 35 01 28 07 37 00 3C 
		        	14 3D 3D 14 00 40 08 28 08 30 
		        	30 04
	        39 01 00 00 00 00 30
				D5 00 00 0A 00 01 05 00 00 18 
				88 99 88 01 45 88 88 01 45 23
				67 88 88 88 88 88 88 88 99 54
				10 88 88 76 32 54 10 88 88 88
				88 88 00 00 00 00 00 00		        	
	        39 01 00 00 00 00 04
		       	DE 05 70 04
	        39 01 00 00 00 00 24
				E0 79 04 10 13 16 16 2a 2C 38
				0C 13 10 14 16 15 16 11 12 04 
				10 13 16 16 2a 2C 38 0C 13 10 
				14 16 15 16 11 12
	        39 01 00 00 00 00 05
				B6 00 71 00 71
	        39 01 00 00 00 00 03
				C6 00 02
		 15 01 00 00 00 00 02
				CC 02
		 15 01 00 00 00 00 02
				35 00
		 05 01 00 00 96 00 02 11 00
		 05 01 00 00 32 00 02 29 00];
		 
		qcom,mdss-dsi-off-command = [05 01 00 00 02 00 02 28 00
					05 01 00 00 79 00 02 10 00];
		qcom,mdss-dsi-on-command-state = "dsi_lp_mode";
		qcom,mdss-dsi-off-command-state = "dsi_hs_mode";
		qcom,mdss-dsi-h-sync-pulse = <1>;
		qcom,mdss-dsi-traffic-mode = "burst_mode";
		qcom,mdss-dsi-lane-map = "lane_map_3012";
		qcom,mdss-dsi-bllp-eof-power-mode;
		qcom,mdss-dsi-bllp-power-mode;
		qcom,mdss-dsi-lane-0-state;
		qcom,mdss-dsi-lane-1-state;
//		qcom,mdss-dsi-lane-2-state;
//		qcom,mdss-dsi-lane-3-state;
		qcom,mdss-dsi-panel-timings = [D5 18 10 00 38 3E 12 1A 13 03 04 00];
		qcom,mdss-dsi-t-clk-post = <0x05>;
		qcom,mdss-dsi-t-clk-pre = <0x36>;
		qcom,mdss-dsi-panel-clockrate = <368500000>;
		qcom,mdss-dsi-bl-min-level = <1>;
		qcom,mdss-dsi-bl-max-level = <255>;
		qcom,mdss-dsi-dma-trigger = "trigger_sw";
		qcom,mdss-dsi-mdp-trigger = "none";
		qcom,mdss-dsi-bl-pmic-control-type = "bl_ctrl_wled";
		qcom,mdss-dsi-reset-sequence = <1 20>, <0 200>, <1 20>;
		qcom,mdss-pan-physical-width-dimension = <0>;
		qcom,mdss-pan-physical-height-dimension = <0>;
	};
};
