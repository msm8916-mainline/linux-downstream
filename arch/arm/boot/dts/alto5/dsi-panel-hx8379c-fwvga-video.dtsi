/* Copyright (c) 2014, The Linux Foundation. All rights reserved.
 *
 * This program is free software; you can redistribute it and/or modify
 * it under the terms of the GNU General Public License version 2 and
 * only version 2 as published by the Free Software Foundation.
 *
 * This program is distributed in the hope that it will be useful,
 * but WITHOUT ANY WARRANTY; without even the implied warranty of
 * MERCHANTABILITY or FITNESS FOR A PARTICULAR PURPOSE.  See the
 * GNU General Public License for more details.
 */

/*---------------------------------------------------------------------------
 * This file is autogenerated file using gcdb parser. Please do not edit it.
 * Update input XML file to add a new entry or update variable in this file
 * VERSION = "1.0"
 *---------------------------------------------------------------------------*/
&mdss_mdp {
	dsi_hx8379c_fwvga_vid: qcom,mdss_dsi_hx8379c_fwvga_video {
		qcom,mdss-dsi-panel-name = "hx8379c video mode dsi panel";
		qcom,mdss-dsi-panel-controller = <&mdss_dsi0>;
		qcom,mdss-dsi-panel-type = "dsi_video_mode";
		qcom,mdss-dsi-panel-destination = "display_1";
		qcom,mdss-dsi-panel-framerate = <60>;
		qcom,mdss-dsi-virtual-channel-id = <0>;
		qcom,mdss-dsi-stream = <0>;
		qcom,mdss-dsi-panel-width = <480>;
		qcom,mdss-dsi-panel-height = <854>;
		qcom,mdss-dsi-h-front-porch = <106>;
		qcom,mdss-dsi-h-back-porch = <75>;
		qcom,mdss-dsi-h-pulse-width = <65>;
		qcom,mdss-dsi-h-sync-skew = <0>;
		qcom,mdss-dsi-v-back-porch = <5>;
		qcom,mdss-dsi-v-front-porch = <5>;
		qcom,mdss-dsi-v-pulse-width = <5>;
		//modify end
		qcom,mdss-dsi-h-left-border = <0>;
		qcom,mdss-dsi-h-right-border = <0>;
		qcom,mdss-dsi-v-top-border = <0>;
		qcom,mdss-dsi-v-bottom-border = <0>;
		qcom,mdss-dsi-bpp = <24>;
		qcom,mdss-dsi-color-order = "rgb_swap_rgb";
		qcom,mdss-dsi-underflow-color = <0xff>;
		qcom,mdss-dsi-border-color = <0>;
		qcom,mdss-dsi-on-command = [
		39 01 00 00 00 00 04
			B9 FF 83 79
		39 01 00 00 00 00 03
			BA 51 93
		39 01 00 00 00 00 15
			B1 44 19 19 31 31 50 D0 EE 54 80 38 38 F8 33 32 22 00 80 30 00
		39 01 00 00 00 00 0A
			B2 80 FE 0A 03 20 50 11 42 1D
		39 01 00 00 00 00 0B
			B4 02 6A 02 6A 02 6A 22 80 23 80
		39 01 00 00 00 00 02
			CC 02
		39 01 00 00 00 00 02
			D2 77
		39 01 00 00 00 00 1E
			D3 00 07 00 00 00 06 06 32 10 03 00 03 03 5F 03 5F 00 08 00 08 35 33 07 07 37 07 07 37 08
		39 01 00 00 00 00 21
			D5 18 18 19 19 18 18 20 21 24 25 18 18 18 18 00 01 04 05 02 03 06 07 18 18 18 18 18 18 18 18 18 18
		39 01 00 00 00 00 21
			D6  18  18  18  18  19  19  25  24  21  20 18 18 18 18 05 04 01 00 03 02 07 06 18 18 18 18 18 18 18 18 18 18
		39 01 00 00 00 00 2B
			E0 00 07 09 17 17 3F 30 3b 07 0F 12 1a 11 15 18 16 16 0a 0f 14 18 00 07 09 17 17 3F 30 3b 07 0F 12 1a 11 15 18 16 16 0a 0f 14 18
		39 01 00 00 00 00 03 B6 38 38
		15 01 00 00 00 00 02 35 00
		05 01 00 00 96 00 02 11 00
		05 01 00 00 12 00 02 29 00];
		qcom,mdss-dsi-off-command = [05 01 00 00 02 00 02 28 00
					05 01 00 00 79 00 02 10 00];
		qcom,mdss-dsi-on-command-state = "dsi_lp_mode";
		qcom,mdss-dsi-off-command-state = "dsi_hs_mode";
		qcom,mdss-dsi-h-sync-pulse = <1>;
		qcom,mdss-dsi-traffic-mode = "burst_mode";
		qcom,mdss-dsi-lane-map = "lane_map_3012";//modify by yusen.ke.sz@tcl.com at 20140714 for lcd driver
		qcom,mdss-dsi-bllp-eof-power-mode;
		qcom,mdss-dsi-bllp-power-mode;
		qcom,mdss-dsi-lane-0-state;
		qcom,mdss-dsi-lane-1-state;
//		qcom,mdss-dsi-lane-2-state;
//		qcom,mdss-dsi-lane-3-state;
		qcom,mdss-dsi-panel-timings = [E7 1C 12 00 42 42 18 20 17 03 04 00];
		qcom,mdss-dsi-t-clk-post = <0x04>;
		qcom,mdss-dsi-t-clk-pre = <0x26>;
		qcom,mdss-dsi-panel-clockrate = <454200000>;
		qcom,mdss-dsi-bl-min-level = <1>;
		qcom,mdss-dsi-bl-max-level = <255>;
		qcom,mdss-dsi-dma-trigger = "trigger_sw";
		qcom,mdss-dsi-mdp-trigger = "none";
		qcom,mdss-dsi-bl-pmic-control-type = "bl_ctrl_wled";
		qcom,mdss-dsi-reset-sequence = <1 20>, <0 20>, <1 20>;
		qcom,mdss-pan-physical-width-dimension = <62>;
		qcom,mdss-pan-physical-height-dimension = <110>;
	};
};
