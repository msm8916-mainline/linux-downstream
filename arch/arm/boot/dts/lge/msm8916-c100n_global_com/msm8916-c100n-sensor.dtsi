/* Copyright (c) 2012, Code Aurora Forum. All rights reserved.
 *
 * This program is free software; you can redistribute it and/or modify
 * it under the terms of the GNU General Public License version 2 and
 * only version 2 as published by the Free Software Foundation.
 *
 * This program is distributed in the hope that it will be useful,
 * but WITHOUT ANY WARRANTY; without even the implied warranty of
 * MERCHANTABILITY or FITNESS FOR A PARTICULAR PURPOSE.  See the
 * GNU General Public License for more details.
 */

&i2c_0{
	rpr05210@38 {
		status = "ok";
		reg = <0x38>;
		compatible = "rohm,rpr0521";
		interrupt-parent = <&msm_gpio>;
		interrupts = <113 0x2>;
		sensor_vdd-supply = <&pm8916_l17_sns>;
		sensor_vcc_i2c-supply = <&pm8916_l6>;
		pinctrl-names = "default", "sleep";
		pinctrl-0 = <&rpr0521_int_active>;
		pinctrl-1 = <&rpr0521_int_suspend>;
		Rohm,i2c-pull-up;
		Rohm,irq-gpio = <&msm_gpio 113 0x0>;
		Rohm,pulse = <0>;
		Rohm,mode = <0>;
		Rohm,measure_time = <6>;
		Rohm,led_current = <2>;
		Rohm,als_gain = <0>;
		Rohm,infrared_level = <0>;
		Rohm,ps_gain = <0>;
		Rohm,persistence = <2>;
		Rohm,near_offset = <35>;
		Rohm,far_offset = <10>;
		Rohm,bright_threshold = <10>;
		Rohm,dark_threshold = <5>;
		Rohm,default_cross_talk = <50>;
		Rohm,judge_coef0 = <1095>;
		Rohm,judge_coef1 = <1254>;
		Rohm,judge_coef2 = <1582>;
		Rohm,judge_coef3 = <4091>;
		Rohm,data0_coef0 = <5751>;
		Rohm,data0_coef1 = <5611>;
		Rohm,data0_coef2 = <4601>;
		Rohm,data0_coef3 = <1493>;
		Rohm,data1_coef0 = <3261>;
		Rohm,data1_coef1 = <3133>;
		Rohm,data1_coef2 = <2328>;
		Rohm,data1_coef3 = <364>;
	};

	/* Acceleration sensor */
	bosch_bma2x2@11 {
		compatible = "bosch,bma2x2";
		status = "ok";
		reg = <0x11>;
		interrupt-parent = <&msm_gpio>;
		interrupts = <115 0x2>;
		Bosch,vdd_ana-supply = <&pm8916_l17_sns>;
		Bosch,vddio_i2c-supply = <&pm8916_l6>;
		pinctrl-names = "default", "sleep";
		pinctrl-0 = <&bma2x2_int_active>;
		pinctrl-1 = <&bma2x2_int_suspend>;
		Bosch,irq-gpio = <&msm_gpio 115 0x00>;
		Bosch,i2c-pull-up;
		Bosch,vdd_ana_supply_min = <2850000>;
		Bosch,vdd_ana_supply_max = <3300000>;
		Bosch,vdd_ana_load_ua = <15000>;
		Bosch,vddio_dig_supply_min = <1800000>;
		Bosch,vddio_dig_supply_max = <1800000>;
		Bosch,vddio_dig_load_ua = <10000>;
		Bosch,vddio_i2c_supply_min = <1800000>;
		Bosch,vddio_i2c_supply_max = <1800000>;
		Bosch,vddio_i2c_load_ua = <10000>;
		place = <7>;
	};

	/* Magnetic Sensor Driver */
	bosch_bmm050@13 {
		compatible = "bosch,bmm050";
		status = "ok";
		reg = <0x13>;
		interrupt-parent = <&msm_gpio>;
		interrupts = <69 0x2>;
		Bosch,vdd_ana-supply = <&pm8916_l17_sns>;
		Bosch,vddio_i2c-supply = <&pm8916_l6>;
		pinctrl-names = "default", "sleep";
		pinctrl-0 = <&bmm_drdy_active>;
		pinctrl-1 = <&bmm_drdy_suspend>;
		Bosch,irq-gpio = <&msm_gpio 69 0x00>;
		Bosch,i2c-pull-up;
		Bosch,vdd_ana_supply_min = <2850000>;
		Bosch,vdd_ana_supply_max = <3300000>;
		Bosch,vdd_ana_load_ua = <15000>;
		Bosch,vddio_dig_supply_min = <1800000>;
		Bosch,vddio_dig_supply_max = <1800000>;
		Bosch,vddio_dig_load_ua = <10000>;
		Bosch,vddio_i2c_supply_min = <1800000>;
		Bosch,vddio_i2c_supply_max = <1800000>;
		Bosch,vddio_i2c_load_ua = <10000>;
		place = <7>;
	};
};
