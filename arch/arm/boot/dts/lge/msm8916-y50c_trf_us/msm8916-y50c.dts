/* Copyright (c) 2014, The Linux Foundation. All rights reserved.
*
* This program is free software; you can redistribute it and/or modify
* it under the terms of the GNU General Public License version 2 and
* only version 2 as published by the Free Software Foundation.
*
* This program is distributed in the hope that it will be useful,
* but WITHOUT ANY WARRANTY; without even the implied warranty of
* MERCHANTABILITY or FITNESS FOR A PARTICULAR PURPOSE.  See the
* GNU General Public License for more details.
*/

/dts-v1/;

#include "../msm8916-lge-common/msm8916-lge.dtsi"
#include "../../qcom/msm8916-memory.dtsi"
#include "msm8916-y50c.dtsi"
/ {
	model = "Qualcomm MSM 8916, Y50C TRF US";
	compatible = "qcom,msm8916";
	qcom,board-id = <100 0>;
};
