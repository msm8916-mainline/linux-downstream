&mdss_mdp {
	dsi_tianma_hvga_cmd: qcom,mdss_dsi_tianma_ili9488_hvga_cmd_none_lcd_panel {
		qcom,cont-splash-enabled;
		qcom,mdss-dsi-panel-name = "TIANMA 320p cmd mode dsi panel";
		qcom,mdss-dsi-panel-controller = <&mdss_dsi0>;
		qcom,mdss-dsi-panel-type = "dsi_cmd_mode";
		qcom,mdss-dsi-panel-destination = "display_1";
		qcom,mdss-pan-physical-width-dimension = <45>;
		qcom,mdss-pan-physical-height-dimension = <68>;
		qcom,mdss-dsi-panel-width = <320>;
		qcom,mdss-dsi-panel-height = <480>;
		qcom,mdss-dsi-bpp = <24>;
		qcom,mdss-dsi-h-back-porch = <14>;
		qcom,mdss-dsi-h-pulse-width = <8>;
		qcom,mdss-dsi-h-front-porch = <49>;
		qcom,mdss-dsi-h-sync-skew = <0>;
		qcom,mdss-dsi-v-back-porch = <14>;
		qcom,mdss-dsi-v-pulse-width = <4>;
		qcom,mdss-dsi-v-front-porch = <14>;
		qcom,mdss-dsi-underflow-color = <0>;
		qcom,mdss-dsi-bl-pmic-control-type = "bl_others";
		qcom,mdss-dsi-h-sync-pulse = <0>;
		qcom,mdss-dsi-traffic-mode = "non_burst_sync_event";
		qcom,mdss-dsi-bllp-eof-power-mode;
		qcom,mdss-dsi-bllp-power-mode;
		qcom,mdss-dsi-te-check-enable;
		qcom,mdss-dsi-te-using-te-pin;
		qcom,mdss-dsi-te-dcs-command = <1>;
		qcom,mdss-dsi-te-v-sync-rd-ptr-irq-line = <0x2c>;
		qcom,mdss-dsi-te-v-sync-continues-lines = <0x3c>;
		qcom,mdss-dsi-virtual-channel-id = <0>;
		qcom,mdss-dsi-color-order = "rgb_swap_rgb";
		qcom,mdss-dsi-lane-0-state;
		qcom,mdss-dsi-lane-map = "lane_map_0123";
		qcom,mdss-dsi-t-clk-pre = <0x27>;
		qcom,mdss-dsi-t-clk-post = <0x20>;
		qcom,mdss-dsi-stream = <0>;
		qcom,mdss-dsi-mdp-trigger = "trigger_te";
		qcom,mdss-dsi-dma-trigger = "trigger_sw";
		qcom,mdss-dsi-panel-framerate = <60>;
		qcom,mdss-dsi-panel-timings = [4A 1A 12 00 25 26 16 1C 1C 03 04 00];
		qcom,mdss-dsi-on-command-state = "dsi_lp_mode";
		qcom,mdss-dsi-off-command-state = "dsi_lp_mode";
		qcom,mdss-dsi-reset-sequence = <1 1>, <0 10>, <1 120>;
		qcom,mdss-dsi-on-command = [
				23 01 00 00 00 00 02
				  C1 41
				29 01 00 00 00 00 03
				  C0 15 15
				29 01 00 00 00 00 10
				  E0 00 09 13 00 0E 05 3E 89 4E 0A 0D 0B 22 25 0F
				29 01 00 00 00 00 10
				  E1 00 1B 1F 06 12 08 33 33 48 04 11 0F 2B 36 0F
				29 01 00 00 00 00 04
				  C5 00 53 80
				39 01 00 00 00 00 02
				  B0 00
				39 01 00 00 00 00 03
				  B1 B0 12
				23 01 00 00 00 00 02
				  B4 02
				29 01 00 00 00 00 04
				  B6 02 22 3B
				39 01 00 00 00 00 02
				  E9 00
				29 01 00 00 00 00 05
				  F7 A9 51 2C 82
				15 01 00 00 00 00 02
				  3A 66
				39 01 00 00 00 00 02
				  36 08
				//15 01 00 00 00 00 02
				//  53 2C
				//15 01 00 00 00 00 02
				//  51 FF
				//15 01 00 00 00 00 02
				//  55 00
				39 01 00 00 00 00 0C
				  F2 58 04 12 02 22 42 FF 0A 90 18 88
				05 01 00 00 78 00 01
				  11
				05 01 00 00 14 00 01
				  29
				05 01 00 00 00 00 01
				  2C
				];
		qcom,mdss-dsi-off-command = [
				05 01 00 00 32 00 01
				  28
				05 01 00 00 78 00 01
				  10
				];
	};
};
