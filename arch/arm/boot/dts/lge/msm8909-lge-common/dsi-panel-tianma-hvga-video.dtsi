&mdss_mdp {
	dsi_tianma_hvga_vid: qcom,mdss_dsi_tianma_ili9488_hvga_video_none_lcd_panel {
		qcom,cont-splash-enabled;
		qcom,mdss-dsi-panel-name = "TIANMA 320p video mode dsi panel";
		qcom,mdss-dsi-panel-controller = <&mdss_dsi0>;
		qcom,mdss-dsi-panel-type = "dsi_video_mode";
		qcom,mdss-dsi-panel-destination = "display_1";
		qcom,mdss-pan-physical-width-dimension = <45>;
		qcom,mdss-pan-physical-height-dimension = <68>;
		qcom,mdss-dsi-panel-width = <320>;
		qcom,mdss-dsi-panel-height = <480>;
		qcom,mdss-dsi-bpp = <24>;
		qcom,mdss-dsi-h-back-porch = <15>;
		qcom,mdss-dsi-h-pulse-width = <4>;
		qcom,mdss-dsi-h-front-porch = <34>;
		qcom,mdss-dsi-h-sync-skew = <0>;
		qcom,mdss-dsi-v-back-porch = <8>;
		qcom,mdss-dsi-v-pulse-width = <4>;
		qcom,mdss-dsi-v-front-porch = <4>;
		qcom,mdss-dsi-underflow-color = <0>;
		qcom,mdss-dsi-bl-pmic-control-type = "bl_others";
		qcom,mdss-dsi-h-sync-pulse = <0>;
		qcom,mdss-dsi-traffic-mode = "non_burst_sync_event";
		qcom,mdss-dsi-bllp-eof-power-mode;
		qcom,mdss-dsi-bllp-power-mode;
		qcom,mdss-dsi-te-dcs-command = <1>;
		qcom,mdss-dsi-te-v-sync-rd-ptr-irq-line = <0x2c>;
		qcom,mdss-dsi-te-v-sync-continues-lines = <0x3c>;
		qcom,mdss-dsi-virtual-channel-id = <0>;
		qcom,mdss-dsi-color-order = "rgb_swap_rgb";
		qcom,mdss-dsi-lane-0-state;
		qcom,mdss-dsi-lane-map = "lane_map_0123";
		qcom,mdss-dsi-t-clk-pre = <0x05>;
		qcom,mdss-dsi-t-clk-post = <0x0F>;
		qcom,mdss-dsi-stream = <0>;
		qcom,mdss-dsi-mdp-trigger = "trigger_te";
		qcom,mdss-dsi-dma-trigger = "trigger_sw";
		qcom,mdss-dsi-panel-framerate = <60>;
		qcom,mdss-dsi-panel-timings = [38 0C 04 00 24 28 08 0E 04 03 04 00];
		qcom,mdss-dsi-on-command-state = "dsi_lp_mode";
		qcom,mdss-dsi-off-command-state = "dsi_lp_mode";
		qcom,mdss-dsi-reset-sequence = <1 1>, <0 10>, <1 120>;
		qcom,mdss-dsi-on-command = [
				23 01 00 00 00 00 02
				  C1 41
				29 01 00 00 00 00 03
				  C0 15 15
				29 01 00 00 00 00 10
				  E0 00 09 13 00 10 07 40 87 51 0A 0F 0B 21 25 0F
				29 01 00 00 00 00 10
				  E1 00 1B 1F 06 10 06 31 35 45 04 0F 0F 2C 36 0F
				29 01 00 00 00 00 04
				  C5 00 56 80
				39 01 00 00 00 00 02
				  B0 00
				39 01 00 00 00 00 02
				  B1 A0
				23 01 00 00 00 00 02
				  B4 02
				29 01 00 00 00 00 04
				  B6 B2 22 02
				39 01 00 00 00 00 02
				  E9 00
				29 01 00 00 00 00 05
				  F7 A9 51 2C 82
				15 01 00 00 00 00 02
				  3A 66
				39 01 00 00 00 00 02
				  36 C8
				15 01 00 00 00 00 02
				  53 2C
				15 01 00 00 00 00 02
				  51 FF
				15 01 00 00 00 00 02
				  55 00
				39 01 00 00 00 00 0C
				  F2 58 04 12 02 22 42 FF 0A 90 18 88
				05 01 00 00 78 00 01
				  11
				05 01 00 00 14 00 01
				  29
				05 01 00 00 00 00 01
				  2C
				];
		qcom,mdss-dsi-off-command = [
				05 01 00 00 78 00 01
				  10
				];
	};
};
