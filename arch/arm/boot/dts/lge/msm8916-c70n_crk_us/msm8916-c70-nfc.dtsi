/* Copyright (c) 2012, Code Aurora Forum. All rights reserved.
 *
 * This program is free software; you can redistribute it and/or modify
 * it under the terms of the GNU General Public License version 2 and
 * only version 2 as published by the Free Software Foundation.
 *
 * This program is distributed in the hope that it will be useful,
 * but WITHOUT ANY WARRANTY; without even the implied warranty of
 * MERCHANTABILITY or FITNESS FOR A PARTICULAR PURPOSE.  See the
 * GNU General Public License for more details.
 */

/* LGE_CHANGE, [NFC][kiwon.jeon@lge.com], NFC Bring up temp */
&soc {
    i2c@78ba000 { //E2 Rev.A
    /*i2c@78b8000 {*/ //E2 HDK
            bcm2079x@76 {
            compatible = "bcm,bcm2079x";
            /*status = "disable";*/
            reg = <0x76>;
            bcm,gpio_sda = <&msm_gpio 22 0x00>;
            bcm,gpio_scl = <&msm_gpio 23 0x00>;
            /*bcm,gpio_sda = <&msm_gpio 14 0x00>;
            bcm,gpio_scl = <&msm_gpio 15 0x00>;*/
            bcm,gpio_irq = <&msm_gpio 21 0x00>;
            bcm,gpio_ven = <&msm_gpio 20 0x00>;
            bcm,gpio_mode = <&msm_gpio 118 0x00>;
            qcom,clk-src = "BBCLK2";
            //qcom,clk-en-gpio = <&msm_gpio 2 0x00>;
            interrupt-parent = <&msm_gpio>;
            interrupts = <21 0x2>;
            //pinctrl-names = "default", "sleep";
            pinctrl-names = "nfc_active","nfc_suspend";
            pinctrl-0 = <&nfc_int_active &nfc_disable_active &nfc_wake_active>;
            pinctrl-1 = <&nfc_int_suspend &nfc_disable_suspend &nfc_wake_suspend>;
            //bcm,i2c-pull-up = <1>;
            qcom,clk-en-gpio = <&msm_gpio 0 0x00>;
            qcom,clk-gpio = <&pm8916_gpios 2 0>;
            qcom,clk-freq-out = <400000>;
            qcom,clk-freq-in  = <19200000>;
            clocks = <&clock_rpm clk_bb_clk2_pin>;
            clock-names = "ref_clk";
            };
    };
};
