/* Copyright (c) 2012, Code Aurora Forum. All rights reserved.
 *
 * This program is free software; you can redistribute it and/or modify
 * it under the terms of the GNU General Public License version 2 and
 * only version 2 as published by the Free Software Foundation.
 *
 * This program is distributed in the hope that it will be useful,
 * but WITHOUT ANY WARRANTY; without even the implied warranty of
 * MERCHANTABILITY or FITNESS FOR A PARTICULAR PURPOSE.  See the
 * GNU General Public License for more details.
 */

&soc {
    i2c@78ba000 {
            pn547@28 {
            compatible = "nxp,pn547";
            reg = <0x28>;
            interrupt-parent = <&msm_gpio>;
            interrupts = <21 0x2>;
            nxp,gpio_sda = <&msm_gpio 22 0x00>;
            nxp,gpio_scl = <&msm_gpio 23 0x00>;
            nxp,gpio_irq = <&msm_gpio 21 0x00>;
            nxp,gpio_ven = <&msm_gpio 20 0x00>;
            nxp,gpio_mode = <&msm_gpio 118 0x00>;
            qcom,clk-src = "BBCLK2";
            pinctrl-names = "nfc_active","nfc_suspend";
            pinctrl-0 = <&nfc_int_active &nfc_disable_active &nfc_wake_active>;
            pinctrl-1 = <&nfc_int_suspend &nfc_disable_suspend &nfc_wake_suspend>;
            qcom,clk-en-gpio = <&msm_gpio 0 0x00>;
            qcom,clk-gpio = <&pm8916_gpios 2 0>;
            clocks = <&clock_rpm clk_bb_clk2_pin>;
            clock-names = "ref_clk";
            qcom,clk-freq-out = <400000>;
            };
    };
};
