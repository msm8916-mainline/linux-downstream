/* Copyright (c) 2014, The Linux Foundation. All rights reserved.
 *
 * This program is free software; you can redistribute it and/or modify
 * it under the terms of the GNU General Public License version 2 and
 * only version 2 as published by the Free Software Foundation.
 *
 * This program is distributed in the hope that it will be useful,
 * but WITHOUT ANY WARRANTY; without even the implied warranty of
 * MERCHANTABILITY or FITNESS FOR A PARTICULAR PURPOSE.  See the
 * GNU General Public License for more details.
 */

&i2c_4 {
	/* BLSP1 QUP4 */
	max17048@36 {
		compatible = "maxim,max17048";
		interrupt-parent = <&msm_gpio>;
		interrupts = <58 0>;
		pinctrl-names = "default";
		pinctrl-0 = <&max_int_default>;
		max17048,alert_gpio = <&msm_gpio 58 0>;
		max17048,rcomp = <103>;
		max17048,temp_co_hot = <375>;
		max17048,temp_co_cold = <6650>;
		max17048,alert_threshold = <0x2>;
		max17048,full_design = <0xbb8>;
		max17048,empty = <0>;
		reg = <0x36>;
	};

	bq24262@6b {
		status = "disabled";
		compatible = "ti,bq24262-charger";
		reg = <0x6b>;
		interrupt-parent = <&msm_gpio>;
		interrupts = <36 0x0>;
		ti,stat-gpio = <&msm_gpio 21 0>;
		ti,int-gpio = <&msm_gpio 36 0>;
		ti,ext-chg-disen-gpio = <&msm_gpio 9 0>;
		ti,term-current-ma = <0>;
		ti,vbat-max-mv = <4325>;	/* Step unit 20 mV, battery available voltage(x = 4.375) : x-0.025 ~ x ~ x+0.025 */
		ti,vin-limit-mv = <4540>;
		/* Pins config setting */
		pinctrl-names = "default", "sleep";
		pinctrl-0 = <&bq24262_int_active &bq24262_ext_stat_active>;
		pinctrl-1 = <&bq24262_int_sleep &bq24262_ext_stat_sleep>;

		/* Each model is defferently value */
		lge,no-init-cable = <0 0 0>;
		lge,cable-mhl-1k = <5000 500 500>;
		lge,cable-u-28p7k = <5500 1200 500>;
		lge,cable-28p7k = <6000 1200 500>;
		lge,cable-56k = <200000 1500 1500>;
		lge,cable-100k = <239000 1200 500>;
		lge,cable-130k = <340000 1500 1500>;
		lge,cable-180k = <400000 1200 500>;
		lge,cable-200k = <410000 1200 500>;
		lge,cable-220k = <485000 1200 500>;
		lge,cable-270k = <560000 1200 500>;
		lge,cable-330k = <735000 1200 500>;
		lge,cable-620k = <955000 1200 500>;
		lge,cable-910k = <1140000 1500 1500>;
		lge,cable-none = <1900000 1200  500>;

		qcom,bq24262-vadc = <&pm8909_vadc>;
	};
};
