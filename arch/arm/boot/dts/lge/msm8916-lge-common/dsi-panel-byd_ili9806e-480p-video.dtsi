&mdss_mdp {
	dsi_byd_ili9806e_vid: qcom,mdss_dsi_byd_ili9806e_video{
		compatible = "qcom,mdss-dsi-panel";
		status = "disable";
		lge,lcd-maker-id = <0>;
		qcom,cont-splash-enabled;
		qcom,mdss-dsi-panel-name = "BYD WVGA video mode dsi panel";
		qcom,mdss-dsi-panel-controller = <&mdss_dsi0>;
		qcom,mdss-dsi-panel-type = "dsi_video_mode";
		qcom,mdss-dsi-panel-destination = "display_1";
		qcom,mdss-pan-physical-width-dimension = <59>;
        qcom,mdss-pan-physical-height-dimension = <98>;
		qcom,mdss-dsi-panel-width = <480>;
		qcom,mdss-dsi-panel-height = <800>;
		qcom,mdss-dsi-bpp = <24>;
		qcom,mdss-dsi-h-back-porch = <60>;
		qcom,mdss-dsi-h-pulse-width = <2>;
		qcom,mdss-dsi-h-front-porch = <60>;
		qcom,mdss-dsi-h-sync-skew = <0>;
		qcom,mdss-dsi-v-back-porch = <20>;
		qcom,mdss-dsi-v-pulse-width = <2>;
		qcom,mdss-dsi-v-front-porch = <20>;
		qcom,mdss-dsi-underflow-color = <0xff>;
		qcom,mdss-dsi-bl-min-level = <1>;
		qcom,mdss-dsi-bl-max-level = <255>;
        qcom,mdss-dsi-bl-pmic-control-type = "bl_ctrl_wled";
        qcom,mdss-dsi-h-sync-pulse = <0>;
		qcom,mdss-dsi-traffic-mode = "non_burst_sync_event";
		qcom,mdss-dsi-bllp-eof-power-mode;
		qcom,mdss-dsi-bllp-power-mode;
        qcom,mdss-dsi-te-dcs-command = <1>;
		qcom,mdss-dsi-te-v-sync-rd-ptr-irq-line = <0x2c>;
		qcom,mdss-dsi-te-v-sync-continues-lines = <0x3c>;
        qcom,mdss-dsi-virtual-channel-id = <0>;
		qcom,mdss-dsi-color-order = "rgb_swap_rgb";
		qcom,mdss-dsi-lane-0-state;
		qcom,mdss-dsi-lane-1-state;
		qcom,mdss-dsi-lane-map = "lane_map_0123";
		qcom,mdss-dsi-t-clk-pre = <0x16>;
		qcom,mdss-dsi-t-clk-post = <0xCB>;
		qcom,mdss-dsi-stream = <0>;
		qcom,mdss-dsi-mdp-trigger = "none";
		qcom,mdss-dsi-dma-trigger = "trigger_sw";
		qcom,mdss-dsi-panel-framerate = <60>;
		qcom,mdss-dsi-panel-timings = [72 16 0E 00 38 3C 12 1A 10 03 04 00];
		qcom,mdss-dsi-on-command-state = "dsi_lp_mode";
		qcom,mdss-dsi-off-command-state = "dsi_lp_mode";
		qcom,mdss-dsi-reset-sequence = <1 1>, <0 1>, <1 130>;
		qcom,mdss-dsi-on-command = [39 01 00 00 00 00 06 FF FF 98 06 04 01
				15 01 00 00 00 00 02 08 10
				15 01 00 00 00 00 02 21 01
				15 01 00 00 00 00 02 30 02
				15 01 00 00 00 00 02 31 02
				15 01 00 00 00 00 02 35 06
				15 01 00 00 00 00 02 60 07
				15 01 00 00 00 00 02 61 00
				15 01 00 00 00 00 02 62 07
				15 01 00 00 00 00 02 63 00
				15 01 00 00 00 00 02 40 12
				15 01 00 00 00 00 02 41 55
				15 01 00 00 00 00 02 42 03
				15 01 00 00 00 00 02 43 09
				15 01 00 00 00 00 02 44 0C
				15 01 00 00 00 00 02 50 78
				15 01 00 00 00 00 02 51 78
				15 01 00 00 00 00 02 52 00
				15 01 00 00 00 00 02 53 69
				15 01 00 00 0A 00 02 57 50
				15 01 00 00 00 00 02 A0 00
				15 01 00 00 00 00 02 A1 10
				15 01 00 00 00 00 02 A2 22
				15 01 00 00 00 00 02 A3 14
				15 01 00 00 00 00 02 A4 06
				15 01 00 00 00 00 02 A5 1D
				15 01 00 00 00 00 02 A6 09
				15 01 00 00 00 00 02 A7 06
				15 01 00 00 00 00 02 A8 08
				15 01 00 00 00 00 02 A9 0D
				15 01 00 00 00 00 02 AA 05
				15 01 00 00 00 00 02 AB 0D
				15 01 00 00 00 00 02 AC 14
				15 01 00 00 00 00 02 AD 26
				15 01 00 00 00 00 02 AE 21
				15 01 00 00 00 00 02 AF 00
				15 01 00 00 00 00 02 C0 00
				15 01 00 00 00 00 02 C1 06
				15 01 00 00 00 00 02 C2 11
				15 01 00 00 00 00 02 C3 11
				15 01 00 00 00 00 02 C4 0E
				15 01 00 00 00 00 02 C5 16
				15 01 00 00 00 00 02 C6 0A
				15 01 00 00 00 00 02 C7 09
				15 01 00 00 00 00 02 C8 00
				15 01 00 00 00 00 02 C9 05
				15 01 00 00 00 00 02 CA 07
				15 01 00 00 00 00 02 CB 00
				15 01 00 00 00 00 02 CC 09
				15 01 00 00 00 00 02 CD 26
				15 01 00 00 00 00 02 CE 21
				15 01 00 00 0A 00 02 CF 00
				39 01 00 00 00 00 06 FF FF 98 06 04 06
				15 01 00 00 00 00 02 00 A0
				15 01 00 00 00 00 02 01 05
				15 01 00 00 00 00 02 02 00
				15 01 00 00 00 00 02 03 00
				15 01 00 00 00 00 02 04 01
				15 01 00 00 00 00 02 05 01
				15 01 00 00 00 00 02 06 88
				15 01 00 00 00 00 02 07 04
				15 01 00 00 00 00 02 08 01
				15 01 00 00 00 00 02 09 90
				15 01 00 00 00 00 02 0A 04
				15 01 00 00 00 00 02 0B 01
				15 01 00 00 00 00 02 0C 01
				15 01 00 00 00 00 02 0D 01
				15 01 00 00 00 00 02 0E 00
				15 01 00 00 00 00 02 0F 00
				15 01 00 00 00 00 02 10 55
				15 01 00 00 00 00 02 11 50
				15 01 00 00 00 00 02 12 01
				15 01 00 00 00 00 02 13 87
				15 01 00 00 00 00 02 14 87
				15 01 00 00 00 00 02 15 C0
				15 01 00 00 00 00 02 16 0B
				15 01 00 00 00 00 02 17 00
				15 01 00 00 00 00 02 18 00
				15 01 00 00 00 00 02 19 00
				15 01 00 00 00 00 02 1A 00
				15 01 00 00 00 00 02 1B 00
				15 01 00 00 00 00 02 1C 00
				15 01 00 00 00 00 02 1D 00
				15 01 00 00 00 00 02 20 01
				15 01 00 00 00 00 02 21 23
				15 01 00 00 00 00 02 22 45
				15 01 00 00 00 00 02 23 67
				15 01 00 00 00 00 02 24 01
				15 01 00 00 00 00 02 25 23
				15 01 00 00 00 00 02 26 45
				15 01 00 00 00 00 02 27 67
				15 01 00 00 00 00 02 30 02
				15 01 00 00 00 00 02 31 22
				15 01 00 00 00 00 02 32 11
				15 01 00 00 00 00 02 33 AA
				15 01 00 00 00 00 02 34 BB
				15 01 00 00 00 00 02 35 66
				15 01 00 00 00 00 02 36 00
				15 01 00 00 00 00 02 37 22
				15 01 00 00 00 00 02 38 22
				15 01 00 00 00 00 02 39 22
				15 01 00 00 00 00 02 3A 22
				15 01 00 00 00 00 02 3B 22
				15 01 00 00 00 00 02 3C 22
				15 01 00 00 00 00 02 3D 22
				15 01 00 00 00 00 02 3E 22
				15 01 00 00 00 00 02 3F 22
				15 01 00 00 00 00 02 40 22
				15 01 00 00 00 00 02 52 10
				15 01 00 00 00 00 02 53 10
				15 01 00 00 0A 00 02 54 13
				39 01 00 00 00 00 06 FF FF 98 06 04 02
				15 01 00 00 00 00 02 40 01
				15 01 00 00 00 00 02 00 00
				15 01 00 00 00 00 02 01 00
				15 01 00 00 00 00 02 02 00
				15 01 00 00 00 00 02 03 00
				15 01 00 00 00 00 02 04 00
				15 01 00 00 00 00 02 05 00
				15 01 00 00 00 00 02 06 00
				15 01 00 00 00 00 02 07 00
				15 01 00 00 00 00 02 08 00
				15 01 00 00 00 00 02 09 00
				15 01 00 00 00 00 02 0A 00
				15 01 00 00 00 00 02 0B 00
				15 01 00 00 00 00 02 0C 00
				15 01 00 00 00 00 02 0D 00
				15 01 00 00 00 00 02 0E 10
				15 01 00 00 00 00 02 0F 10
				15 01 00 00 00 00 02 10 20
				15 01 00 00 00 00 02 11 20
				15 01 00 00 00 00 02 12 30
				15 01 00 00 00 00 02 13 30
				15 01 00 00 00 00 02 14 40
				15 01 00 00 00 00 02 15 40
				15 01 00 00 00 00 02 16 50
				15 01 00 00 00 00 02 17 50
				15 01 00 00 00 00 02 18 60
				15 01 00 00 00 00 02 19 60
				15 01 00 00 00 00 02 1A 70
				15 01 00 00 00 00 02 1B 70
				15 01 00 00 00 00 02 1C 70
				15 01 00 00 00 00 02 1D 70
				15 01 00 00 00 00 02 1E 70
				15 01 00 00 00 00 02 1F 70
				15 01 00 00 00 00 02 20 70
				15 01 00 00 00 00 02 21 70
				15 01 00 00 00 00 02 22 70
				15 01 00 00 00 00 02 23 70
				15 01 00 00 00 00 02 24 70
				15 01 00 00 00 00 02 25 70
				15 01 00 00 00 00 02 26 70
				15 01 00 00 00 00 02 27 70
				15 01 00 00 00 00 02 28 70
				15 01 00 00 00 00 02 29 79
				15 01 00 00 00 00 02 2A 69
				15 01 00 00 00 00 02 2B 69
				15 01 00 00 00 00 02 2C 6A
				15 01 00 00 00 00 02 2D 6A
				15 01 00 00 00 00 02 2E 6A
				15 01 00 00 00 00 02 2F 6B
				15 01 00 00 00 00 02 30 6B
				15 01 00 00 00 00 02 31 6B
				15 01 00 00 00 00 02 32 6B
				15 01 00 00 00 00 02 33 6B
				15 01 00 00 00 00 02 34 6B
				15 01 00 00 00 00 02 35 6B
				15 01 00 00 00 00 02 36 5B
				15 01 00 00 00 00 02 37 5B
				15 01 00 00 00 00 02 38 4B
				15 01 00 00 00 00 02 39 3B
				15 01 00 00 00 00 02 3A 2B
				15 01 00 00 00 00 02 3B 2B
				15 01 00 00 00 00 02 3C 1A
				15 01 00 00 00 00 02 3D 1A
				15 01 00 00 00 00 02 3E 09
				15 01 00 00 0A 00 02 3F 00
				39 01 00 00 00 00 06 FF FF 98 06 04 03
				15 01 00 00 00 00 02 00 00
				15 01 00 00 00 00 02 01 00
				15 01 00 00 00 00 02 02 00
				15 01 00 00 00 00 02 03 00
				15 01 00 00 00 00 02 04 00
				15 01 00 00 00 00 02 05 00
				15 01 00 00 00 00 02 06 00
				15 01 00 00 00 00 02 07 00
				15 01 00 00 00 00 02 08 00
				15 01 00 00 00 00 02 09 00
				15 01 00 00 00 00 02 0A 00
				15 01 00 00 00 00 02 0B 00
				15 01 00 00 00 00 02 0C 00
				15 01 00 00 00 00 02 0D 00
				15 01 00 00 00 00 02 0E 00
				15 01 00 00 00 00 02 0F 00
				15 01 00 00 00 00 02 10 00
				15 01 00 00 00 00 02 11 00
				15 01 00 00 00 00 02 12 00
				15 01 00 00 00 00 02 13 00
				15 01 00 00 00 00 02 14 00
				15 01 00 00 00 00 02 15 00
				15 01 00 00 00 00 02 16 00
				15 01 00 00 00 00 02 17 00
				15 01 00 00 00 00 02 18 00
				15 01 00 00 00 00 02 19 00
				15 01 00 00 00 00 02 1A 00
				15 01 00 00 00 00 02 1B 00
				15 01 00 00 00 00 02 1C 00
				15 01 00 00 00 00 02 1D 00
				15 01 00 00 00 00 02 1E 00
				15 01 00 00 00 00 02 1F 00
				15 01 00 00 00 00 02 20 00
				15 01 00 00 00 00 02 21 00
				15 01 00 00 00 00 02 22 00
				15 01 00 00 00 00 02 23 00
				15 01 00 00 00 00 02 24 00
				15 01 00 00 00 00 02 25 00
				15 01 00 00 00 00 02 26 00
				15 01 00 00 00 00 02 27 00
				15 01 00 00 00 00 02 28 30
				15 01 00 00 00 00 02 29 30
				15 01 00 00 00 00 02 2A 50
				15 01 00 00 00 00 02 2B 60
				15 01 00 00 00 00 02 2C 00
				15 01 00 00 00 00 02 2D 00
				15 01 00 00 00 00 02 2E 00
				15 01 00 00 00 00 02 2F 00
				15 01 00 00 00 00 02 30 00
				15 01 00 00 00 00 02 31 00
				15 01 00 00 00 00 02 32 00
				15 01 00 00 00 00 02 33 00
				15 01 00 00 00 00 02 34 40
				15 01 00 00 00 00 02 35 40
				15 01 00 00 00 00 02 36 40
				15 01 00 00 00 00 02 37 40
				15 01 00 00 00 00 02 38 80
				15 01 00 00 00 00 02 39 80
				15 01 00 00 00 00 02 3A 80
				15 01 00 00 00 00 02 3B 80
				15 01 00 00 00 00 02 3C 10
				15 01 00 00 00 00 02 3D 10
				15 01 00 00 00 00 02 3E 20
				15 01 00 00 00 00 02 3F 20
				15 01 00 00 00 00 02 40 40
				15 01 00 00 00 00 02 41 40
				15 01 00 00 00 00 02 42 50
				15 01 00 00 00 00 02 43 50
				15 01 00 00 00 00 02 44 60
				15 01 00 00 00 00 02 45 60
				15 01 00 00 00 00 02 46 60
				15 01 00 00 00 00 02 47 60
				15 01 00 00 00 00 02 48 00
				15 01 00 00 00 00 02 49 00
				15 01 00 00 00 00 02 4A 30
				15 01 00 00 00 00 02 4B 30
				15 01 00 00 00 00 02 4C 50
				15 01 00 00 00 00 02 4D 50
				15 01 00 00 00 00 02 4E 70
				15 01 00 00 00 00 02 4F 70
				15 01 00 00 00 00 02 50 80
				15 01 00 00 00 00 02 51 80
				15 01 00 00 00 00 02 52 A0
				15 01 00 00 00 00 02 53 A0
				15 01 00 00 00 00 02 54 30
				15 01 00 00 00 00 02 55 30
				15 01 00 00 00 00 02 56 30
				15 01 00 00 00 00 02 57 30
				15 01 00 00 00 00 02 58 50
				15 01 00 00 00 00 02 59 50
				15 01 00 00 00 00 02 5A 50
				15 01 00 00 00 00 02 5B 50
				15 01 00 00 00 00 02 5C 70
				15 01 00 00 00 00 02 5D 70
				15 01 00 00 00 00 02 5E 70
				15 01 00 00 00 00 02 5F 70
				15 01 00 00 00 00 02 60 80
				15 01 00 00 00 00 02 61 80
				15 01 00 00 00 00 02 62 80
				15 01 00 00 00 00 02 63 80
				15 01 00 00 00 00 02 64 A0
				15 01 00 00 00 00 02 65 A0
				15 01 00 00 00 00 02 66 A0
				15 01 00 00 00 00 02 67 A0
				15 01 00 00 00 00 02 68 B0
				15 01 00 00 00 00 02 69 B0
				15 01 00 00 00 00 02 6A B0
				15 01 00 00 00 00 02 6B B0
				15 01 00 00 00 00 02 6C C0
				15 01 00 00 00 00 02 6D C0
				15 01 00 00 00 00 02 6E C0
				15 01 00 00 00 00 02 6F C0
				15 01 00 00 00 00 02 70 D0
				15 01 00 00 00 00 02 71 D0
				15 01 00 00 00 00 02 72 D0
				15 01 00 00 00 00 02 73 D0
				15 01 00 00 00 00 02 74 D0
				15 01 00 00 00 00 02 75 D0
				15 01 00 00 00 00 02 76 E0
				15 01 00 00 00 00 02 77 E0
				15 01 00 00 00 00 02 78 E0
				15 01 00 00 00 00 02 79 E0
				15 01 00 00 00 00 02 7A F0
				15 01 00 00 00 00 02 7B F0
				15 01 00 00 00 00 02 7C F0
				15 01 00 00 00 00 02 7D F0
				15 01 00 00 00 00 02 7E F0
				15 01 00 00 0A 00 02 7F F0
				39 01 00 00 00 00 06 FF FF 98 06 04 04
				15 01 00 00 00 00 02 00 F0
				15 01 00 00 00 00 02 01 F0
				15 01 00 00 00 00 02 02 F0
				15 01 00 00 00 00 02 03 F0
				15 01 00 00 00 00 02 04 F0
				15 01 00 00 00 00 02 05 F0
				15 01 00 00 00 00 02 06 F0
				15 01 00 00 00 00 02 07 F0
				15 01 00 00 00 00 02 08 F0
				15 01 00 00 00 00 02 09 F0
				15 01 00 00 00 00 02 0A F0
				15 01 00 00 00 00 02 0B F0
				15 01 00 00 00 00 02 0C F0
				15 01 00 00 00 00 02 0D F0
				15 01 00 00 00 00 02 0E F0
				15 01 00 00 00 00 02 0F F0
				15 01 00 00 00 00 02 10 F0
				15 01 00 00 00 00 02 11 F0
				15 01 00 00 00 00 02 12 F0
				15 01 00 00 00 00 02 13 F0
				15 01 00 00 00 00 02 14 F0
				15 01 00 00 00 00 02 15 F0
				15 01 00 00 00 00 02 16 F0
				15 01 00 00 00 00 02 17 F0
				15 01 00 00 00 00 02 18 F0
				15 01 00 00 00 00 02 19 F0
				15 01 00 00 00 00 02 1A F0
				15 01 00 00 00 00 02 1B F0
				15 01 00 00 00 00 02 1C F0
				15 01 00 00 00 00 02 1D F0
				15 01 00 00 00 00 02 1E F0
				15 01 00 00 00 00 02 1F F0
				15 01 00 00 00 00 02 20 F0
				15 01 00 00 00 00 02 21 F0
				15 01 00 00 00 00 02 22 F0
				15 01 00 00 00 00 02 23 F0
				15 01 00 00 00 00 02 24 F6
				15 01 00 00 00 00 02 25 F6
				15 01 00 00 00 00 02 26 F6
				15 01 00 00 00 00 02 27 F6
				15 01 00 00 00 00 02 28 F4
				15 01 00 00 00 00 02 29 F4
				15 01 00 00 00 00 02 2A F4
				15 01 00 00 00 00 02 2B F4
				15 01 00 00 00 00 02 2C F2
				15 01 00 00 00 00 02 2D F2
				15 01 00 00 00 00 02 2E F2
				15 01 00 00 00 00 02 2F F2
				15 01 00 00 00 00 02 30 F0
				15 01 00 00 00 00 02 31 F0
				15 01 00 00 00 00 02 32 F0
				15 01 00 00 00 00 02 33 F0
				15 01 00 00 00 00 02 34 F0
				15 01 00 00 00 00 02 35 F0
				15 01 00 00 00 00 02 36 F0
				15 01 00 00 00 00 02 37 F0
				15 01 00 00 00 00 02 38 F0
				15 01 00 00 00 00 02 39 F0
				15 01 00 00 00 00 02 3A F0
				15 01 00 00 00 00 02 3B F0
				15 01 00 00 00 00 02 3C F6
				15 01 00 00 00 00 02 3D F6
				15 01 00 00 00 00 02 3E F6
				15 01 00 00 00 00 02 3F F6
				15 01 00 00 00 00 02 40 F2
				15 01 00 00 00 00 02 41 F2
				15 01 00 00 00 00 02 42 F2
				15 01 00 00 00 00 02 43 F2
				15 01 00 00 00 00 02 44 F0
				15 01 00 00 00 00 02 45 F0
				15 01 00 00 00 00 02 46 D0
				15 01 00 00 00 00 02 47 D0
				15 01 00 00 00 00 02 48 B2
				15 01 00 00 00 00 02 49 B2
				15 01 00 00 00 00 02 4A 92
				15 01 00 00 00 00 02 4B 92
				15 01 00 00 00 00 02 4C 61
				15 01 00 00 00 00 02 4D 61
				15 01 00 00 00 00 02 4E 61
				15 01 00 00 00 00 02 4F 61
				15 01 00 00 00 00 02 50 30
				15 01 00 00 00 00 02 51 30
				15 01 00 00 00 00 02 52 10
				15 01 00 00 00 00 02 53 10
				15 01 00 00 00 00 02 54 90
				15 01 00 00 00 00 02 55 90
				15 01 00 00 00 00 02 56 90
				15 01 00 00 00 00 02 57 90
				15 01 00 00 00 00 02 58 70
				15 01 00 00 00 00 02 59 70
				15 01 00 00 00 00 02 5A 70
				15 01 00 00 00 00 02 5B 70
				15 01 00 00 00 00 02 5C 60
				15 01 00 00 00 00 02 5D 60
				15 01 00 00 00 00 02 5E 60
				15 01 00 00 00 00 02 5F 60
				15 01 00 00 00 00 02 60 40
				15 01 00 00 00 00 02 61 40
				15 01 00 00 00 00 02 62 40
				15 01 00 00 00 00 02 63 40
				15 01 00 00 00 00 02 64 20
				15 01 00 00 00 00 02 65 20
				15 01 00 00 00 00 02 66 20
				15 01 00 00 00 00 02 67 20
				15 01 00 00 00 00 02 68 80
				15 01 00 00 00 00 02 69 80
				15 01 00 00 00 00 02 6A 60
				15 01 00 00 00 00 02 6B 60
				15 01 00 00 00 00 02 6C 30
				15 01 00 00 00 00 02 6D 30
				15 01 00 00 00 00 02 6E 30
				15 01 00 00 00 00 02 6F 30
				15 01 00 00 00 00 02 70 50
				15 01 00 00 00 00 02 71 50
				15 01 00 00 00 00 02 72 50
				15 01 00 00 00 00 02 73 50
				15 01 00 00 00 00 02 74 30
				15 01 00 00 00 00 02 75 30
				15 01 00 00 00 00 02 76 10
				15 01 00 00 00 00 02 77 00
				15 01 00 00 00 00 02 78 62
				15 01 00 00 00 00 02 79 42
				15 01 00 00 00 00 02 7A 04
				15 01 00 00 00 00 02 7B 04
				15 01 00 00 00 00 02 7C 40
				15 01 00 00 00 00 02 7D 40
				15 01 00 00 00 00 02 7E 00
				15 01 00 00 0A 00 02 7F 00
				39 01 00 00 00 00 06 FF FF 98 06 04 07
				15 01 00 00 00 00 02 17 22
				15 01 00 00 00 00 02 02 77
				15 01 00 00 00 00 02 E1 59
				15 01 00 00 0A 00 02 B3 10
				15 01 00 00 0A 00 02 00 11
				39 01 00 00 00 00 06 FF FF 98 06 04 00
				15 01 00 00 00 00 02 55 B0
				05 01 00 00 78 00 02 11 00
				05 01 00 00 0A 00 02 29 00
		];
		qcom,mdss-dsi-off-command = [
				05 01 00 00 32 00 01
				  28
				05 01 00 00 78 00 01
				  10
				];
	};
};

