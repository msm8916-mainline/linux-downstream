/* Copyright (c) 2012, Code Aurora Forum. All rights reserved.
 *
 * This program is free software; you can redistribute it and/or modify
 * it under the terms of the GNU General Public License version 2 and
 * only version 2 as published by the Free Software Foundation.
 *
 * This program is distributed in the hope that it will be useful,
 * but WITHOUT ANY WARRANTY; without even the implied warranty of
 * MERCHANTABILITY or FITNESS FOR A PARTICULAR PURPOSE.  See the
 * GNU General Public License for more details.
 */

&spi_0 {

    spi-max-frequency = <960000>;
	status = "disable";

	peel_ir_rev_a@0 {
		revision = "rev_a";
		status = "disable";
        compatible = "peel,peel_ir";
	    spi-max-frequency = <960000>;
	    reg = <0>;
		Peel,vdd_ana-supply = <&pm8916_l17>;
		vdd_ana_supply_min = <2850000>;
		vdd_ana_supply_max = <3300000>;
		vdd_ana_load_ua = <15000>;
	};

	peel_ir_rev_b@0 {
		revision = "rev_b...";
		status = "disable";
        compatible = "peel,peel_ir";
	    spi-max-frequency = <960000>;
	    reg = <0>;
		Peel,vdd_ana-supply = <&pm8916_l17>;
		vdd_ana_supply_min = <2850000>;
		vdd_ana_supply_max = <3300000>;
		vdd_ana_load_ua = <15000>;
	};

};
