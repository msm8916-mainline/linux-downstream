/* Copyright (c) 2012, Code Aurora Forum. All rights reserved.
 *
 * This program is free software; you can redistribute it and/or modify
 * it under the terms of the GNU General Public License version 2 and
 * only version 2 as published by the Free Software Foundation.
 *
 * This program is distributed in the hope that it will be useful,
 * but WITHOUT ANY WARRANTY; without even the implied warranty of
 * MERCHANTABILITY or FITNESS FOR A PARTICULAR PURPOSE.  See the
 * GNU General Public License for more details.
 */

&i2c_0{

	/* Proximity sensor */
	avago_apds9130@39 {
		compatible = "avago,apds9130";
		status ="ok";
		reg = <0x39>;
		interrupt-parent = <&msm_gpio>;
		interrupts = <113 0x2>;
		Avago,vdd_ana-supply = <&pm8916_l11_sns>;
		Avago,vddio_i2c-supply = <&pm8916_l6>;
		pinctrl-names = "default", "sleep";
		pinctrl-0 = <&apds9130_int_active>;
		pinctrl-1 = <&apds9130_int_suspend>;
		Avago,irq-gpio = <&msm_gpio 113 0x0>;
		Avago,i2c-pull-up;
		Avago,vdd_ana_supply_min = <2800000>;
		Avago,vdd_ana_supply_max = <2950000>;
		Avago,vdd_ana_load_ua = <15000>;
		Avago,vddio_dig_supply_min = <1800000>;
		Avago,vddio_dig_supply_max = <1800000>;
		Avago,vddio_dig_load_ua = <10000>;
		Avago,vddio_i2c_supply_min = <1800000>;
		Avago,vddio_i2c_supply_max = <1800000>;
		Avago,vddio_i2c_load_ua = <10000>;
		Avago,ppcount = <8>;
		Avago,pdrive = <0>;
		Avago,near_offset = <300>;
		Avago,far_offset = <100>;
		Avago,crosstalk_max = <720>;
		Avago,bright_threshold = <2000>;
		Avago,dark_threshold = <1000>;
	};
	k2hh@1e {
			status = "ok";
			reg = <0x1e>;
			compatible = "st,k2hh";
			interrupt-parent = <&msm_gpio>;
			interrupts = <115 0x0>;
			stm,sensor_vdd-supply = <&pm8916_l11_sns>;
			stm,sensor_vcc_i2c-supply = <&pm8916_l6>;
			pinctrl-names = "k2hh_int_active", "k2hh_int_suspend";
			pinctrl-0 = <&k2hh_int_active>;
			pinctrl-1 = <&k2hh_int_suspend>;
			st,gpio-int = <&msm_gpio 115 0x0>;
			axis_map_x = <1>;
			axis_map_y = <0>;
			axis_map_z = <2>;
			negate_x = <0>;
			negate_y = <1>;
			negate_z = <1>;
			poll_interval = <100>;
			min_interval = <9>;
			fs_range = <32>;
		};

};
