/* Copyright (c) 2013, Code Aurora Forum. All rights reserved.
 *
 * This program is free software; you can redistribute it and/or modify
 * it under the terms of the GNU General Public License version 2 and
 * only version 2 as published by the Free Software Foundation.
 *
 * This program is distributed in the hope that it will be useful,
 * but WITHOUT ANY WARRANTY; without even the implied warranty of
 * MERCHANTABILITY or FITNESS FOR A PARTICULAR PURPOSE.  See the
 * GNU General Public License for more details.
 */

#include "../msm8916-lge-common/dsi-panel-lgd-db7400-720p-video.dtsi"

&mdss_mdp {
       qcom,mdss-pref-prim-intf = "dsi";
       qcom,mdss-ab-factor = <1 1>;
       qcom,mdss-ib-factor = <2 1>;
};

&dsi_lgd_db7400_hd_incell_vid {
		lge,display_id = <0>;
		qcom,mdss-dsi-bl-pmic-control-type = "bl_ctrl_wled";
		qcom,mdss-dsi-h-front-porch = <72>;
		qcom,mdss-dsi-h-back-porch = <120>;//<80>;//<70>;//<88>;
		qcom,mdss-dsi-h-pulse-width = <4>;
		qcom,mdss-dsi-v-front-porch = <580>;//<550>;//<400>;//<7>;
		qcom,mdss-dsi-v-back-porch = <11>;//<417>;
		qcom,mdss-dsi-v-pulse-width = <1>;//<4>;
		qcom,mdss-pan-physical-width-dimension = < 71 >;
		qcom,mdss-pan-physical-height-dimension = < 126 >;
		/* DB7400 CUT5 Initial code start */
		qcom,mdss-dsi-on-command-cut5 = [
			15 01 00 00 00 00 02 /*address*/
			36 00

			15 01 00 00 00 00 02 /*manufacturer*/
			B0 00

			29 01 00 00 00 00 03 /*RGB interface*/
			B1 00 30

			29 01 00 00 00 00 07 /*module charateristic set*/
			B2 50 00 0C 00 00 00

			29 01 00 00 00 00 05 /*internal timgin set*/
			B3 4F 80 32 56

			29 01 00 00 00 00 07/*channel control*/
			B4 05 04 02 28 11 00

			29 01 00 00 00 00 34 /*GIP Control Set*/
			B5 19 04 1C 22 2F 80
			2F 1F 04 40 05 00 20
			09 04 40 05 00 A5 0D
			2F 28 3F FF 3F FF 01
			7C 00 02 50 23 40 15
			6C CB BA A9 97 8D 1F
			23 40 15 6C CB BA A9
			97 8D 1F

			29 01 00 00 00 00 03 /*touch enable*/
			B6 01 03

			29 01 00 00 00 00 04 /*gvddp*/
			B7 00 3C 3E

			29 01 00 00 00 00 03 /*vcom*/
			BA 00 43

			29 01 00 00 00 00 10 /*vghl*/
			BB 00 94 8B 00 00 00
			00 00 00 00 00 00 00
			00 13

			29 01 00 00 00 00 03
			BD 04 33

			15 01 00 00 00 00 02 /*vci1*/
			BE 44

			29 01 00 00 00 00 07 /*write dsi control*/
			95 00 08 10 00 00 00

			29 01 00 00 00 00 03 /*mipi parameter setting*/
			C6 0A 00

			29 01 00 00 00 00 02 /*add temp*/
			CF 0F

			29 01 00 00 00 00 1B /*touch gip control*/
			D7 01 13 FF 39 0B 04
			14 F4 01 00 00 00 00
			60 01 57 57 2F 28 28
			50 00 00 00 00 00

			29 01 00 00 00 00 06
			F5 00 06 00 00 80

			29 01 00 00 00 00 02 /*vdd1 regulator*/
			F6 06

			29 01 00 00 00 00 04/*sharpness enhance*/
			81 18 34 00

			29 01 00 00 00 00 22/*contrast enhance*/
			83 10 00 07 0F 17 1F
			27 2F 37 3F 47 4F 57
			5F 67 6F 77 7F 87 8F
			97 9F A7 AF B7 BF C7
			CF D7 DF E7 EF F5

			29 01 00 00 00 00 24/*power sequence control*/
			F0 18 00 00 14 00 00
			00 01 00 03 2B 01 02
			53 58 5D 62 A6 AB B0
			B0 B0 AF B0 AD 85 B0
			B0 5D 58 53 4E 0A 05
			00

			29 01 00 00 00 00 0A /*pos gamma curve red*/
			D0 52 04 74 03 00 00
			42 01 02

			29 01 00 00 00 00 0A /*neg gamma curve red*/
			D1 41 03 75 02 00 00
			42 12 01

			29 01 00 00 00 00 0A /*pos gamma curve green*/
			D2 43 04 74 03 00 00
			42 01 02

			29 01 00 00 00 00 0A /*neg gamma curve green*/
			D3 32 03 75 02 00 00
			42 12 01

			29 01 00 00 00 00 0A /*pos gamma curve blue*/
			D4 52 04 74 03 00 00
			42 01 02

			29 01 00 00 3C 00 0A /*neg gamma curve blue*/
			D5 41 03 75 02 00 00
			42 12 01

			05 01 00 00 A0 00 01 /*exit sleep*/
			11

			05 01 00 00 28 00 01 /*display on*/
			29

		];

		qcom,mdss-dsi-off-command1-cut5 = [
			05 01 00 00 28 00 01 /*display off*/
			28
			05 01 00 00 28 00 01 /*Sleep in*/
			10
		];
		qcom,mdss-dsi-off-command2-cut5 = [
			29 01 00 00 00 00 1C /*34->1C GIP Control Set*/
			B5 19 04 1C 22 2F 80
			2F 1F 04 40 05 00 20
			09 04 40 05 00 A5 0D
			2F 1F 04 00 04 00 00
			29 01 00 00 00 00 03 /*touch enable*/
			B6 01 01

			29 01 00 00 00 00 02 /*add temp*/
			CF 07

			29 01 00 00 00 00 1B /*touch gip control*/
			D7 01 13 FF 39 0B 04
			14 F4 01 00 00 00 00
			40 01 67 67 47 10 10
			34 00 00 00 00 00

			29 01 00 00 00 00 06/*Touch LFD Control set*/
			F5 00 06 00 00 C0

			29 01 00 00 5A 00 03 /*mipi lane floating*/
			C8 01 00
		];
		/* DB7400 CUT5 initial code end */

		/* DB7400 CUT6 initial code start */
		qcom,mdss-dsi-on-command-cut6 = [
			15 01 00 00 00 00 02 /*address*/
			36 00

			15 01 00 00 00 00 02 /*manufacturer*/
			B0 00

			29 01 00 00 00 00 03 /*RGB interface*/
			B1 00 30

			29 01 00 00 00 00 07 /*module charateristic set*/
			B2 50 00 0C 00 00 00

			29 01 00 00 00 00 05 /*internal timgin set*/
			B3 4F 80 32 56

			29 01 00 00 00 00 07/*channel control*/
			B4 05 04 0A 00 11 00

			29 01 00 00 00 00 37 /*GIP Control Set*/
			B5 19 04 1C 22 2F 80
			2F 1F 04 40 05 05 00
			20 09 04 40 05 05 00
			A5 0D 2F 28 3F FF 3F
			FF 01 7C 00 03 78 23
			40 15 6C CB BA A9 97
			8D 1F 23 40 15 6C CB
			BA A9 97 8D 1F 00

			29 01 00 00 00 00 03 /*touch enable*/
			B6 01 01

			29 01 00 00 00 00 04 /*gvddp*/
			B7 00 3C 3E

			29 01 00 00 00 00 03 /*vcom*/
			BA 00 43

			29 01 00 00 00 00 10 /*vghl*/
			BB 00 94 8B 00 00 00
			00 00 00 00 00 00 00
			00 13

			29 01 00 00 00 00 03 /*Bias current*/
			BD 04 33

			15 01 00 00 00 00 02 /*vci1*/
			BE 44

			29 01 00 00 00 00 07 /*write dsi control*/
			95 00 08 10 00 00 00

			29 01 00 00 00 00 03 /*mipi parameter setting*/
			C6 08 00

			29 01 00 00 00 00 02 /*add temp*/
			CF 07

			29 01 00 00 00 00 1B /*touch gip control*/
			D7 00 03 FF 00 00 04
			14 CC 01 00 00 00 00
			40 01 57 57 16 28 28
			69 00 00 00 00 00

			15 01 00 00 00 00 02 /*Contrast of*/
			83 00

			39 01 00 00 00 00 2F /*ief 1*/
			77 03 00 00 00 11 05
			10 d1 0b 20 ee 05 20
			b2 18 30 11 05 50 d1
			0b 60 b2 18 70 b2 18
			70 b2 18 70 b2 18 70
			b2 18 70 b2 18 70 b2
			18 70 b2 18 70

			39 01 00 00 00 00 42 /*ief 2*/
			78 25 29 ff fd e1 5f
			91 fe db ff fb 2d 01
			25 81 3e 03 e0 bf 10
			03 d8 1f 09 c3 00 1d
			71 ff fd db 8f 91 fe
			77 e0 f6 2d 01 25 29
			ff fd e1 5f 91 fe db
			ff fb 2d 01 25 29 ff
			fd e1 5f 91 fe db ff
			fb 2d 01

			39 01 00 00 00 00 42 /*ief 3*/
			79 25 29 ff fd e1 5f
			91 fe db ff fb 2d 01
			25 29 ff fd e1 5f 91
			fe db ff fb 2d 01 25
			29 ff fd e1 5f 91 fe
			db ff fb 2d 01 25 29
			ff fd e1 5f 91 fe db
			ff fb 2d 01 25 29 ff
			fd e1 5f 91 fe db ff
			fb 2d 01

			39 01 00 00 00 00 46 /*ief 4*/
			7a 25 29 ff fd e1 5f
			91 fe db ff fb 2d 01
			25 29 ff fd e1 5f 91
			fe db ff fb 2d 01 25
			29 ff fd e1 5f 91 fe
			db ff fb 2d 01 25 29
			ff fd e1 5f 91 fe db
			ff fb 2d 01 00 00 00
			00 00 00 00 00 00 00
			00 00 00 80 00 00 00

			29 01 00 00 00 00 06 /*DB Check need*/
			F5 00 06 00 00 80

			29 01 00 00 00 00 02 /*vdd1 regulator*/
			F6 06

			29 01 00 00 00 00 24/*power sequence control*/
			F0 18 00 00 14 00 00
			00 01 00 03 2B 01 02
			53 58 5D 62 A6 AB B0
			B0 B0 AF B0 AD 85 B0
			B0 5D 58 53 4E 0A 05
			00

			29 01 00 00 00 00 0A /*pos gamma curve red*/
			D0 52 04 74 03 00 00
			42 01 02

			29 01 00 00 00 00 0A /*neg gamma curve red*/
			D1 41 03 75 02 00 00
			42 12 01

			29 01 00 00 00 00 0A /*pos gamma curve green*/
			D2 43 04 74 03 00 00
			42 01 02

			29 01 00 00 00 00 0A /*neg gamma curve green*/
			D3 32 03 75 02 00 00
			42 12 01

			29 01 00 00 00 00 0A /*pos gamma curve blue*/
			D4 52 04 74 03 00 00
			42 01 02

			29 01 00 00 3C 00 0A /*neg gamma curve blue*/
			D5 41 03 75 02 00 00
			42 12 01

			05 01 00 00 0B 00 01 /*exit sleep*/
			11

			05 01 00 00 78 00 01 /*display on*/
			29

		];
		qcom,mdss-dsi-off-command1-cut6 = [
			05 01 00 00 28 00 01 /*display off*/
			28
			05 01 00 00 28 00 01 /*Sleep in*/
			10
		];
		qcom,mdss-dsi-off-command2-cut6 = [
			29 01 00 00 00 00 1E /*34->1C GIP Control Set*/
			B5 19 04 1C 22 2F 80
			2F 1F 04 40 05 05 00
			20 09 04 40 05 05 00
			A5 0D 2F 1F 04 00 04
			00 00

			29 01 00 00 00 00 06/*Touch LFD Control set*/
			F5 00 06 00 00 C0

			29 01 00 00 5A 00 03 /*mipi lane floating*/
			C8 01 00
		];
		/* DB7400 CUT6 initial code end */

		/* DB7400 CUT7 initial code start */
		qcom,mdss-dsi-on-command = [
			15 01 00 00 00 00 02 /*address*/
			36 00

			15 01 00 00 00 00 02 /*manufacturer*/
			B0 00

			29 01 00 00 00 00 03 /*RGB interface*/
			B1 00 30

			29 01 00 00 00 00 07 /*module charateristic set*/
			B2 50 00 0C 00 00 00

			29 01 00 00 00 00 05 /*internal timgin set*/
			B3 4F 80 32 56

			29 01 00 00 00 00 07/*channel control*/
			B4 05 04 0A 00 11 00

			29 01 00 00 00 00 37 /*GIP Control Set*/
			B5 19 04 1C 22 2F 80
			2F 1F 04 40 05 05 00
			20 09 04 40 05 05 00
			A5 0D 2F 28 3F FF 3F
			FF 01 7C 00 03 78 23
			40 15 6C CB BA A9 97
			8D 1F 23 40 15 6C CB
			BA A9 97 8D 1F 00

			29 01 00 00 00 00 03 /*touch enable*/
			B6 01 01

			29 01 00 00 00 00 04 /*gvddp*/
			B7 00 3C 3E

			29 01 00 00 00 00 03 /*vcom*/
			BA 00 43

			29 01 00 00 00 00 10 /*vghl*/
			BB 00 94 8B 00 00 00
			00 00 00 00 00 00 00
			00 13

			29 01 00 00 00 00 03 /*Bias current*/
			BD 04 33

			15 01 00 00 00 00 02 /*vci1*/
			BE 44

			29 01 00 00 00 00 07 /*write dsi control*/
			95 00 08 10 00 00 00

			29 01 00 00 00 00 03 /*mipi parameter setting*/
			C6 08 00

			29 01 00 00 00 00 02 /*add temp*/
			CF 07

			29 01 00 00 00 00 1B /*touch gip control*/
			D7 00 03 FF 00 00 04
			14 CC 01 00 00 00 00
			40 01 57 57 16 28 28
			69 00 00 00 00 00

			15 01 00 00 00 00 02 /*Contrast of*/
			83 00

			39 01 00 00 00 00 2F /*ief 1*/
			77 03 00 00 00 11 05
			10 d1 0b 20 ee 05 20
			b2 18 30 11 05 50 d1
			0b 60 b2 18 70 b2 18
			70 b2 18 70 b2 18 70
			b2 18 70 b2 18 70 b2
			18 70 b2 18 70

			39 01 00 00 00 00 42 /*ief 2*/
			78 25 29 ff fd e1 5f
			91 fe db ff fb 2d 01
			25 81 3e 03 e0 bf 10
			03 d8 1f 09 c3 00 1d
			71 ff fd db 8f 91 fe
			77 e0 f6 2d 01 25 29
			ff fd e1 5f 91 fe db
			ff fb 2d 01 25 29 ff
			fd e1 5f 91 fe db ff
			fb 2d 01

			39 01 00 00 00 00 42 /*ief 3*/
			79 25 29 ff fd e1 5f
			91 fe db ff fb 2d 01
			25 29 ff fd e1 5f 91
			fe db ff fb 2d 01 25
			29 ff fd e1 5f 91 fe
			db ff fb 2d 01 25 29
			ff fd e1 5f 91 fe db
			ff fb 2d 01 25 29 ff
			fd e1 5f 91 fe db ff
			fb 2d 01

			39 01 00 00 00 00 46 /*ief 4*/
			7a 25 29 ff fd e1 5f
			91 fe db ff fb 2d 01
			25 29 ff fd e1 5f 91
			fe db ff fb 2d 01 25
			29 ff fd e1 5f 91 fe
			db ff fb 2d 01 25 29
			ff fd e1 5f 91 fe db
			ff fb 2d 01 00 00 00
			00 00 00 00 00 00 00
			00 00 00 80 00 00 00

			29 01 00 00 00 00 06 /*DB Check need*/
			F5 00 06 00 00 80

			29 01 00 00 00 00 02 /*vdd1 regulator*/
			F6 06

			29 01 00 00 00 00 24/*power sequence control*/
			F0 18 00 00 14 00 00
			00 01 00 03 2B 01 02
			53 58 5D 62 A6 AB B0
			B0 B0 AF B0 AD 85 B0
			B0 5D 58 53 4E 0A 05
			00

			29 01 00 00 00 00 0A /*pos gamma curve red*/
			D0 52 04 74 03 00 00
			42 01 02

			29 01 00 00 00 00 0A /*neg gamma curve red*/
			D1 41 03 75 02 00 00
			42 12 01

			29 01 00 00 00 00 0A /*pos gamma curve green*/
			D2 43 04 74 03 00 00
			42 01 02

			29 01 00 00 00 00 0A /*neg gamma curve green*/
			D3 32 03 75 02 00 00
			42 12 01

			29 01 00 00 00 00 0A /*pos gamma curve blue*/
			D4 52 04 74 03 00 00
			42 01 02

			29 01 00 00 3C 00 0A /*neg gamma curve blue*/
			D5 41 03 75 02 00 00
			42 12 01

			05 01 00 00 0B 00 01 /*exit sleep*/
			11

			05 01 00 00 78 00 01 /*display on*/
			29

		];
		qcom,mdss-dsi-off-command1 = [
			05 01 00 00 28 00 01 /*display off*/
			28
			05 01 00 00 28 00 01 /*Sleep in*/
			10
		];
		qcom,mdss-dsi-off-command2 = [
			29 01 00 00 00 00 1E /*34->1C GIP Control Set*/
			B5 19 04 1C 22 2F 80
			2F 1F 04 40 05 05 00
			20 09 04 40 05 05 00
			A5 0D 2F 1F 04 00 04
			00 00

			29 01 00 00 00 00 06/*Touch LFD Control set*/
			F5 00 06 00 00 C0

			29 01 00 00 5A 00 03 /*mipi lane floating*/
			C8 01 00
		];
		/* DB7400 CUT7 initial code end */

		qcom,mdss-dsi-panel-timings = [A8 26 1A 00 50 4A 28 2A 3E 03 04 00];
		qcom,mdss-dsi-t-clk-post = <0x03>;
		qcom,mdss-dsi-t-clk-pre = <0x24>;

};

&mdss_dsi0 {
       qcom,dsi-pref-prim-pan = <&dsi_lgd_db7400_hd_incell_vid>;

       qcom,platform-lcd-ldo-1v8-gpio = <&msm_gpio 33 0>;
       qcom,platform-reset-gpio = <&msm_gpio 25 0>;
	   qcom,platform-t_reset-gpio = <&msm_gpio 12 0>;
       qcom,regulator-ldo-mode;
       qcom,platform-regulator-settings = [02 09 03 00 20 00 01];
};


