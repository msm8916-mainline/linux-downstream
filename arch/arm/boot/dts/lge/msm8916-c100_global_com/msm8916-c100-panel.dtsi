/* Copyright (c) 2013, Code Aurora Forum. All rights reserved.
 *
 * This program is free software; you can redistribute it and/or modify
 * it under the terms of the GNU General Public License version 2 and
 * only version 2 as published by the Free Software Foundation.
 *
 * This program is distributed in the hope that it will be useful,
 * but WITHOUT ANY WARRANTY; without even the implied warranty of
 * MERCHANTABILITY or FITNESS FOR A PARTICULAR PURPOSE.  See the
 * GNU General Public License for more details.
 */

#include "../msm8916-lge-common/dsi-panel-lgd-db7400-720p-video.dtsi"

&mdss_mdp {
       qcom,mdss-pref-prim-intf = "dsi";
       qcom,mdss-ab-factor = <1 1>;
       qcom,mdss-ib-factor = <2 1>;
};

&dsi_lgd_db7400_hd_incell_vid {
	qcom,mdss-dsi-on-command = [
			15 01 00 00 00 00 02 /*address*/
			36 00

			15 01 00 00 00 00 02 /*manufacturer*/
			B0 00

			29 01 00 00 00 00 03 /*RGB interface*/
			B1 00 46

			29 01 00 00 00 00 07 /*module charateristic set*/
			B2 50 00 0B 00 00 00

			29 01 00 00 00 00 05 /*internal timgin set*/
			B3 4F 80 0A 28

			29 01 00 00 00 00 07/*channel control*/
			B4 05 0C 1F 40 11 00

			29 01 00 00 00 00 34 /*GIP Control Set*/
			B5 19 04 1C 22 2F 80
			2F 1F 02 20 05 00 10
			08 02 20 05 00 95 0C
			2F 2F 3F FF 3F FF 01
			7C 00 02 50 23 40 15
			6C CB BA A9 97 8D 1F
			23 40 15 6C CB BA A9
			97 8D 1F

			29 01 00 00 00 00 03 /*touch enable*/
			B6 01 01

			29 01 00 00 00 00 04 /*gvddp*/
			B7 00 37 38

			29 01 00 00 00 00 04 /*vcom*/
			BA 00 58 58

			29 01 00 00 00 00 10 /*vghl*/
			BB 00 9A 94 30 30 00
			00 00 00 00 00 00 00
			00 13

			15 01 00 00 00 00 02 /*vci1*/
			BE 03

			29 01 00 00 00 00 03 /*SAP*/
			BD 03 33

			29 01 00 00 00 00 07 /*write dsi control*/
			95 00 08 10 00 00 00
			
			29 01 00 00 00 00 03 /*mipi parameter setting*/
			C6 0A 00
			
			29 01 00 00 00 00 02 /*add temp*/
			CF 07

			29 01 00 00 00 00 1B /*touch gip control*/
			D7 01 13 FF 39 0B 04
			14 F4 01 00 00 00 00
			40 01 5F 5F 47 14 14
			29 00 00 00 00 00

			29 01 00 00 00 00 24/*power sequence control*/
			F0 18 00 00 14 00 00
			00 01 00 03 2B 01 02
			53 58 5D 62 A6 AB B0
			B0 B0 AF B0 AD 85 B0
			B0 5D 58 53 4E 0A 05
			00

			29 01 00 00 00 00 0A /*pos gamma curve red*/
			D0 04 64 40 26 06 00
			34 26 02

			29 01 00 00 00 00 0A /*neg gamma curve red*/
			D1 04 64 40 26 0E 00
			34 26 02

			29 01 00 00 00 00 0A /*pos gamma curve green*/
			D2 04 64 40 26 06 00
			34 26 02

			29 01 00 00 00 00 0A /*neg gamma curve green*/
			D3 04 64 40 26 0E 00
			34 26 02

			29 01 00 00 00 00 0A /*pos gamma curve blue*/
			D4 04 64 40 26 06 00
			31 26 02

			29 01 00 00 00 00 0A /*neg gamma curve blue*/
			D5 04 64 40 26 0E 00
			31 26 02

			29 01 00 00 00 00 05 /*pos gamma curve red*/
			D0 04 64 40 26

			29 01 00 00 00 00 05 /*neg gamma curve red*/
			D1 04 64 40 26

			29 01 00 00 00 00 05 /*pos gamma curve green*/
			D2 04 64 40 26

			29 01 00 00 00 00 05 /*neg gamma curve green*/
			D3 04 64 40 26

			29 01 00 00 00 00 05 /*pos gamma curve blue*/
			D4 04 64 40 26

			29 01 00 00 00 00 05 /*neg gamma curve blue*/
			D5 04 64 40 26

			29 01 00 00 00 00 1A    /*Color En*/
			85 11 6E 22 5A 19 44
			28 7F 4D AD 85 62 A2
			9B 8C 65 51 97 60 B0
			9C 65 51 A5 62

			29 01 00 00 00 00 02 /*VDD1 control 1.25V -> 1.27V*/
			F6 06

			05 01 00 00 50 00 01 /*exit sleep 120msec -> 80msec*/
			11
			
			05 01 00 00 00 00 01 /*display on*/
			29
		];
		qcom,mdss-dsi-h-sync-pulse = <1>;
		qcom,mdss-dsi-traffic-mode = "non_burst_sync_pulse";
		qcom,mdss-dsi-tx-eot-append;
       qcom,mdss-dsi-bl-pmic-control-type = "bl_ctrl_wled";
};

&mdss_dsi0 {
       qcom,dsi-pref-prim-pan = <&dsi_lgd_db7400_hd_incell_vid>;
       pinctrl-names = "mdss_default", "mdss_sleep";
       pinctrl-0 = <&mdss_dsi_active>;
       pinctrl-1 = <&mdss_dsi_suspend>;

       qcom,platform-dsv_p_en-gpio = <&msm_gpio 110 0>;
       qcom,platform-dsv_n_en-gpio = <&msm_gpio 112 0>;
       qcom,platform-lcd-ldo-3v0-gpio = <&msm_gpio 34 0>;
       qcom,platform-lcd-ldo-1v8-gpio = <&msm_gpio 33 0>;

       qcom,platform-reset-gpio = <&msm_gpio 25 0>;
       qcom,regulator-ldo-mode;
       qcom,platform-regulator-settings = [02 09 03 00 20 00 01];

};


