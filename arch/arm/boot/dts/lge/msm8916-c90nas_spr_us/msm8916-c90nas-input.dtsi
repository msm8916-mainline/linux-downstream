/* Copyright (c) 2012, Code Aurora Forum. All rights reserved.
 *
 * This program is free software; you can redistribute it and/or modify
 * it under the terms of the GNU General Public License version 2 and
 * only version 2 as published by the Free Software Foundation.
 *
 * This program is distributed in the hope that it will be useful,
 * but WITHOUT ANY WARRANTY; without even the implied warranty of
 * MERCHANTABILITY or FITNESS FOR A PARTICULAR PURPOSE.  See the
 * GNU General Public License for more details.
 */
&i2c_5 { /* BLSP1 QUP5 */
	qcom,clk-freq-out = <400000>;

	synaptics_s3320@20 {
			compatible = "unified_driver,ver2";
			status = "ok";
			revision = "rev_a...";

			fw_image = "synaptics/c90nas_spr_us/PLG465-V1.02-PR1781398-DS5.2.12.0.13-40050182.img";

	};
};
