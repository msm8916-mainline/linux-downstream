/* Copyright (c) 2012, Code Aurora Forum. All rights reserved.
 *
 * This program is free software; you can redistribute it and/or modify
* it under the terms of the GNU General Public License version 2 and
* only version 2 as published by the Free Software Foundation.
*
* This program is distributed in the hope that it will be useful,
* but WITHOUT ANY WARRANTY; without even the implied warranty of
* MERCHANTABILITY or FITNESS FOR A PARTICULAR PURPOSE.  See the
* GNU General Public License for more details.
*/

&usb_otg {
	qcom,hsusb-otg-mode = <3>;
	qcom,hsusb-otg-otg-control = <2>;
	qcom,usbid-gpio = <&msm_gpio 110 0>;
	qcom,msm_otg-adc_tm = <&pm8916_adc_tm>;
	lge,hsusb-otg-adc-low-threshold = <20>;
	lge,hsusb-otg-adc-high-threshold = <30>;
	qcom,phy-vadc = <&pm8916_vadc>;
};
