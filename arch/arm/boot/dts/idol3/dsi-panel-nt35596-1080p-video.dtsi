/* Copyright (c) 2013-2014, The Linux Foundation. All rights reserved.
 *
 * This program is free software; you can redistribute it and/or modify
 * it under the terms of the GNU General Public License version 2 and
 * only version 2 as published by the Free Software Foundation.
 *
 * This program is distributed in the hope that it will be useful,
 * but WITHOUT ANY WARRANTY; without even the implied warranty of
 * MERCHANTABILITY or FITNESS FOR A PARTICULAR PURPOSE.  See the
 * GNU General Public License for more details.
 */

/*---------------------------------------------------------------------------
 * This file is autogenerated file using gcdb parser. Please do not edit it.
 * Update input XML file to add a new entry or update variable in this file
 * VERSION = "1.0"
 *---------------------------------------------------------------------------*/
 
&mdss_mdp {
	dsi_nt35596_1080p_vid: qcom,mdss_dsi_nt35596_1080p_video{
		compatible = "qcom,mdss-dsi-panel";
		status = "disable";
		qcom,mdss-dsi-panel-name = "nt35596 1080p videomode panel";
		qcom,mdss-dsi-panel-controller = <&mdss_dsi0>;
		qcom,mdss-dsi-panel-type = "dsi_video_mode";
		qcom,mdss-dsi-panel-destination = "display_1";
		qcom,mdss-dsi-pixel-packing = <0>; /* used for 16bit mode*/
        	qcom,mdss-dsi-panel-framerate = <60>;
        	qcom,mdss-dsi-virtual-channel-id = <0>;
		qcom,mdss-dsi-stream = <0>;
		qcom,mdss-dsi-panel-width = <1080>;
		qcom,mdss-dsi-panel-height = <1920>;
		qcom,mdss-dsi-h-front-porch = <100>;
		qcom,mdss-dsi-h-back-porch = <96>;
		qcom,mdss-dsi-h-pulse-width = <20>;
		qcom,mdss-dsi-h-sync-skew = <0>;
		qcom,mdss-dsi-v-back-porch = <7>;
		qcom,mdss-dsi-v-front-porch = <2>;
		qcom,mdss-dsi-v-pulse-width = <5>;
		qcom,mdss-dsi-h-left-border = <0>;
		qcom,mdss-dsi-h-right-border = <0>;
		qcom,mdss-dsi-v-top-border = <0>;
		qcom,mdss-dsi-v-bottom-border = <0>;
		qcom,mdss-pan-physical-width-dimension = <68>;
		qcom,mdss-pan-physical-height-dimension = <121>;
		qcom,mdss-dsi-bpp = <24>;
		qcom,mdss-dsi-color-order = "rgb_swap_rgb";
		qcom,mdss-dsi-underflow-color = <0xff>;
		qcom,mdss-dsi-border-color = <0>;
		qcom,mdss-dsi-reset-command = [
            	05 01 00 00 78 00 02 11 00
            	05 01 00 00 14 00 02 29 00
            	05 01 00 00 14 00 02 38 00
        	];
		qcom,mdss-dsi-on-command = [
		//CMD2 P4		       
		15 01 00 00 01 00 02 FF 05
		//ccmon        
		15 01 00 00 00 00 02 90 00          
		//FP/BP
		15 01 00 00 00 00 02 93 04
		15 01 00 00 00 00 02 94 04
		15 01 00 00 00 00 02 9B 0F
		15 01 00 00 00 00 02 A4 0F        
		15 01 00 00 00 00 02 91 44
		15 01 00 00 00 00 02 92 79
           
		//PIN MAP
		15 01 00 00 00 00 02 00 0F
		15 01 00 00 00 00 02 01 00
		15 01 00 00 00 00 02 02 00
		15 01 00 00 00 00 02 03 00
		15 01 00 00 00 00 02 04 0B
		15 01 00 00 00 00 02 05 0C
		15 01 00 00 00 00 02 06 00
		15 01 00 00 00 00 02 07 00
		15 01 00 00 00 00 02 08 00
		15 01 00 00 00 00 02 09 00
		15 01 00 00 00 00 02 0A 03
		15 01 00 00 00 00 02 0B 04
		15 01 00 00 00 00 02 0C 01
		15 01 00 00 00 00 02 0D 13
		15 01 00 00 00 00 02 0E 15
		15 01 00 00 00 00 02 0F 17
		15 01 00 00 00 00 02 10 0F
		15 01 00 00 00 00 02 11 00
		15 01 00 00 00 00 02 12 00
		15 01 00 00 00 00 02 13 00
		15 01 00 00 00 00 02 14 0B
		15 01 00 00 00 00 02 15 0C
		15 01 00 00 00 00 02 16 00
		15 01 00 00 00 00 02 17 00
		15 01 00 00 00 00 02 18 00
		15 01 00 00 00 00 02 19 00
		15 01 00 00 00 00 02 1A 03
		15 01 00 00 00 00 02 1B 04
		15 01 00 00 00 00 02 1C 01
		15 01 00 00 00 00 02 1D 13
		15 01 00 00 00 00 02 1E 15
		15 01 00 00 00 00 02 1F 17
		//STV		       
		15 01 00 00 00 00 02 20 09                              
		15 01 00 00 00 00 02 21 01                              
		15 01 00 00 00 00 02 22 00                              
		15 01 00 00 00 00 02 23 00                              
		15 01 00 00 00 00 02 24 00                              
		15 01 00 00 00 00 02 25 6D 
		//GCK1,2		       
		15 01 00 00 00 00 02 2F 02                              
		15 01 00 00 00 00 02 30 04                              
		15 01 00 00 00 00 02 31 49                              
		15 01 00 00 00 00 02 32 23                              
		15 01 00 00 00 00 02 33 01                              
		15 01 00 00 00 00 02 34 00                              
		15 01 00 00 00 00 02 35 69                             
		15 01 00 00 00 00 02 36 00                              
		15 01 00 00 00 00 02 37 2D                              
		15 01 00 00 00 00 02 38 08 
		//U2D,D2U		       
		15 01 00 00 00 00 02 29 58
		15 01 00 00 00 00 02 2A 16
		15 01 00 00 00 00 02 2B 0A	       
		15 01 00 00 00 00 02 5B 00
		15 01 00 00 00 00 02 5F 75
		15 01 00 00 00 00 02 63 00
		15 01 00 00 00 00 02 67 04
		15 01 00 00 00 00 02 6C 00       
		15 01 00 00 00 00 02 5C 2C
		15 01 00 00 00 00 02 60 75
		15 01 00 00 00 00 02 64 00
		15 01 00 00 00 00 02 68 04
		15 01 00 00 00 00 02 6C 10
		15 01 00 00 00 00 02 5D 00
		15 01 00 00 00 00 02 61 75
		15 01 00 00 00 00 02 65 00
		15 01 00 00 00 00 02 69 04
		15 01 00 00 00 00 02 6C 00
		15 01 00 00 00 00 02 6C 10
		15 01 00 00 00 00 02 7A 01
		//MUX dummy
		15 01 00 00 00 00 02 7B 80
		15 01 00 00 00 00 02 7C D8
		15 01 00 00 00 00 02 7D 60
		15 01 00 00 00 00 02 7E 07
		15 01 00 00 00 00 02 7F 17
		15 01 00 00 00 00 02 80 00
		15 01 00 00 00 00 02 81 05
		15 01 00 00 00 00 02 82 02
		15 01 00 00 00 00 02 83 00
		15 01 00 00 00 00 02 84 05
		15 01 00 00 00 00 02 85 05
		15 01 00 00 00 00 02 86 1B
		15 01 00 00 00 00 02 87 1B
		15 01 00 00 00 00 02 88 1B
		15 01 00 00 00 00 02 89 1B
		15 01 00 00 00 00 02 8A 33
		15 01 00 00 00 00 02 8B 00
		15 01 00 00 00 00 02 8C 00
		15 01 00 00 00 00 02 73 D0
		15 01 00 00 00 00 02 74 0D
		15 01 00 00 00 00 02 75 03
		15 01 00 00 00 00 02 76 16
		15 01 00 00 00 00 02 99 33
		15 01 00 00 00 00 02 98 00
		//ccmoff
		//ccmrun

	//*******************************************************************
		//Power Related
		15 01 00 00 01 00 02 FF 01
                15 01 00 00 00 00 02 FB 01
		//ccmon
		//Normal Black Panel
		15 01 00 00 00 00 02 00 01

		//PUMP VGH=2xAVDD, VGL=2AVEE
		15 01 00 00 00 00 02 05 50 

		//EN_PRE_REG -->Disable
		15 01 00 00 00 00 02 06 0A

		//Enable VGH/VGL clamp function, and Set VGH=9V, VGL=-9V A8 B2
		15 01 00 00 00 00 02 14 9E
		15 01 00 00 00 00 02 07 a8

		//Gamma Voltage Setting GVDDP=4.6V, GVDDN=-4.6V
		15 01 00 00 00 00 02 0B AF
		15 01 00 00 00 00 02 0C AF

		//VCOM setting, 
		15 01 00 00 00 00 02 11 21
		15 01 00 00 00 00 02 12 21

		//AVDDR/AVEER Setting (+/- 4.8V)
		15 01 00 00 00 00 02 08 0C
		15 01 00 00 00 00 02 15 13
		15 01 00 00 00 00 02 16 13

		//ISOP
		15 01 00 00 00 00 02 6D 44
		15 01 00 00 01 00 02 FF E0
		15 01 00 00 00 00 02 46 63
		15 01 00 00 00 00 02 FB 01

		//page selection cmd start
		15 01 00 00 00 00 02 FF 01
		15 01 00 00 00 00 02 FB 01
		//page selection cmd end
		//R(+) MCR cmd
		15 01 00 00 00 00 02 75 00
		15 01 00 00 00 00 02 76 00
		15 01 00 00 00 00 02 77 00
		15 01 00 00 00 00 02 78 0B
		15 01 00 00 00 00 02 79 00
		15 01 00 00 00 00 02 7A 59
		15 01 00 00 00 00 02 7B 00
		15 01 00 00 00 00 02 7C 88
		15 01 00 00 00 00 02 7D 00
		15 01 00 00 00 00 02 7E A5
		15 01 00 00 00 00 02 7F 00
		15 01 00 00 00 00 02 80 BD
		15 01 00 00 00 00 02 81 00
		15 01 00 00 00 00 02 82 D2
		15 01 00 00 00 00 02 83 00
		15 01 00 00 00 00 02 84 E2
		15 01 00 00 00 00 02 85 00
		15 01 00 00 00 00 02 86 F2
		15 01 00 00 00 00 02 87 01
		15 01 00 00 00 00 02 88 24
		15 01 00 00 00 00 02 89 01
		15 01 00 00 00 00 02 8A 4B
		15 01 00 00 00 00 02 8B 01
		15 01 00 00 00 00 02 8C 86
		15 01 00 00 00 00 02 8D 01
		15 01 00 00 00 00 02 8E B3
		15 01 00 00 00 00 02 8F 01
		15 01 00 00 00 00 02 90 FA
		15 01 00 00 00 00 02 91 02
		15 01 00 00 00 00 02 92 30
		15 01 00 00 00 00 02 93 02
		15 01 00 00 00 00 02 94 31
		15 01 00 00 00 00 02 95 02
		15 01 00 00 00 00 02 96 62
		15 01 00 00 00 00 02 97 02
		15 01 00 00 00 00 02 98 94
		15 01 00 00 00 00 02 99 02
		15 01 00 00 00 00 02 9A B5
		15 01 00 00 00 00 02 9B 02
		15 01 00 00 00 00 02 9C E1
		15 01 00 00 00 00 02 9D 03
		15 01 00 00 00 00 02 9E 00
		15 01 00 00 00 00 02 9F 03
		15 01 00 00 00 00 02 A0 2B
		15 01 00 00 00 00 02 A2 03
		15 01 00 00 00 00 02 A3 38
		15 01 00 00 00 00 02 A4 03
		15 01 00 00 00 00 02 A5 47
		15 01 00 00 00 00 02 A6 03
		15 01 00 00 00 00 02 A7 59
		15 01 00 00 00 00 02 A9 03
		15 01 00 00 00 00 02 AA 6D
		15 01 00 00 00 00 02 AB 03
		15 01 00 00 00 00 02 AC 86
		15 01 00 00 00 00 02 AD 03
		15 01 00 00 00 00 02 AE A4
		15 01 00 00 00 00 02 AF 03
		15 01 00 00 00 00 02 B0 E1
		15 01 00 00 00 00 02 B1 03
		15 01 00 00 00 00 02 B2 FF
		//R(-) MCR cmd
		15 01 00 00 00 00 02 B3 00
		15 01 00 00 00 00 02 B4 00
		15 01 00 00 00 00 02 B5 00
		15 01 00 00 00 00 02 B6 0B
		15 01 00 00 00 00 02 B7 00
		15 01 00 00 00 00 02 B8 59
		15 01 00 00 00 00 02 B9 00
		15 01 00 00 00 00 02 BA 88
		15 01 00 00 00 00 02 BB 00
		15 01 00 00 00 00 02 BC A5
		15 01 00 00 00 00 02 BD 00
		15 01 00 00 00 00 02 BE BD
		15 01 00 00 00 00 02 BF 00
		15 01 00 00 00 00 02 C0 D2
		15 01 00 00 00 00 02 C1 00
		15 01 00 00 00 00 02 C2 E2
		15 01 00 00 00 00 02 C3 00
		15 01 00 00 00 00 02 C4 F2
		15 01 00 00 00 00 02 C5 01
		15 01 00 00 00 00 02 C6 24
		15 01 00 00 00 00 02 C7 01
		15 01 00 00 00 00 02 C8 4B
		15 01 00 00 00 00 02 C9 01
		15 01 00 00 00 00 02 CA 86
		15 01 00 00 00 00 02 CB 01
		15 01 00 00 00 00 02 CC B3
		15 01 00 00 00 00 02 CD 01
		15 01 00 00 00 00 02 CE FA
		15 01 00 00 00 00 02 CF 02
		15 01 00 00 00 00 02 D0 30
		15 01 00 00 00 00 02 D1 02
		15 01 00 00 00 00 02 D2 31
		15 01 00 00 00 00 02 D3 02
		15 01 00 00 00 00 02 D4 62
		15 01 00 00 00 00 02 D5 02
		15 01 00 00 00 00 02 D6 94
		15 01 00 00 00 00 02 D7 02
		15 01 00 00 00 00 02 D8 B5
		15 01 00 00 00 00 02 D9 02
		15 01 00 00 00 00 02 DA E1
		15 01 00 00 00 00 02 DB 03
		15 01 00 00 00 00 02 DC 00
		15 01 00 00 00 00 02 DD 03
		15 01 00 00 00 00 02 DE 2B
		15 01 00 00 00 00 02 DF 03
		15 01 00 00 00 00 02 E0 38
		15 01 00 00 00 00 02 E1 03
		15 01 00 00 00 00 02 E2 47
		15 01 00 00 00 00 02 E3 03
		15 01 00 00 00 00 02 E4 59
		15 01 00 00 00 00 02 E5 03
		15 01 00 00 00 00 02 E6 6D
		15 01 00 00 00 00 02 E7 03
		15 01 00 00 00 00 02 E8 86
		15 01 00 00 00 00 02 E9 03
		15 01 00 00 00 00 02 EA A4
		15 01 00 00 00 00 02 EB 03
		15 01 00 00 00 00 02 EC E1
		15 01 00 00 00 00 02 ED 03
		15 01 00 00 00 00 02 EE FF
		//G(+) MCR cmd
		15 01 00 00 00 00 02 EF 00
		15 01 00 00 00 00 02 F0 00
		15 01 00 00 00 00 02 F1 00
		15 01 00 00 00 00 02 F2 0B
		15 01 00 00 00 00 02 F3 00
		15 01 00 00 00 00 02 F4 59
		15 01 00 00 00 00 02 F5 00
		15 01 00 00 00 00 02 F6 88
		15 01 00 00 00 00 02 F7 00
		15 01 00 00 00 00 02 F8 A5
		15 01 00 00 00 00 02 F9 00
		15 01 00 00 00 00 02 FA BD
		//page selection cmd start
		15 01 00 00 00 00 02 FF 02
		15 01 00 00 00 00 02 FB 01
		//page selection cmd end
		15 01 00 00 00 00 02 00 00
		15 01 00 00 00 00 02 01 D2
		15 01 00 00 00 00 02 02 00
		15 01 00 00 00 00 02 03 E2
		15 01 00 00 00 00 02 04 00
		15 01 00 00 00 00 02 05 F2
		15 01 00 00 00 00 02 06 01
		15 01 00 00 00 00 02 07 24
		15 01 00 00 00 00 02 08 01
		15 01 00 00 00 00 02 09 4B
		15 01 00 00 00 00 02 0A 01
		15 01 00 00 00 00 02 0B 86
		15 01 00 00 00 00 02 0C 01
		15 01 00 00 00 00 02 0D B3
		15 01 00 00 00 00 02 0E 01
		15 01 00 00 00 00 02 0F FA
		15 01 00 00 00 00 02 10 02
		15 01 00 00 00 00 02 11 30
		15 01 00 00 00 00 02 12 02
		15 01 00 00 00 00 02 13 31
		15 01 00 00 00 00 02 14 02
		15 01 00 00 00 00 02 15 62
		15 01 00 00 00 00 02 16 02
		15 01 00 00 00 00 02 17 94
		15 01 00 00 00 00 02 18 02
		15 01 00 00 00 00 02 19 B5
		15 01 00 00 00 00 02 1A 02
		15 01 00 00 00 00 02 1B E1
		15 01 00 00 00 00 02 1C 03
		15 01 00 00 00 00 02 1D 00
		15 01 00 00 00 00 02 1E 03
		15 01 00 00 00 00 02 1F 2B
		15 01 00 00 00 00 02 20 03
		15 01 00 00 00 00 02 21 38
		15 01 00 00 00 00 02 22 03
		15 01 00 00 00 00 02 23 47
		15 01 00 00 00 00 02 24 03
		15 01 00 00 00 00 02 25 59
		15 01 00 00 00 00 02 26 03
		15 01 00 00 00 00 02 27 6D
		15 01 00 00 00 00 02 28 03
		15 01 00 00 00 00 02 29 86
		15 01 00 00 00 00 02 2A 03
		15 01 00 00 00 00 02 2B A4
		15 01 00 00 00 00 02 2D 03
		15 01 00 00 00 00 02 2F E1
		15 01 00 00 00 00 02 30 03
		15 01 00 00 00 00 02 31 FF
		//G(-) MCR cmd
		15 01 00 00 00 00 02 32 00
		15 01 00 00 00 00 02 33 00
		15 01 00 00 00 00 02 34 00
		15 01 00 00 00 00 02 35 0B
		15 01 00 00 00 00 02 36 00
		15 01 00 00 00 00 02 37 59
		15 01 00 00 00 00 02 38 00
		15 01 00 00 00 00 02 39 88
		15 01 00 00 00 00 02 3A 00
		15 01 00 00 00 00 02 3B A5
		15 01 00 00 00 00 02 3D 00
		15 01 00 00 00 00 02 3F BD
		15 01 00 00 00 00 02 40 00
		15 01 00 00 00 00 02 41 D2
		15 01 00 00 00 00 02 42 00
		15 01 00 00 00 00 02 43 E2
		15 01 00 00 00 00 02 44 00
		15 01 00 00 00 00 02 45 F2
		15 01 00 00 00 00 02 46 01
		15 01 00 00 00 00 02 47 24
		15 01 00 00 00 00 02 48 01
		15 01 00 00 00 00 02 49 4B
		15 01 00 00 00 00 02 4A 01
		15 01 00 00 00 00 02 4B 86
		15 01 00 00 00 00 02 4C 01
		15 01 00 00 00 00 02 4D B3
		15 01 00 00 00 00 02 4E 01
		15 01 00 00 00 00 02 4F FA
		15 01 00 00 00 00 02 50 02
		15 01 00 00 00 00 02 51 30
		15 01 00 00 00 00 02 52 02
		15 01 00 00 00 00 02 53 31
		15 01 00 00 00 00 02 54 02
		15 01 00 00 00 00 02 55 62
		15 01 00 00 00 00 02 56 02
		15 01 00 00 00 00 02 58 94
		15 01 00 00 00 00 02 59 02
		15 01 00 00 00 00 02 5A B5
		15 01 00 00 00 00 02 5B 02
		15 01 00 00 00 00 02 5C E1
		15 01 00 00 00 00 02 5D 03
		15 01 00 00 00 00 02 5E 00
		15 01 00 00 00 00 02 5F 03
		15 01 00 00 00 00 02 60 2B
		15 01 00 00 00 00 02 61 03
		15 01 00 00 00 00 02 62 38
		15 01 00 00 00 00 02 63 03
		15 01 00 00 00 00 02 64 47
		15 01 00 00 00 00 02 65 03
		15 01 00 00 00 00 02 66 59
		15 01 00 00 00 00 02 67 03
		15 01 00 00 00 00 02 68 6D
		15 01 00 00 00 00 02 69 03
		15 01 00 00 00 00 02 6A 86
		15 01 00 00 00 00 02 6B 03
		15 01 00 00 00 00 02 6C A4
		15 01 00 00 00 00 02 6D 03
		15 01 00 00 00 00 02 6E E1
		15 01 00 00 00 00 02 6F 03
		15 01 00 00 00 00 02 70 FF
		//B(+) MCR cmd
		15 01 00 00 00 00 02 71 00
		15 01 00 00 00 00 02 72 00
		15 01 00 00 00 00 02 73 00
		15 01 00 00 00 00 02 74 0B
		15 01 00 00 00 00 02 75 00
		15 01 00 00 00 00 02 76 59
		15 01 00 00 00 00 02 77 00
		15 01 00 00 00 00 02 78 88
		15 01 00 00 00 00 02 79 00
		15 01 00 00 00 00 02 7A A5
		15 01 00 00 00 00 02 7B 00
		15 01 00 00 00 00 02 7C BD
		15 01 00 00 00 00 02 7D 00
		15 01 00 00 00 00 02 7E D2
		15 01 00 00 00 00 02 7F 00
		15 01 00 00 00 00 02 80 E2
		15 01 00 00 00 00 02 81 00
		15 01 00 00 00 00 02 82 F2
		15 01 00 00 00 00 02 83 01
		15 01 00 00 00 00 02 84 24
		15 01 00 00 00 00 02 85 01
		15 01 00 00 00 00 02 86 4B
		15 01 00 00 00 00 02 87 01
		15 01 00 00 00 00 02 88 86
		15 01 00 00 00 00 02 89 01
		15 01 00 00 00 00 02 8A B3
		15 01 00 00 00 00 02 8B 01
		15 01 00 00 00 00 02 8C FA
		15 01 00 00 00 00 02 8D 02
		15 01 00 00 00 00 02 8E 30
		15 01 00 00 00 00 02 8F 02
		15 01 00 00 00 00 02 90 31
		15 01 00 00 00 00 02 91 02
		15 01 00 00 00 00 02 92 62
		15 01 00 00 00 00 02 93 02
		15 01 00 00 00 00 02 94 94
		15 01 00 00 00 00 02 95 02
		15 01 00 00 00 00 02 96 B5
		15 01 00 00 00 00 02 97 02
		15 01 00 00 00 00 02 98 E1
		15 01 00 00 00 00 02 99 03
		15 01 00 00 00 00 02 9A 00
		15 01 00 00 00 00 02 9B 03
		15 01 00 00 00 00 02 9C 2B
		15 01 00 00 00 00 02 9D 03
		15 01 00 00 00 00 02 9E 38
		15 01 00 00 00 00 02 9F 03
		15 01 00 00 00 00 02 A0 47
		15 01 00 00 00 00 02 A2 03
		15 01 00 00 00 00 02 A3 59
		15 01 00 00 00 00 02 A4 03
		15 01 00 00 00 00 02 A5 6D
		15 01 00 00 00 00 02 A6 03
		15 01 00 00 00 00 02 A7 86
		15 01 00 00 00 00 02 A9 03
		15 01 00 00 00 00 02 AA A4
		15 01 00 00 00 00 02 AB 03
		15 01 00 00 00 00 02 AC E1
		15 01 00 00 00 00 02 AD 03
		15 01 00 00 00 00 02 AE FF
		//B(-) MCR cmd
		15 01 00 00 00 00 02 AF 00
		15 01 00 00 00 00 02 B0 00
		15 01 00 00 00 00 02 B1 00
		15 01 00 00 00 00 02 B2 0B
		15 01 00 00 00 00 02 B3 00
		15 01 00 00 00 00 02 B4 59
		15 01 00 00 00 00 02 B5 00
		15 01 00 00 00 00 02 B6 88
		15 01 00 00 00 00 02 B7 00
		15 01 00 00 00 00 02 B8 A5
		15 01 00 00 00 00 02 B9 00
		15 01 00 00 00 00 02 BA BD
		15 01 00 00 00 00 02 BB 00
		15 01 00 00 00 00 02 BC D2
		15 01 00 00 00 00 02 BD 00
		15 01 00 00 00 00 02 BE E2
		15 01 00 00 00 00 02 BF 00
		15 01 00 00 00 00 02 C0 F2
		15 01 00 00 00 00 02 C1 01
		15 01 00 00 00 00 02 C2 24
		15 01 00 00 00 00 02 C3 01
		15 01 00 00 00 00 02 C4 4B
		15 01 00 00 00 00 02 C5 01
		15 01 00 00 00 00 02 C6 86
		15 01 00 00 00 00 02 C7 01
		15 01 00 00 00 00 02 C8 B3
		15 01 00 00 00 00 02 C9 01
		15 01 00 00 00 00 02 CA FA
		15 01 00 00 00 00 02 CB 02
		15 01 00 00 00 00 02 CC 30
		15 01 00 00 00 00 02 CD 02
		15 01 00 00 00 00 02 CE 31
		15 01 00 00 00 00 02 CF 02
		15 01 00 00 00 00 02 D0 62
		15 01 00 00 00 00 02 D1 02
		15 01 00 00 00 00 02 D2 94
		15 01 00 00 00 00 02 D3 02
		15 01 00 00 00 00 02 D4 B5
		15 01 00 00 00 00 02 D5 02
		15 01 00 00 00 00 02 D6 E1
		15 01 00 00 00 00 02 D7 03
		15 01 00 00 00 00 02 D8 00
		15 01 00 00 00 00 02 D9 03
		15 01 00 00 00 00 02 DA 2B
		15 01 00 00 00 00 02 DB 03
		15 01 00 00 00 00 02 DC 38
		15 01 00 00 00 00 02 DD 03
		15 01 00 00 00 00 02 DE 47
		15 01 00 00 00 00 02 DF 03
		15 01 00 00 00 00 02 E0 59
		15 01 00 00 00 00 02 E1 03
		15 01 00 00 00 00 02 E2 6D
		15 01 00 00 00 00 02 E3 03
		15 01 00 00 00 00 02 E4 86
		15 01 00 00 00 00 02 E5 03
		15 01 00 00 00 00 02 E6 A4
		15 01 00 00 00 00 02 E7 03
		15 01 00 00 00 00 02 E8 E1
		15 01 00 00 00 00 02 E9 03
		15 01 00 00 00 00 02 EA FF
		//ccmoff
		//ccmrun
//*******************************************************************

		//CMD1
		15 01 00 00 01 00 02 FF 00

		//VBP,VFP
		15 01 00 00 00 00 02 D3 0C
		15 01 00 00 00 00 02 D4 02
		15 01 00 00 00 00 02 FF 05
		15 01 00 00 00 00 02 FB 01
		15 01 00 00 00 00 02 E7 80
		15 01 00 00 01 00 02 FF 01
		15 01 00 00 01 00 02 FB 01
		15 01 00 00 01 00 02 5C 84
		15 01 00 00 01 00 02 5D 84
		15 01 00 00 01 00 02 5E 04
		15 01 00 00 01 00 02 5F 04
		15 01 00 00 01 00 02 60 11
		15 01 00 00 00 00 02 FF 00
            	05 01 00 00 78 00 02 11 00
		05 01 00 00 32 00 02 29 00

		];
		qcom,mdss-dsi-off-command = [05 01 00 00 32 00 02 28 00
					05 01 00 00 78 00 02 10 00];

		qcom,mdss-dsi-on-command-state = "dsi_lp_mode";
		qcom,mdss-dsi-off-command-state = "dsi_hs_mode";
		qcom,mdss-dsi-h-sync-pulse = <1>;
		qcom,mdss-dsi-traffic-mode = "non_burst_sync_event";
		qcom,mdss-dsi-lane-map = "lane_map_3012";
		qcom,mdss-dsi-bllp-eof-power-mode;
		qcom,mdss-dsi-bllp-power-mode;
		qcom,mdss-dsi-lane-0-state;
		qcom,mdss-dsi-lane-1-state;
		qcom,mdss-dsi-lane-2-state;
		qcom,mdss-dsi-lane-3-state;
		qcom,mdss-dsi-panel-timings = [f9 3d 34 00 58 4d 36 3f 53 03 04 00];
		qcom,mdss-dsi-t-clk-post = <0x1e>;
		qcom,mdss-dsi-t-clk-pre = <0x38>;
		qcom,mdss-dsi-bl-min-level = <11>;
		qcom,mdss-dsi-bl-max-level = <255>;
		qcom,mdss-dsi-interleave-mode = <0>;
		qcom,mdss-dsi-dma-trigger = "trigger_sw";
		qcom,mdss-dsi-mdp-trigger = "none";

		qcom,mdss-dsi-bl-pmic-control-type = "bl_ctrl_pwm";
		qcom,mdss-dsi-bl-pmic-pwm-frequency = <255>;		/*TCTNB.CY, PR-891676, modify for backlight blink*/
		qcom,mdss-dsi-bl-pmic-bank-select = <0>;
		qcom,mdss-dsi-pwm-gpio = <&pm8916_mpps 4 0>;
		qcom,cont-splash-enabled;
		qcom,mdss-dsi-lp11-init;

/* [PLATFORM]-Mod-BEGIN by TCTNB.CY, CR-990241, 2015/4/30, enable esd check*/
		qcom,esd-check-enabled;
		qcom,mdss-dsi-panel-status-command = [
			06 01 00 01 05 00 01 0a
		];
		qcom,mdss-dsi-panel-status-command-state = "dsi_lp_mode";
		qcom,mdss-dsi-panel-status-check-mode = "reg_read";
		qcom,mdss-dsi-panel-status-value = <0x9c 0x00 0x00 0x00 0x00 0x00 0x00 0x00 0x00 0x00>;
/* [PLATFORM]-Mod-END by TCTNB.CY, 2015/4/30*/

		qcom,mdss-dsi-reset-sequence = <1 20>, <0 20>, <1 20>;

	};
};
