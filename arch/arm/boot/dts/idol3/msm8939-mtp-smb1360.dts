/* Copyright (c) 2014-2015, The Linux Foundation. All rights reserved.
*
* This program is free software; you can redistribute it and/or modify
* it under the terms of the GNU General Public License version 2 and
* only version 2 as published by the Free Software Foundation.
*
* This program is distributed in the hope that it will be useful,
* but WITHOUT ANY WARRANTY; without even the implied warranty of
* MERCHANTABILITY or FITNESS FOR A PARTICULAR PURPOSE.  See the
* GNU General Public License for more details.
*/

/dts-v1/;

#include "msm8939.dtsi"
#include "msm8939-mtp.dtsi"
#include "msm8939-audio-internal_codec.dtsi"

/ {
	model = "Qualcomm Technologies, Inc. MSM 8939 SMB1360 MTP";
	compatible = "qcom,msm8939-mtp", "qcom,msm8939", "qcom,mtp";
	qcom,board-id = <8 0>;
};

&i2c_4 {
	smb1360_otg_supply: smb1360-chg-fg@14 {
	/* [PLATFORM]-Mod-BEGIN by TCTNB.FLF, PR-790435, 2014/11/12, fix irq blocks booting up*/
	/* task:1176413 2015.12.22 dhx  */
        compatible = "qcom,smb1360-chg-fg";
        reg = <0x14>;
        interrupt-parent = <&msm_gpio>;
        interrupts = <62 2>;
        pinctrl-names = "default";
        pinctrl-0 = <&smb_int_default>;
        qcom,stat-pulsed-irq;
        qcom,chg-inhibit-disabled;
        qcom,float-voltage-mv = <4350>;
        qcom,fg-cc-to-cv-mv = <4328>;
	qcom,thermistor-c1-coeff = <0x86C8>;
        qcom,iterm-ma = <100>;   // bug946997, wangjin modified, 2015/3/13
        qcom,charging-timeout = <0>; //TMP modify by wqf for stability test, need to revert later
        qcom,otg-batt-curr-limit = <1500>;
        qcom,recharge-thresh-mv = <100>;
        qcom,thermal-mitigation = <1500 700 600 0>;
        qcom,fg-auto-recharge-soc = <99>;
        qcom,empty-soc-disabled;
        regulator-name = "smb1360_otg_vreg";
        /* qcom,awake-min-soc; */
        qcom,batt-profile-select; // MODIFIED by jin.wang, 2016-05-12,BUG-2145817
        qcom,smb1360-vadc = <&pm8916_vadc>;
        qcom,batt-id-vref-uv = <1800000>;
        qcom,batt-id-rpullup-kohm = <100>;
        qcom,profile-a-rid-kohm = <33>;
        qcom,profile-b-rid-kohm = <52>;
	qcom,fg-batt-capacity-mah = <2910>;
        qcom,fg-cc-soc-coeff = <0x81A1>;

        qcom,shdn-after-pwroff;
	qcom,fg-soc-max = <85>;
        qcom,fg-soc-min = <15>;
        qcom,fg-delta-soc = <1>;

	/* MODIFIED-BEGIN by jin.wang, 2016-05-12,BUG-2145817*/
	qcom,fg-reset-at-pon;
	qcom,fg-reset-thresold-mv = <200>;
	/* MODIFIED-END by jin.wang,BUG-2145817*/

        qcom,config-hard-thresholds;
        qcom,hot-bat-decidegc = <550>;
	qcom,cold-bat-decidegc = <0>;   // changed as qcom suggestion

	qcom,soft-jeita-supported;
	qcom,warm-bat-decidegc = <450>;
	qcom,cool-bat-decidegc = <100>;
	qcom,warm-bat-mv = <4100>;
	qcom,cool-bat-mv = <4350>;
	qcom,warm-bat-ma = <1350>;
	qcom,cool-bat-ma = <750>;
/* [PLATFORM]-Mod-END by TCTNB.FLF */
	};
};

/*&pm8916_chg {
	status = "ok";
	qcom,use-external-charger;
};

&pm8916_bms {
	status = "ok";
	qcom,disable-bms;
};*/ //MODIFIED by jianeng.yuan, 2016-04-14,BUG-1941671

&usb_otg {
	qcom,hsusb-otg-mode = <3>;
        /*[PLATFORM]-Mod-BEGIN by TCTNB.Bin.Su, PR-883930, 2014/12/30, Idle power consumption is high in airplane*/
	//qcom,usbid-gpio = <&msm_gpio 79 0>;/*NB.THW modify 2014/11/17*/
        qcom,usbid-gpio = <&msm_gpio 69 0>;
        /* [PLATFORM]-Mod-END by TCTNB.Bin.Su */
	pinctrl-names = "default";
	pinctrl-0 = <&usbid_default>;
	vbus_otg-supply = <&smb1360_otg_supply>;
};

/*MODIFIED-BEGIN by jianeng.yuan, 2016-04-14,BUG-1941671*/
/*&cci {
	qcom,camera@0 {
		qcom,led-flash-src = <&led_flash0>;
	};
};*/
/*MODIFIED-END by jianeng.yuan,BUG-1941671*/
