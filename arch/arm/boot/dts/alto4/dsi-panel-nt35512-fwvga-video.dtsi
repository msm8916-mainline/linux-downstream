/* Copyright (c) 2014, The Linux Foundation. All rights reserved.
 *
 * This program is free software; you can redistribute it and/or modify
 * it under the terms of the GNU General Public License version 2 and
 * only version 2 as published by the Free Software Foundation.
 *
 * This program is distributed in the hope that it will be useful,
 * but WITHOUT ANY WARRANTY; without even the implied warranty of
 * MERCHANTABILITY or FITNESS FOR A PARTICULAR PURPOSE.  See the
 * GNU General Public License for more details.
 */

/*---------------------------------------------------------------------------
 * This file is autogenerated file using gcdb parser. Please do not edit it.
 * Update input XML file to add a new entry or update variable in this file
 * VERSION = "1.0"
 *---------------------------------------------------------------------------*/
&mdss_mdp {
	dsi_nt35512_fwvga_vid: qcom,mdss_dsi_nt35512_fwvga_video {
		qcom,mdss-dsi-panel-name = "nt35512 video mode dsi panel";
		qcom,mdss-dsi-panel-controller = <&mdss_dsi0>;
		qcom,mdss-dsi-panel-type = "dsi_video_mode";
		qcom,mdss-dsi-panel-destination = "display_1";
        qcom,mdss-dsi-panel-framerate = <60>;
		qcom,mdss-dsi-virtual-channel-id = <0>;
		qcom,mdss-dsi-stream = <0>;
		qcom,mdss-dsi-panel-width = <480>;
		qcom,mdss-dsi-panel-height = <854>;
		qcom,mdss-dsi-h-front-porch = <100>;
		qcom,mdss-dsi-h-back-porch = <100>;
		qcom,mdss-dsi-h-pulse-width = <4>;
		qcom,mdss-dsi-h-sync-skew = <0>;
		qcom,mdss-dsi-v-back-porch = <10>;
		qcom,mdss-dsi-v-front-porch = <20>;
		qcom,mdss-dsi-v-pulse-width = <4>;
		qcom,mdss-dsi-h-left-border = <0>;
		qcom,mdss-dsi-h-right-border = <0>;
		qcom,mdss-dsi-v-top-border = <0>;
		qcom,mdss-dsi-v-bottom-border = <0>;
		qcom,mdss-dsi-bpp = <24>;
		qcom,mdss-dsi-color-order = "rgb_swap_rgb";
		qcom,mdss-dsi-underflow-color = <0xff>;
		qcom,mdss-dsi-border-color = <0>;
		qcom,mdss-dsi-on-command = [
	        39 01 00 00 00 00 06
				F0 55 AA 52 08 01
			15 01 00 00 00 00 02
				B0 0D
			15 01 00 00 00 00 02
				B6 36
			15 01 00 00 00 00 02
				B1 0D
			15 01 00 00 00 00 02
				B7 24
			15 01 00 00 00 00 02
				B2 00
			15 01 00 00 00 00 02
				B8 36
			15 01 00 00 00 00 02
				BF 01
			15 01 00 00 00 00 02
				B3 0F
			15 01 00 00 00 00 02
				B9 34
			15 01 00 00 00 00 02
				B5 08
			15 01 00 00 00 00 02
				BA 14
	        39 01 00 00 00 00 04
		        BC 00 78 00
	        39 01 00 00 00 00 04
		        BD 00 78 00
	        39 01 00 00 00 00 03
//		        BE 00 5F
		        BE 00 60
	        39 01 00 00 00 00 35
D1 00 00 00 07 00 23 00 4C 00 76 00 BB 00 EA 01 2C 01 5A 01 98 01 C3 01 FF 02 2D 02 2E 02 56 02 7D 02 94 02 AF 02 BF 02 D3 02 E0 02 F2 02 FE 03 11 03 38 03 FF
	        39 01 00 00 00 00 35
D2 00 00 00 07 00 23 00 4C 00 76 00 BB 00 EA 01 2C 01 5A 01 98 01 C3 01 FF 02 2D 02 2E 02 56 02 7D 02 94 02 AF 02 BF 02 D3 02 E0 02 F2 02 FE 03 11 03 38 03 FF
	        39 01 00 00 00 00 35
D3 00 00 00 07 00 23 00 4C 00 76 00 BB 00 EA 01 2C 01 5A 01 98 01 C3 01 FF 02 2D 02 2E 02 56 02 7D 02 94 02 AF 02 BF 02 D3 02 E0 02 F2 02 FE 03 11 03 38 03 FF
	        39 01 00 00 00 00 35
D4 00 00 00 07 00 23 00 4C 00 76 00 BB 00 EA 01 2C 01 5A 01 98 01 C3 01 FF 02 2D 02 2E 02 56 02 7D 02 94 02 AF 02 BF 02 D3 02 E0 02 F2 02 FE 03 11 03 38 03 FF
	        39 01 00 00 00 00 35
D5 00 00 00 07 00 23 00 4C 00 76 00 BB 00 EA 01 2C 01 5A 01 98 01 C3 01 FF 02 2D 02 2E 02 56 02 7D 02 94 02 AF 02 BF 02 D3 02 E0 02 F2 02 FE 03 11 03 38 03 FF
	        39 01 00 00 00 00 35
D6 00 00 00 07 00 23 00 4C 00 76 00 BB 00 EA 01 2C 01 5A 01 98 01 C3 01 FF 02 2D 02 2E 02 56 02 7D 02 94 02 AF 02 BF 02 D3 02 E0 02 F2 02 FE 03 11 03 38 03 FF
	        39 01 00 00 00 00 06
		        F0 55 AA 52 08 00
			15 01 00 00 00 00 02
				B5 6B
			15 01 00 00 00 00 02
				DE 19
			15 01 00 00 00 00 02
				B6 05
	        39 01 00 00 00 00 03
	    	    B7 77 77
	        39 01 00 00 00 00 05
				B8 01 03 03 03
			15 01 00 00 00 00 02
//				BC 02
				BC 00
			15 01 00 00 00 00 02
				DE 1E
	        39 01 00 00 00 00 04
		        B1 6A 00 01
	        39 01 00 00 00 00 0C
	        CE 00 FF FF FF FF B0 C1 D2 E3 0A 80
			05 01 00 00 78 00 02 11 00
			05 01 00 00 8C 00 02 29 00];
		qcom,mdss-dsi-off-command = [05 01 00 00 02 00 02 28 00
					05 01 00 00 79 00 02 10 00];
		qcom,mdss-dsi-on-command-state = "dsi_lp_mode";
		qcom,mdss-dsi-off-command-state = "dsi_hs_mode";
		qcom,mdss-dsi-h-sync-pulse = <1>;
		qcom,mdss-dsi-traffic-mode = "burst_mode";
		qcom,mdss-dsi-lane-map = "lane_map_3012";
		qcom,mdss-dsi-bllp-eof-power-mode;
		qcom,mdss-dsi-bllp-power-mode;
		qcom,mdss-dsi-lane-0-state;
		qcom,mdss-dsi-lane-1-state;
//		qcom,mdss-dsi-lane-2-state;
//		qcom,mdss-dsi-lane-3-state;
		qcom,mdss-dsi-panel-timings = [f2 1c 12 00 40 42 16 1e 14 03 04 00];
		qcom,mdss-dsi-t-clk-post = <0x04>;
		qcom,mdss-dsi-t-clk-pre = <0x39>;
		qcom,mdss-dsi-panel-clockrate = <437300000>;
		qcom,mdss-dsi-bl-min-level = <1>;
		qcom,mdss-dsi-bl-max-level = <255>;
		qcom,mdss-dsi-dma-trigger = "trigger_sw";
		qcom,mdss-dsi-mdp-trigger = "none";
		qcom,mdss-dsi-bl-pmic-control-type = "bl_ctrl_wled";
		qcom,mdss-dsi-reset-sequence = <1 20>, <0 200>, <1 20>;
		qcom,mdss-pan-physical-width-dimension = <0>;
		qcom,mdss-pan-physical-height-dimension = <0>;
	};
};
